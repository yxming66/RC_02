/*
 * JJ Lin - Xing Cun Zhe.
 * Single-line PWM buzzer reduction generated from PiaStudy 1hLQ3hKIzWy space data.
 * The source is PiaStudy timestamp/space data matching the provided PDF.
 * Each visible playback onset contributes one buzzer tone, so moving
 * accompaniment is preserved instead of being hidden under long held notes.
 * Simultaneous notes are reduced upper-voice first, but repeated
 * top notes fall through to another chord tone when that exposes
 * motion that would otherwise sound like a tied note.
 * Notes outside the practical buzzer range are folded by octaves into C3-C7.
 * 935 events, about 254 seconds.
 */
#define XCZ(note, octave, ms) {note, octave, (uint16_t)(ms)}
#define XCZ_R(ms) {NOTE_REST, 0, (uint16_t)(ms)}

const Tone_t XING_CUN_ZHE[] = {
    /* Events 1-16 */
    XCZ(NOTE_DS, 4, 435),
    XCZ(NOTE_FS, 3, 435),
    XCZ(NOTE_DS, 5, 217),
    XCZ(NOTE_E, 5, 217),
    XCZ(NOTE_DS, 5, 217),
    XCZ(NOTE_CS, 5, 217),
    XCZ(NOTE_FS, 4, 435),
    XCZ(NOTE_CS, 3, 435),
    XCZ(NOTE_DS, 5, 217),
    XCZ(NOTE_E, 5, 217),
    XCZ(NOTE_DS, 5, 435),
    XCZ(NOTE_CS, 5, 435),
    XCZ(NOTE_B, 3, 435),
    XCZ(NOTE_E, 3, 435),
    XCZ(NOTE_B, 4, 434),
    XCZ(NOTE_FS, 4, 218),
    /* Events 17-32 */
    XCZ(NOTE_E, 4, 217),
    XCZ(NOTE_AS, 4, 217),
    XCZ(NOTE_B, 4, 217),
    XCZ(NOTE_E, 3, 435),
    XCZ(NOTE_E, 4, 435),
    XCZ(NOTE_DS, 4, 434),
    XCZ(NOTE_FS, 3, 435),
    XCZ(NOTE_DS, 5, 217),
    XCZ(NOTE_E, 5, 217),
    XCZ(NOTE_DS, 5, 217),
    XCZ(NOTE_CS, 5, 217),
    XCZ(NOTE_FS, 4, 434),
    XCZ(NOTE_CS, 3, 435),
    XCZ(NOTE_DS, 5, 217),
    XCZ(NOTE_E, 5, 217),
    XCZ(NOTE_DS, 5, 435),
    /* Events 33-48 */
    XCZ(NOTE_CS, 5, 435),
    XCZ(NOTE_B, 3, 217),
    XCZ(NOTE_B, 4, 217),
    XCZ(NOTE_E, 4, 435),
    XCZ(NOTE_B, 3, 435),
    XCZ(NOTE_FS, 5, 1739),
    XCZ(NOTE_DS, 4, 435),
    XCZ(NOTE_B, 3, 435),
    XCZ(NOTE_DS, 5, 434),
    XCZ(NOTE_E, 5, 217),
    XCZ(NOTE_FS, 5, 217),
    XCZ(NOTE_DS, 5, 435),
    XCZ(NOTE_CS, 5, 435),
    XCZ(NOTE_AS, 4, 869),
    XCZ(NOTE_CS, 4, 435),
    XCZ(NOTE_AS, 3, 435),
    /* Events 49-64 */
    XCZ(NOTE_CS, 5, 435),
    XCZ(NOTE_DS, 5, 217),
    XCZ(NOTE_E, 5, 217),
    XCZ(NOTE_DS, 4, 435),
    XCZ(NOTE_DS, 5, 435),
    XCZ(NOTE_DS, 4, 217),
    XCZ(NOTE_AS, 3, 217),
    XCZ(NOTE_DS, 3, 435),
    XCZ(NOTE_GS, 4, 434),
    XCZ(NOTE_GS, 3, 435),
    XCZ(NOTE_GS, 4, 290),
    XCZ(NOTE_AS, 4, 290),
    XCZ(NOTE_B, 4, 290),
    XCZ(NOTE_FS, 5, 434),
    XCZ(NOTE_FS, 3, 217),
    XCZ(NOTE_FS, 3, 217),
    /* Events 65-80 */
    XCZ(NOTE_CS, 5, 435),
    XCZ(NOTE_DS, 5, 435),
    XCZ(NOTE_GS, 4, 435),
    XCZ(NOTE_DS, 3, 217),
    XCZ(NOTE_AS, 4, 217),
    XCZ(NOTE_DS, 4, 217),
    XCZ(NOTE_E, 4, 217),
    XCZ(NOTE_DS, 4, 435),
    XCZ(NOTE_FS, 3, 435),
    XCZ(NOTE_CS, 3, 217),
    XCZ(NOTE_FS, 3, 217),
    XCZ(NOTE_AS, 3, 434),
    XCZ(NOTE_FS, 3, 435),
    XCZ(NOTE_DS, 5, 435),
    XCZ(NOTE_B, 3, 217),
    XCZ(NOTE_E, 3, 217),
    /* Events 81-96 */
    XCZ(NOTE_E, 5, 290),
    XCZ(NOTE_E, 5, 289),
    XCZ(NOTE_FS, 5, 290),
    XCZ(NOTE_DS, 5, 435),
    XCZ(NOTE_CS, 5, 217),
    XCZ(NOTE_FS, 3, 217),
    XCZ(NOTE_AS, 3, 217),
    XCZ(NOTE_FS, 3, 217),
    XCZ(NOTE_CS, 3, 434),
    XCZ(NOTE_CS, 4, 435),
    XCZ(NOTE_DS, 3, 217),
    XCZ(NOTE_GS, 3, 217),
    XCZ(NOTE_E, 5, 217),
    XCZ(NOTE_DS, 5, 218),
    XCZ(NOTE_AS, 3, 217),
    XCZ(NOTE_AS, 4, 217),
    /* Events 97-112 */
    XCZ(NOTE_CS, 5, 218),
    XCZ(NOTE_DS, 3, 217),
    XCZ(NOTE_B, 4, 435),
    XCZ(NOTE_GS, 3, 435),
    XCZ(NOTE_AS, 3, 217),
    XCZ(NOTE_B, 3, 217),
    XCZ(NOTE_GS, 4, 434),
    XCZ(NOTE_B, 3, 435),
    XCZ(NOTE_GS, 4, 290),
    XCZ(NOTE_AS, 4, 290),
    XCZ(NOTE_B, 4, 290),
    XCZ(NOTE_FS, 4, 435),
    XCZ(NOTE_CS, 3, 434),
    XCZ(NOTE_AS, 4, 435),
    XCZ(NOTE_CS, 3, 435),
    XCZ(NOTE_B, 4, 435),
    /* Events 113-128 */
    XCZ(NOTE_B, 3, 217),
    XCZ(NOTE_FS, 3, 217),
    XCZ(NOTE_E, 4, 217),
    XCZ(NOTE_FS, 4, 217),
    XCZ(NOTE_E, 4, 435),
    XCZ(NOTE_DS, 4, 1739),
    XCZ(NOTE_B, 5, 435),
    XCZ(NOTE_AS, 5, 217),
    XCZ(NOTE_CS, 5, 217),
    XCZ(NOTE_AS, 5, 217),
    XCZ(NOTE_FS, 3, 217),
    XCZ(NOTE_GS, 5, 217),
    XCZ(NOTE_B, 4, 217),
    XCZ(NOTE_GS, 5, 435),
    XCZ(NOTE_FS, 5, 217),
    XCZ(NOTE_CS, 5, 217),
    /* Events 129-144 */
    XCZ(NOTE_AS, 3, 217),
    XCZ(NOTE_FS, 3, 217),
    XCZ(NOTE_CS, 3, 217),
    XCZ(NOTE_AS, 3, 217),
    XCZ(NOTE_GS, 5, 435),
    XCZ(NOTE_FS, 5, 217),
    XCZ(NOTE_CS, 5, 217),
    XCZ(NOTE_FS, 5, 217),
    XCZ(NOTE_FS, 3, 217),
    XCZ(NOTE_DS, 5, 217),
    XCZ(NOTE_FS, 4, 217),
    XCZ(NOTE_DS, 5, 434),
    XCZ(NOTE_CS, 5, 217),
    XCZ(NOTE_GS, 4, 217),
    XCZ(NOTE_GS, 3, 217),
    XCZ(NOTE_B, 3, 217),
    /* Events 145-160 */
    XCZ(NOTE_CS, 3, 217),
    XCZ(NOTE_DS, 3, 217),
    XCZ(NOTE_GS, 4, 434),
    XCZ(NOTE_B, 3, 217),
    XCZ(NOTE_E, 3, 217),
    XCZ(NOTE_GS, 4, 290),
    XCZ(NOTE_AS, 4, 145),
    XCZ(NOTE_E, 3, 145),
    XCZ(NOTE_B, 4, 290),
    XCZ(NOTE_FS, 5, 435),
    XCZ(NOTE_CS, 3, 217),
    XCZ(NOTE_FS, 3, 217),
    XCZ(NOTE_CS, 5, 218),
    XCZ(NOTE_FS, 3, 217),
    XCZ(NOTE_CS, 3, 435),
    XCZ(NOTE_B, 4, 435),
    /* Events 161-176 */
    XCZ(NOTE_CS, 5, 217),
    XCZ(NOTE_FS, 3, 217),
    XCZ(NOTE_CS, 5, 218),
    XCZ(NOTE_B, 3, 217),
    XCZ(NOTE_DS, 5, 218),
    XCZ(NOTE_B, 3, 217),
    XCZ(NOTE_DS, 5, 435),
    XCZ(NOTE_E, 5, 217),
    XCZ(NOTE_FS, 3, 217),
    XCZ(NOTE_FS, 5, 217),
    XCZ(NOTE_DS, 3, 217),
    XCZ(NOTE_FS, 3, 217),
    XCZ(NOTE_FS, 3, 217),
    XCZ(NOTE_B, 5, 435),
    XCZ(NOTE_AS, 5, 217),
    XCZ(NOTE_CS, 5, 217),
    /* Events 177-192 */
    XCZ(NOTE_AS, 5, 217),
    XCZ(NOTE_FS, 3, 217),
    XCZ(NOTE_GS, 5, 217),
    XCZ(NOTE_B, 4, 217),
    XCZ(NOTE_GS, 5, 435),
    XCZ(NOTE_FS, 5, 217),
    XCZ(NOTE_CS, 5, 217),
    XCZ(NOTE_AS, 3, 217),
    XCZ(NOTE_FS, 3, 217),
    XCZ(NOTE_CS, 3, 217),
    XCZ(NOTE_AS, 3, 217),
    XCZ(NOTE_GS, 5, 435),
    XCZ(NOTE_FS, 5, 217),
    XCZ(NOTE_CS, 5, 217),
    XCZ(NOTE_FS, 5, 217),
    XCZ(NOTE_FS, 3, 217),
    /* Events 193-208 */
    XCZ(NOTE_AS, 4, 217),
    XCZ(NOTE_CS, 5, 217),
    XCZ(NOTE_FS, 4, 434),
    XCZ(NOTE_DS, 5, 217),
    XCZ(NOTE_CS, 5, 217),
    XCZ(NOTE_FS, 4, 217),
    XCZ(NOTE_B, 4, 217),
    XCZ(NOTE_GS, 3, 217),
    XCZ(NOTE_GS, 3, 217),
    XCZ(NOTE_GS, 4, 434),
    XCZ(NOTE_B, 3, 217),
    XCZ(NOTE_E, 3, 217),
    XCZ(NOTE_GS, 4, 290),
    XCZ(NOTE_AS, 4, 145),
    XCZ(NOTE_E, 3, 145),
    XCZ(NOTE_B, 4, 290),
    /* Events 209-224 */
    XCZ(NOTE_E, 4, 435),
    XCZ(NOTE_CS, 3, 217),
    XCZ(NOTE_FS, 3, 217),
    XCZ(NOTE_AS, 4, 218),
    XCZ(NOTE_FS, 3, 217),
    XCZ(NOTE_CS, 3, 435),
    XCZ(NOTE_B, 4, 435),
    XCZ(NOTE_FS, 3, 217),
    XCZ(NOTE_B, 3, 217),
    XCZ(NOTE_DS, 4, 217),
    XCZ(NOTE_E, 4, 217),
    XCZ(NOTE_DS, 4, 217),
    XCZ(NOTE_B, 3, 217),
    XCZ(NOTE_FS, 3, 435),
    XCZ(NOTE_CS, 3, 217),
    XCZ(NOTE_FS, 3, 217),
    /* Events 225-240 */
    XCZ(NOTE_DS, 4, 217),
    XCZ(NOTE_E, 4, 217),
    XCZ(NOTE_DS, 4, 217),
    XCZ(NOTE_AS, 3, 217),
    XCZ(NOTE_GS, 3, 435),
    XCZ(NOTE_DS, 3, 217),
    XCZ(NOTE_GS, 3, 217),
    XCZ(NOTE_AS, 3, 217),
    XCZ(NOTE_B, 3, 217),
    XCZ(NOTE_AS, 3, 217),
    XCZ(NOTE_GS, 3, 217),
    XCZ(NOTE_E, 3, 435),
    XCZ(NOTE_CS, 3, 217),
    XCZ(NOTE_B, 4, 217),
    XCZ(NOTE_FS, 4, 217),
    XCZ(NOTE_AS, 4, 218),
    /* Events 241-256 */
    XCZ(NOTE_B, 3, 217),
    XCZ(NOTE_FS, 4, 217),
    XCZ(NOTE_DS, 4, 435),
    XCZ(NOTE_FS, 3, 217),
    XCZ(NOTE_B, 3, 217),
    XCZ(NOTE_DS, 4, 217),
    XCZ(NOTE_E, 4, 217),
    XCZ(NOTE_DS, 4, 217),
    XCZ(NOTE_B, 3, 217),
    XCZ(NOTE_FS, 3, 434),
    XCZ(NOTE_CS, 3, 217),
    XCZ(NOTE_FS, 3, 217),
    XCZ(NOTE_DS, 4, 217),
    XCZ(NOTE_E, 4, 217),
    XCZ(NOTE_DS, 4, 217),
    XCZ(NOTE_AS, 3, 217),
    /* Events 257-272 */
    XCZ(NOTE_FS, 4, 435),
    XCZ(NOTE_E, 3, 217),
    XCZ(NOTE_DS, 4, 217),
    XCZ_R(435),
    XCZ(NOTE_FS, 4, 435),
    XCZ(NOTE_FS, 3, 1304),
    XCZ(NOTE_FS, 4, 217),
    XCZ(NOTE_FS, 4, 217),
    XCZ(NOTE_CS, 5, 217),
    XCZ(NOTE_B, 4, 218),
    XCZ(NOTE_FS, 3, 217),
    XCZ(NOTE_FS, 4, 217),
    XCZ(NOTE_CS, 5, 217),
    XCZ(NOTE_B, 4, 217),
    XCZ(NOTE_FS, 3, 218),
    XCZ(NOTE_FS, 4, 217),
    /* Events 273-288 */
    XCZ(NOTE_CS, 5, 217),
    XCZ(NOTE_B, 4, 217),
    XCZ(NOTE_CS, 3, 217),
    XCZ(NOTE_FS, 3, 217),
    XCZ(NOTE_AS, 3, 217),
    XCZ(NOTE_B, 3, 217),
    XCZ(NOTE_CS, 3, 218),
    XCZ(NOTE_FS, 4, 217),
    XCZ(NOTE_CS, 5, 217),
    XCZ(NOTE_B, 4, 217),
    XCZ(NOTE_DS, 3, 217),
    XCZ(NOTE_FS, 4, 217),
    XCZ(NOTE_CS, 5, 217),
    XCZ(NOTE_B, 4, 218),
    XCZ(NOTE_DS, 3, 217),
    XCZ(NOTE_FS, 4, 217),
    /* Events 289-304 */
    XCZ(NOTE_CS, 5, 217),
    XCZ(NOTE_B, 4, 217),
    XCZ(NOTE_B, 3, 217),
    XCZ(NOTE_E, 3, 217),
    XCZ(NOTE_FS, 3, 217),
    XCZ(NOTE_B, 3, 217),
    XCZ(NOTE_E, 3, 217),
    XCZ(NOTE_FS, 4, 217),
    XCZ(NOTE_E, 5, 217),
    XCZ(NOTE_DS, 5, 217),
    XCZ(NOTE_FS, 3, 217),
    XCZ(NOTE_B, 3, 217),
    XCZ(NOTE_DS, 5, 217),
    XCZ(NOTE_CS, 5, 218),
    XCZ(NOTE_FS, 3, 217),
    XCZ(NOTE_CS, 5, 217),
    /* Events 305-320 */
    XCZ(NOTE_FS, 4, 434),
    XCZ(NOTE_B, 4, 217),
    XCZ(NOTE_FS, 3, 217),
    XCZ(NOTE_B, 4, 218),
    XCZ(NOTE_FS, 3, 217),
    XCZ(NOTE_AS, 4, 217),
    XCZ(NOTE_AS, 4, 217),
    XCZ(NOTE_DS, 4, 217),
    XCZ(NOTE_GS, 4, 218),
    XCZ(NOTE_B, 3, 217),
    XCZ(NOTE_E, 3, 217),
    XCZ(NOTE_E, 4, 217),
    XCZ(NOTE_FS, 4, 217),
    XCZ(NOTE_CS, 5, 217),
    XCZ(NOTE_B, 4, 217),
    XCZ(NOTE_E, 3, 217),
    /* Events 321-336 */
    XCZ(NOTE_B, 3, 217),
    XCZ(NOTE_B, 4, 217),
    XCZ(NOTE_AS, 4, 217),
    XCZ(NOTE_B, 3, 217),
    XCZ(NOTE_E, 3, 217),
    XCZ(NOTE_GS, 4, 217),
    XCZ(NOTE_E, 4, 217),
    XCZ(NOTE_DS, 5, 217),
    XCZ(NOTE_CS, 5, 218),
    XCZ(NOTE_GS, 3, 217),
    XCZ(NOTE_CS, 3, 217),
    XCZ(NOTE_DS, 5, 217),
    XCZ(NOTE_CS, 5, 217),
    XCZ(NOTE_GS, 3, 218),
    XCZ(NOTE_GS, 4, 217),
    XCZ(NOTE_DS, 5, 218),
    /* Events 337-352 */
    XCZ(NOTE_GS, 3, 217),
    XCZ(NOTE_CS, 5, 435),
    XCZ(NOTE_GS, 3, 217),
    XCZ(NOTE_CS, 3, 217),
    XCZ(NOTE_GS, 3, 217),
    XCZ(NOTE_GS, 4, 217),
    XCZ(NOTE_DS, 5, 217),
    XCZ(NOTE_CS, 5, 217),
    XCZ(NOTE_AS, 3, 217),
    XCZ(NOTE_GS, 4, 217),
    XCZ(NOTE_DS, 5, 290),
    XCZ(NOTE_FS, 5, 145),
    XCZ(NOTE_AS, 3, 145),
    XCZ(NOTE_DS, 5, 289),
    XCZ(NOTE_CS, 5, 217),
    XCZ(NOTE_B, 4, 217),
    /* Events 353-368 */
    XCZ(NOTE_GS, 3, 217),
    XCZ(NOTE_AS, 3, 217),
    XCZ(NOTE_B, 3, 435),
    XCZ(NOTE_B, 3, 217),
    XCZ(NOTE_FS, 3, 217),
    XCZ(NOTE_FS, 4, 434),
    XCZ(NOTE_GS, 4, 218),
    XCZ(NOTE_B, 3, 217),
    XCZ(NOTE_B, 4, 218),
    XCZ(NOTE_B, 3, 217),
    XCZ(NOTE_CS, 5, 217),
    XCZ(NOTE_E, 3, 217),
    XCZ(NOTE_CS, 5, 434),
    XCZ(NOTE_DS, 5, 218),
    XCZ(NOTE_B, 3, 217),
    XCZ(NOTE_B, 4, 218),
    /* Events 369-384 */
    XCZ(NOTE_B, 3, 217),
    XCZ(NOTE_GS, 4, 217),
    XCZ(NOTE_GS, 3, 217),
    XCZ(NOTE_AS, 4, 435),
    XCZ(NOTE_CS, 3, 217),
    XCZ(NOTE_FS, 3, 217),
    XCZ(NOTE_B, 4, 435),
    XCZ(NOTE_GS, 3, 217),
    XCZ(NOTE_GS, 3, 217),
    XCZ(NOTE_CS, 5, 435),
    XCZ(NOTE_AS, 3, 217),
    XCZ(NOTE_AS, 3, 217),
    XCZ(NOTE_FS, 3, 217),
    XCZ(NOTE_CS, 3, 217),
    XCZ(NOTE_FS, 4, 217),
    XCZ(NOTE_FS, 4, 217),
    /* Events 385-400 */
    XCZ(NOTE_CS, 5, 217),
    XCZ(NOTE_B, 4, 218),
    XCZ(NOTE_FS, 3, 217),
    XCZ(NOTE_FS, 4, 217),
    XCZ(NOTE_CS, 5, 217),
    XCZ(NOTE_B, 4, 217),
    XCZ(NOTE_FS, 3, 218),
    XCZ(NOTE_FS, 4, 217),
    XCZ(NOTE_CS, 5, 217),
    XCZ(NOTE_B, 4, 217),
    XCZ(NOTE_CS, 3, 217),
    XCZ(NOTE_FS, 3, 217),
    XCZ(NOTE_AS, 3, 217),
    XCZ(NOTE_B, 3, 217),
    XCZ(NOTE_CS, 3, 217),
    XCZ(NOTE_FS, 4, 217),
    /* Events 401-416 */
    XCZ(NOTE_CS, 5, 217),
    XCZ(NOTE_B, 4, 217),
    XCZ(NOTE_DS, 3, 218),
    XCZ(NOTE_FS, 4, 217),
    XCZ(NOTE_CS, 5, 217),
    XCZ(NOTE_B, 4, 218),
    XCZ(NOTE_DS, 3, 217),
    XCZ(NOTE_FS, 4, 217),
    XCZ(NOTE_CS, 5, 217),
    XCZ(NOTE_B, 4, 217),
    XCZ(NOTE_B, 3, 217),
    XCZ(NOTE_E, 3, 217),
    XCZ(NOTE_FS, 3, 217),
    XCZ(NOTE_B, 3, 217),
    XCZ(NOTE_E, 3, 217),
    XCZ(NOTE_FS, 4, 217),
    /* Events 417-432 */
    XCZ(NOTE_E, 5, 217),
    XCZ(NOTE_DS, 5, 217),
    XCZ(NOTE_FS, 3, 217),
    XCZ(NOTE_DS, 5, 217),
    XCZ(NOTE_FS, 4, 290),
    XCZ(NOTE_CS, 5, 145),
    XCZ(NOTE_FS, 3, 145),
    XCZ(NOTE_CS, 5, 290),
    XCZ(NOTE_FS, 4, 435),
    XCZ(NOTE_B, 4, 217),
    XCZ(NOTE_FS, 4, 217),
    XCZ(NOTE_B, 4, 218),
    XCZ(NOTE_AS, 4, 217),
    XCZ(NOTE_CS, 3, 217),
    XCZ(NOTE_B, 4, 217),
    XCZ(NOTE_FS, 4, 217),
    /* Events 433-448 */
    XCZ(NOTE_E, 5, 218),
    XCZ(NOTE_B, 3, 217),
    XCZ(NOTE_E, 3, 217),
    XCZ(NOTE_FS, 5, 218),
    XCZ(NOTE_E, 3, 217),
    XCZ(NOTE_B, 5, 435),
    XCZ(NOTE_AS, 5, 217),
    XCZ(NOTE_B, 5, 217),
    XCZ(NOTE_FS, 5, 217),
    XCZ(NOTE_CS, 5, 217),
    XCZ(NOTE_B, 3, 217),
    XCZ(NOTE_B, 4, 217),
    XCZ(NOTE_AS, 4, 217),
    XCZ(NOTE_B, 4, 217),
    XCZ(NOTE_E, 5, 435),
    XCZ(NOTE_GS, 3, 217),
    /* Events 449-464 */
    XCZ(NOTE_CS, 3, 217),
    XCZ(NOTE_E, 3, 217),
    XCZ(NOTE_FS, 3, 217),
    XCZ(NOTE_GS, 4, 435),
    XCZ(NOTE_AS, 4, 218),
    XCZ(NOTE_CS, 3, 217),
    XCZ(NOTE_FS, 3, 217),
    XCZ(NOTE_GS, 3, 217),
    XCZ(NOTE_AS, 3, 217),
    XCZ(NOTE_CS, 3, 218),
    XCZ(NOTE_B, 4, 217),
    XCZ(NOTE_CS, 5, 217),
    XCZ(NOTE_GS, 5, 435),
    XCZ(NOTE_AS, 3, 217),
    XCZ(NOTE_DS, 3, 217),
    XCZ(NOTE_AS, 4, 217),
    /* Events 465-480 */
    XCZ(NOTE_DS, 5, 218),
    XCZ(NOTE_AS, 3, 217),
    XCZ(NOTE_CS, 5, 217),
    XCZ(NOTE_B, 4, 217),
    XCZ(NOTE_DS, 3, 217),
    XCZ(NOTE_GS, 3, 217),
    XCZ(NOTE_AS, 3, 217),
    XCZ(NOTE_B, 3, 435),
    XCZ(NOTE_B, 3, 217),
    XCZ(NOTE_FS, 3, 217),
    XCZ(NOTE_GS, 4, 434),
    XCZ(NOTE_AS, 4, 218),
    XCZ(NOTE_B, 3, 217),
    XCZ(NOTE_AS, 4, 218),
    XCZ(NOTE_B, 3, 217),
    XCZ(NOTE_B, 4, 217),
    /* Events 481-496 */
    XCZ(NOTE_E, 3, 217),
    XCZ(NOTE_B, 4, 435),
    XCZ(NOTE_CS, 5, 217),
    XCZ(NOTE_B, 3, 217),
    XCZ(NOTE_DS, 5, 218),
    XCZ(NOTE_DS, 3, 217),
    XCZ(NOTE_B, 3, 218),
    XCZ(NOTE_CS, 5, 217),
    XCZ(NOTE_E, 5, 435),
    XCZ(NOTE_CS, 3, 217),
    XCZ(NOTE_B, 4, 217),
    XCZ(NOTE_FS, 4, 218),
    XCZ(NOTE_FS, 3, 217),
    XCZ(NOTE_CS, 3, 435),
    XCZ(NOTE_E, 3, 870),
    XCZ(NOTE_DS, 5, 652),
    /* Events 497-512 */
    XCZ(NOTE_B, 4, 217),
    XCZ(NOTE_FS, 4, 435),
    XCZ(NOTE_B, 3, 217),
    XCZ(NOTE_FS, 3, 217),
    XCZ(NOTE_CS, 4, 217),
    XCZ(NOTE_B, 3, 217),
    XCZ(NOTE_CS, 4, 217),
    XCZ(NOTE_DS, 4, 217),
    XCZ(NOTE_E, 4, 217),
    XCZ(NOTE_DS, 4, 217),
    XCZ(NOTE_E, 4, 217),
    XCZ(NOTE_FS, 4, 217),
    XCZ(NOTE_GS, 4, 217),
    XCZ(NOTE_FS, 4, 217),
    XCZ(NOTE_GS, 4, 217),
    XCZ(NOTE_AS, 4, 217),
    /* Events 513-528 */
    XCZ(NOTE_B, 4, 217),
    XCZ(NOTE_AS, 4, 217),
    XCZ(NOTE_B, 4, 217),
    XCZ(NOTE_CS, 5, 217),
    XCZ(NOTE_DS, 5, 217),
    XCZ(NOTE_CS, 5, 217),
    XCZ(NOTE_DS, 5, 217),
    XCZ(NOTE_E, 5, 217),
    XCZ(NOTE_FS, 5, 217),
    XCZ(NOTE_E, 5, 217),
    XCZ(NOTE_FS, 5, 217),
    XCZ(NOTE_AS, 5, 217),
    XCZ(NOTE_B, 5, 217),
    XCZ(NOTE_FS, 5, 217),
    XCZ(NOTE_CS, 5, 217),
    XCZ(NOTE_B, 4, 217),
    /* Events 529-544 */
    XCZ(NOTE_B, 5, 434),
    XCZ(NOTE_AS, 5, 217),
    XCZ(NOTE_CS, 5, 217),
    XCZ(NOTE_AS, 5, 218),
    XCZ(NOTE_FS, 3, 217),
    XCZ(NOTE_GS, 5, 217),
    XCZ(NOTE_B, 4, 217),
    XCZ(NOTE_GS, 5, 435),
    XCZ(NOTE_FS, 5, 217),
    XCZ(NOTE_CS, 5, 217),
    XCZ(NOTE_AS, 3, 218),
    XCZ(NOTE_FS, 3, 217),
    XCZ(NOTE_CS, 3, 217),
    XCZ(NOTE_AS, 3, 217),
    XCZ(NOTE_GS, 5, 435),
    XCZ(NOTE_FS, 5, 217),
    /* Events 545-560 */
    XCZ(NOTE_CS, 5, 217),
    XCZ(NOTE_FS, 5, 217),
    XCZ(NOTE_FS, 3, 217),
    XCZ(NOTE_DS, 5, 217),
    XCZ(NOTE_FS, 4, 217),
    XCZ(NOTE_DS, 5, 435),
    XCZ(NOTE_CS, 5, 217),
    XCZ(NOTE_GS, 4, 217),
    XCZ(NOTE_GS, 3, 217),
    XCZ(NOTE_B, 3, 217),
    XCZ(NOTE_CS, 3, 217),
    XCZ(NOTE_DS, 3, 217),
    XCZ(NOTE_GS, 4, 435),
    XCZ(NOTE_B, 3, 217),
    XCZ(NOTE_E, 3, 217),
    XCZ(NOTE_GS, 4, 290),
    /* Events 561-576 */
    XCZ(NOTE_AS, 4, 145),
    XCZ(NOTE_E, 3, 144),
    XCZ(NOTE_B, 4, 290),
    XCZ(NOTE_FS, 5, 435),
    XCZ(NOTE_CS, 3, 217),
    XCZ(NOTE_FS, 3, 217),
    XCZ(NOTE_CS, 5, 217),
    XCZ(NOTE_FS, 3, 217),
    XCZ(NOTE_CS, 3, 434),
    XCZ(NOTE_B, 4, 435),
    XCZ(NOTE_CS, 5, 218),
    XCZ(NOTE_FS, 3, 217),
    XCZ(NOTE_CS, 5, 217),
    XCZ(NOTE_B, 3, 218),
    XCZ(NOTE_DS, 5, 217),
    XCZ(NOTE_B, 3, 217),
    /* Events 577-592 */
    XCZ(NOTE_DS, 5, 434),
    XCZ(NOTE_E, 5, 218),
    XCZ(NOTE_FS, 3, 217),
    XCZ(NOTE_FS, 5, 218),
    XCZ(NOTE_DS, 3, 217),
    XCZ(NOTE_FS, 3, 217),
    XCZ(NOTE_FS, 3, 217),
    XCZ(NOTE_B, 5, 435),
    XCZ(NOTE_AS, 5, 217),
    XCZ(NOTE_CS, 5, 217),
    XCZ(NOTE_AS, 5, 218),
    XCZ(NOTE_FS, 3, 217),
    XCZ(NOTE_GS, 5, 217),
    XCZ(NOTE_B, 4, 217),
    XCZ(NOTE_GS, 5, 435),
    XCZ(NOTE_FS, 5, 217),
    /* Events 593-608 */
    XCZ(NOTE_CS, 5, 217),
    XCZ(NOTE_AS, 3, 218),
    XCZ(NOTE_FS, 3, 217),
    XCZ(NOTE_CS, 3, 217),
    XCZ(NOTE_AS, 3, 217),
    XCZ(NOTE_GS, 5, 435),
    XCZ(NOTE_FS, 5, 217),
    XCZ(NOTE_CS, 5, 217),
    XCZ(NOTE_FS, 5, 217),
    XCZ(NOTE_FS, 3, 217),
    XCZ(NOTE_AS, 4, 217),
    XCZ(NOTE_CS, 5, 217),
    XCZ(NOTE_FS, 4, 435),
    XCZ(NOTE_DS, 5, 217),
    XCZ(NOTE_CS, 5, 217),
    XCZ(NOTE_FS, 4, 217),
    /* Events 609-624 */
    XCZ(NOTE_B, 4, 217),
    XCZ(NOTE_GS, 3, 217),
    XCZ(NOTE_GS, 3, 217),
    XCZ(NOTE_GS, 4, 435),
    XCZ(NOTE_B, 3, 217),
    XCZ(NOTE_E, 3, 217),
    XCZ(NOTE_GS, 4, 290),
    XCZ(NOTE_AS, 4, 145),
    XCZ(NOTE_E, 3, 145),
    XCZ(NOTE_B, 4, 289),
    XCZ(NOTE_E, 5, 435),
    XCZ(NOTE_CS, 3, 217),
    XCZ(NOTE_FS, 3, 217),
    XCZ(NOTE_AS, 3, 217),
    XCZ(NOTE_DS, 5, 218),
    XCZ(NOTE_CS, 3, 435),
    /* Events 625-640 */
    XCZ(NOTE_B, 4, 434),
    XCZ(NOTE_FS, 3, 217),
    XCZ(NOTE_B, 3, 217),
    XCZ(NOTE_E, 4, 435),
    XCZ(NOTE_FS, 4, 435),
    XCZ(NOTE_DS, 4, 434),
    XCZ(NOTE_FS, 3, 435),
    XCZ(NOTE_B, 3, 870),
    XCZ(NOTE_E, 4, 435),
    XCZ(NOTE_B, 3, 217),
    XCZ(NOTE_E, 3, 217),
    XCZ(NOTE_DS, 5, 435),
    XCZ(NOTE_E, 3, 218),
    XCZ(NOTE_CS, 5, 217),
    XCZ(NOTE_B, 4, 870),
    XCZ_R(434),
    /* Events 641-656 */
    XCZ(NOTE_FS, 4, 217),
    XCZ(NOTE_FS, 4, 217),
    XCZ(NOTE_CS, 5, 217),
    XCZ(NOTE_B, 4, 218),
    XCZ(NOTE_FS, 3, 217),
    XCZ(NOTE_FS, 4, 217),
    XCZ(NOTE_CS, 5, 217),
    XCZ(NOTE_B, 4, 217),
    XCZ(NOTE_FS, 3, 435),
    XCZ(NOTE_CS, 5, 217),
    XCZ(NOTE_B, 4, 217),
    XCZ(NOTE_CS, 3, 217),
    XCZ(NOTE_FS, 3, 217),
    XCZ(NOTE_AS, 3, 217),
    XCZ(NOTE_B, 3, 217),
    XCZ(NOTE_CS, 3, 217),
    /* Events 657-672 */
    XCZ(NOTE_FS, 4, 217),
    XCZ(NOTE_CS, 5, 217),
    XCZ(NOTE_B, 4, 217),
    XCZ(NOTE_DS, 3, 217),
    XCZ(NOTE_FS, 4, 217),
    XCZ(NOTE_CS, 5, 217),
    XCZ(NOTE_B, 4, 218),
    XCZ(NOTE_DS, 3, 217),
    XCZ(NOTE_FS, 4, 217),
    XCZ(NOTE_CS, 5, 217),
    XCZ(NOTE_B, 4, 217),
    XCZ(NOTE_B, 3, 217),
    XCZ(NOTE_E, 3, 217),
    XCZ(NOTE_FS, 3, 217),
    XCZ(NOTE_B, 3, 217),
    XCZ(NOTE_E, 3, 217),
    /* Events 673-688 */
    XCZ(NOTE_FS, 4, 217),
    XCZ(NOTE_E, 5, 217),
    XCZ(NOTE_DS, 5, 217),
    XCZ(NOTE_FS, 3, 217),
    XCZ(NOTE_DS, 5, 217),
    XCZ(NOTE_FS, 4, 290),
    XCZ(NOTE_CS, 5, 145),
    XCZ(NOTE_FS, 3, 145),
    XCZ(NOTE_CS, 5, 290),
    XCZ(NOTE_FS, 4, 434),
    XCZ(NOTE_B, 4, 217),
    XCZ(NOTE_FS, 3, 217),
    XCZ(NOTE_B, 4, 218),
    XCZ(NOTE_FS, 3, 217),
    XCZ(NOTE_AS, 4, 217),
    XCZ(NOTE_AS, 4, 217),
    /* Events 689-704 */
    XCZ(NOTE_DS, 4, 217),
    XCZ(NOTE_GS, 4, 218),
    XCZ(NOTE_B, 3, 217),
    XCZ(NOTE_E, 3, 217),
    XCZ(NOTE_E, 5, 217),
    XCZ(NOTE_FS, 5, 217),
    XCZ(NOTE_CS, 6, 217),
    XCZ(NOTE_B, 5, 217),
    XCZ(NOTE_E, 3, 217),
    XCZ(NOTE_B, 3, 217),
    XCZ(NOTE_B, 5, 217),
    XCZ(NOTE_AS, 5, 217),
    XCZ(NOTE_B, 3, 217),
    XCZ(NOTE_E, 3, 217),
    XCZ(NOTE_GS, 4, 435),
    XCZ(NOTE_DS, 5, 217),
    /* Events 705-720 */
    XCZ(NOTE_CS, 5, 218),
    XCZ(NOTE_GS, 3, 217),
    XCZ(NOTE_GS, 4, 217),
    XCZ(NOTE_DS, 5, 217),
    XCZ(NOTE_CS, 5, 217),
    XCZ(NOTE_GS, 3, 218),
    XCZ(NOTE_GS, 4, 217),
    XCZ(NOTE_DS, 5, 218),
    XCZ(NOTE_GS, 3, 217),
    XCZ(NOTE_CS, 5, 435),
    XCZ(NOTE_GS, 3, 217),
    XCZ(NOTE_CS, 3, 217),
    XCZ(NOTE_GS, 3, 217),
    XCZ(NOTE_FS, 4, 217),
    XCZ(NOTE_DS, 5, 217),
    XCZ(NOTE_CS, 5, 217),
    /* Events 721-736 */
    XCZ(NOTE_AS, 3, 217),
    XCZ(NOTE_GS, 4, 217),
    XCZ(NOTE_DS, 5, 290),
    XCZ(NOTE_FS, 5, 145),
    XCZ(NOTE_AS, 3, 145),
    XCZ(NOTE_DS, 5, 289),
    XCZ(NOTE_CS, 5, 217),
    XCZ(NOTE_B, 4, 217),
    XCZ(NOTE_GS, 3, 217),
    XCZ(NOTE_AS, 3, 217),
    XCZ(NOTE_B, 3, 435),
    XCZ(NOTE_B, 3, 217),
    XCZ(NOTE_FS, 3, 217),
    XCZ(NOTE_FS, 4, 434),
    XCZ(NOTE_GS, 4, 218),
    XCZ(NOTE_B, 3, 217),
    /* Events 737-752 */
    XCZ(NOTE_B, 4, 218),
    XCZ(NOTE_B, 3, 217),
    XCZ(NOTE_CS, 5, 217),
    XCZ(NOTE_E, 3, 217),
    XCZ(NOTE_CS, 5, 435),
    XCZ(NOTE_DS, 5, 217),
    XCZ(NOTE_B, 3, 217),
    XCZ(NOTE_B, 4, 218),
    XCZ(NOTE_B, 3, 217),
    XCZ(NOTE_GS, 4, 217),
    XCZ(NOTE_GS, 3, 217),
    XCZ(NOTE_FS, 5, 435),
    XCZ(NOTE_CS, 3, 217),
    XCZ(NOTE_DS, 5, 217),
    XCZ(NOTE_FS, 5, 435),
    XCZ(NOTE_GS, 3, 217),
    /* Events 753-768 */
    XCZ(NOTE_DS, 5, 217),
    XCZ(NOTE_FS, 5, 435),
    XCZ(NOTE_AS, 3, 217),
    XCZ(NOTE_AS, 3, 217),
    XCZ(NOTE_FS, 3, 217),
    XCZ(NOTE_CS, 3, 217),
    XCZ(NOTE_FS, 5, 217),
    XCZ(NOTE_FS, 5, 217),
    XCZ(NOTE_CS, 5, 217),
    XCZ(NOTE_B, 4, 217),
    XCZ(NOTE_FS, 3, 217),
    XCZ(NOTE_FS, 4, 217),
    XCZ(NOTE_CS, 5, 217),
    XCZ(NOTE_B, 4, 217),
    XCZ(NOTE_FS, 3, 218),
    XCZ(NOTE_FS, 4, 217),
    /* Events 769-784 */
    XCZ(NOTE_CS, 5, 217),
    XCZ(NOTE_B, 4, 217),
    XCZ(NOTE_CS, 3, 217),
    XCZ(NOTE_FS, 3, 217),
    XCZ(NOTE_AS, 3, 217),
    XCZ(NOTE_B, 3, 217),
    XCZ(NOTE_CS, 3, 217),
    XCZ(NOTE_FS, 4, 217),
    XCZ(NOTE_CS, 5, 217),
    XCZ(NOTE_B, 4, 217),
    XCZ(NOTE_DS, 3, 218),
    XCZ(NOTE_FS, 4, 217),
    XCZ(NOTE_CS, 5, 217),
    XCZ(NOTE_B, 4, 218),
    XCZ(NOTE_DS, 3, 217),
    XCZ(NOTE_FS, 4, 217),
    /* Events 785-800 */
    XCZ(NOTE_CS, 5, 217),
    XCZ(NOTE_B, 4, 217),
    XCZ(NOTE_B, 3, 217),
    XCZ(NOTE_E, 3, 217),
    XCZ(NOTE_FS, 3, 217),
    XCZ(NOTE_B, 3, 217),
    XCZ(NOTE_E, 3, 217),
    XCZ(NOTE_FS, 4, 217),
    XCZ(NOTE_E, 5, 217),
    XCZ(NOTE_DS, 5, 217),
    XCZ(NOTE_FS, 3, 217),
    XCZ(NOTE_DS, 5, 217),
    XCZ(NOTE_FS, 4, 290),
    XCZ(NOTE_CS, 5, 145),
    XCZ(NOTE_FS, 3, 145),
    XCZ(NOTE_CS, 5, 290),
    /* Events 801-816 */
    XCZ(NOTE_FS, 4, 435),
    XCZ(NOTE_B, 4, 217),
    XCZ(NOTE_FS, 4, 217),
    XCZ(NOTE_B, 4, 218),
    XCZ(NOTE_AS, 4, 217),
    XCZ(NOTE_CS, 3, 218),
    XCZ(NOTE_B, 4, 217),
    XCZ(NOTE_FS, 4, 217),
    XCZ(NOTE_E, 5, 218),
    XCZ(NOTE_B, 3, 217),
    XCZ(NOTE_E, 3, 217),
    XCZ(NOTE_FS, 5, 218),
    XCZ(NOTE_E, 3, 217),
    XCZ(NOTE_B, 5, 435),
    XCZ(NOTE_AS, 5, 217),
    XCZ(NOTE_B, 5, 217),
    /* Events 817-832 */
    XCZ(NOTE_FS, 5, 217),
    XCZ(NOTE_CS, 5, 217),
    XCZ(NOTE_B, 3, 217),
    XCZ(NOTE_B, 4, 217),
    XCZ(NOTE_AS, 4, 217),
    XCZ(NOTE_B, 4, 217),
    XCZ(NOTE_E, 5, 435),
    XCZ(NOTE_GS, 3, 217),
    XCZ(NOTE_CS, 3, 217),
    XCZ(NOTE_E, 3, 217),
    XCZ(NOTE_FS, 3, 217),
    XCZ(NOTE_GS, 4, 434),
    XCZ(NOTE_B, 4, 217),
    XCZ(NOTE_AS, 4, 217),
    XCZ(NOTE_FS, 3, 217),
    XCZ(NOTE_GS, 3, 217),
    /* Events 833-848 */
    XCZ(NOTE_AS, 3, 217),
    XCZ(NOTE_AS, 4, 217),
    XCZ(NOTE_B, 4, 217),
    XCZ(NOTE_CS, 5, 217),
    XCZ(NOTE_GS, 5, 435),
    XCZ(NOTE_AS, 3, 217),
    XCZ(NOTE_DS, 3, 217),
    XCZ(NOTE_AS, 4, 217),
    XCZ(NOTE_GS, 5, 218),
    XCZ(NOTE_AS, 3, 435),
    XCZ(NOTE_AS, 5, 217),
    XCZ(NOTE_GS, 5, 217),
    XCZ(NOTE_GS, 3, 217),
    XCZ(NOTE_AS, 3, 217),
    XCZ(NOTE_B, 3, 435),
    XCZ(NOTE_B, 3, 217),
    /* Events 849-864 */
    XCZ(NOTE_FS, 3, 217),
    XCZ(NOTE_GS, 5, 434),
    XCZ(NOTE_DS, 5, 218),
    XCZ(NOTE_B, 3, 217),
    XCZ(NOTE_CS, 5, 218),
    XCZ(NOTE_B, 3, 217),
    XCZ(NOTE_B, 4, 217),
    XCZ(NOTE_E, 3, 217),
    XCZ(NOTE_B, 4, 435),
    XCZ(NOTE_CS, 5, 217),
    XCZ(NOTE_B, 3, 217),
    XCZ(NOTE_DS, 5, 218),
    XCZ(NOTE_DS, 3, 217),
    XCZ(NOTE_B, 3, 218),
    XCZ(NOTE_CS, 5, 217),
    XCZ(NOTE_E, 5, 435),
    /* Events 865-880 */
    XCZ(NOTE_CS, 3, 217),
    XCZ(NOTE_FS, 3, 217),
    XCZ(NOTE_AS, 3, 217),
    XCZ(NOTE_FS, 3, 217),
    XCZ(NOTE_CS, 3, 217),
    XCZ(NOTE_FS, 3, 217),
    XCZ(NOTE_CS, 4, 217),
    XCZ(NOTE_AS, 3, 217),
    XCZ(NOTE_FS, 3, 217),
    XCZ(NOTE_AS, 3, 217),
    XCZ(NOTE_E, 4, 217),
    XCZ(NOTE_AS, 3, 217),
    XCZ(NOTE_CS, 3, 217),
    XCZ(NOTE_FS, 3, 217),
    XCZ(NOTE_FS, 4, 218),
    XCZ(NOTE_AS, 3, 217),
    /* Events 881-896 */
    XCZ(NOTE_FS, 3, 217),
    XCZ(NOTE_AS, 3, 217),
    XCZ(NOTE_AS, 5, 870),
    XCZ_R(869),
    XCZ(NOTE_DS, 5, 652),
    XCZ(NOTE_B, 4, 217),
    XCZ(NOTE_FS, 4, 435),
    XCZ(NOTE_FS, 3, 217),
    XCZ(NOTE_B, 4, 217),
    XCZ(NOTE_DS, 5, 217),
    XCZ(NOTE_E, 5, 217),
    XCZ(NOTE_DS, 5, 217),
    XCZ(NOTE_B, 4, 217),
    XCZ(NOTE_FS, 3, 434),
    XCZ(NOTE_CS, 3, 218),
    XCZ(NOTE_B, 4, 217),
    /* Events 897-912 */
    XCZ(NOTE_DS, 5, 217),
    XCZ(NOTE_E, 5, 217),
    XCZ(NOTE_DS, 5, 217),
    XCZ(NOTE_B, 4, 217),
    XCZ(NOTE_GS, 3, 435),
    XCZ(NOTE_DS, 3, 434),
    XCZ(NOTE_GS, 3, 435),
    XCZ(NOTE_FS, 5, 435),
    XCZ(NOTE_B, 4, 435),
    XCZ(NOTE_B, 3, 434),
    XCZ(NOTE_DS, 5, 652),
    XCZ(NOTE_B, 4, 217),
    XCZ(NOTE_DS, 4, 435),
    XCZ(NOTE_FS, 3, 217),
    XCZ(NOTE_B, 3, 217),
    XCZ(NOTE_DS, 4, 217),
    /* Events 913-928 */
    XCZ(NOTE_E, 4, 217),
    XCZ(NOTE_DS, 4, 217),
    XCZ(NOTE_B, 3, 217),
    XCZ(NOTE_FS, 3, 435),
    XCZ(NOTE_CS, 3, 217),
    XCZ(NOTE_FS, 3, 217),
    XCZ(NOTE_DS, 4, 217),
    XCZ(NOTE_E, 4, 217),
    XCZ(NOTE_DS, 4, 217),
    XCZ(NOTE_B, 3, 217),
    XCZ(NOTE_E, 4, 435),
    XCZ(NOTE_FS, 4, 435),
    XCZ(NOTE_E, 4, 435),
    XCZ(NOTE_FS, 3, 434),
    XCZ(NOTE_E, 4, 435),
    XCZ(NOTE_E, 3, 435),
    /* Events 929-935 */
    XCZ(NOTE_E, 4, 435),
    XCZ(NOTE_FS, 3, 435),
    XCZ(NOTE_E, 4, 434),
    XCZ(NOTE_E, 3, 435),
    XCZ(NOTE_E, 4, 870),
    XCZ(NOTE_DS, 4, 1739),
    XCZ(NOTE_FS, 3, 3478)
};

#undef XCZ_R
#undef XCZ
