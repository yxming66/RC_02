/*
 * Carlos Gardel - Por Una Cabeza / Yi Bu Zhi Yao.
 * Single-line PWM buzzer reduction generated from local PDF / PiaStudy 1hLQ5VKCCVF MIDI.
 * The right-hand line is preferred at simultaneous onsets; bass notes
 * are folded by octaves into the practical buzzer range.
 * 389 events, about 118 seconds.
 */
#define FD(note, octave, ms) {note, octave, (uint16_t)(ms)}
#define FD_R(ms) {NOTE_REST, 0, (uint16_t)(ms)}

const Tone_t YI_BU_ZHI_YAO[] = {
    /* Events 1-16 */
    FD_R(909),
    FD(NOTE_B, 4, 227),
    FD(NOTE_C, 5, 227),
    FD(NOTE_CS, 5, 227),
    FD(NOTE_D, 5, 227),
    FD(NOTE_E, 5, 227),
    FD(NOTE_D, 5, 227),
    FD(NOTE_D, 4, 455),
    FD(NOTE_CS, 5, 227),
    FD(NOTE_D, 5, 227),
    FD(NOTE_E, 5, 227),
    FD(NOTE_FS, 5, 227),
    FD(NOTE_A, 5, 227),
    FD(NOTE_G, 5, 227),
    FD(NOTE_D, 4, 455),
    FD(NOTE_B, 5, 227),
    /* Events 17-32 */
    FD(NOTE_C, 6, 227),
    FD(NOTE_A, 5, 227),
    FD(NOTE_B, 5, 227),
    FD(NOTE_G, 5, 227),
    FD(NOTE_A, 5, 227),
    FD(NOTE_FS, 5, 227),
    FD(NOTE_G, 5, 227),
    FD(NOTE_FS, 5, 455),
    FD(NOTE_GS, 3, 227),
    FD(NOTE_D, 5, 227),
    FD(NOTE_C, 5, 455),
    FD(NOTE_E, 4, 455),
    FD(NOTE_C, 6, 227),
    FD(NOTE_B, 5, 227),
    FD(NOTE_D, 6, 227),
    FD(NOTE_C, 6, 227),
    /* Events 33-48 */
    FD(NOTE_A, 5, 455),
    FD(NOTE_E, 4, 455),
    FD(NOTE_A, 5, 227),
    FD(NOTE_GS, 5, 227),
    FD(NOTE_B, 5, 227),
    FD(NOTE_A, 5, 227),
    FD(NOTE_FS, 5, 455),
    FD(NOTE_FS, 4, 455),
    FD(NOTE_FS, 5, 227),
    FD(NOTE_G, 5, 227),
    FD(NOTE_GS, 5, 227),
    FD(NOTE_A, 5, 227),
    FD(NOTE_B, 5, 227),
    FD(NOTE_A, 5, 227),
    FD(NOTE_FS, 5, 227),
    FD(NOTE_D, 5, 227),
    /* Events 49-64 */
    FD(NOTE_DS, 5, 227),
    FD(NOTE_FS, 5, 227),
    FD(NOTE_E, 5, 227),
    FD(NOTE_C, 5, 227),
    FD(NOTE_B, 4, 455),
    FD(NOTE_D, 4, 455),
    FD(NOTE_B, 4, 227),
    FD(NOTE_C, 5, 227),
    FD(NOTE_CS, 5, 227),
    FD(NOTE_D, 5, 227),
    FD(NOTE_E, 5, 227),
    FD(NOTE_D, 5, 227),
    FD(NOTE_D, 4, 455),
    FD(NOTE_CS, 5, 227),
    FD(NOTE_D, 5, 227),
    FD(NOTE_E, 5, 227),
    /* Events 65-80 */
    FD(NOTE_FS, 5, 227),
    FD(NOTE_A, 5, 227),
    FD(NOTE_G, 5, 227),
    FD(NOTE_D, 4, 455),
    FD(NOTE_G, 5, 227),
    FD(NOTE_A, 5, 227),
    FD(NOTE_B, 5, 227),
    FD(NOTE_G, 5, 227),
    FD(NOTE_A, 5, 227),
    FD(NOTE_G, 5, 227),
    FD(NOTE_A, 5, 227),
    FD(NOTE_B, 5, 227),
    FD(NOTE_A, 5, 455),
    FD(NOTE_F, 4, 227),
    FD(NOTE_G, 5, 227),
    FD(NOTE_E, 6, 455),
    /* Events 81-96 */
    FD(NOTE_E, 4, 455),
    FD(NOTE_A, 5, 227),
    FD(NOTE_G, 5, 227),
    FD(NOTE_E, 5, 227),
    FD(NOTE_C, 5, 227),
    FD(NOTE_B, 4, 227),
    FD(NOTE_A, 4, 227),
    FD(NOTE_B, 4, 227),
    FD(NOTE_C, 5, 227),
    FD(NOTE_DS, 5, 227),
    FD(NOTE_G, 5, 227),
    FD(NOTE_C, 3, 227),
    FD(NOTE_F, 5, 114),
    FD(NOTE_DS, 5, 114),
    FD(NOTE_G, 5, 455),
    FD(NOTE_D, 5, 455),
    /* Events 97-112 */
    FD(NOTE_G, 5, 227),
    FD(NOTE_A, 5, 227),
    FD(NOTE_B, 5, 227),
    FD(NOTE_G, 5, 227),
    FD(NOTE_A, 5, 910),
    FD(NOTE_FS, 5, 227),
    FD(NOTE_G, 5, 227),
    FD(NOTE_A, 5, 227),
    FD(NOTE_FS, 5, 227),
    FD(NOTE_G, 5, 682),
    FD(NOTE_D, 4, 227),
    FD(NOTE_G, 4, 455),
    FD(NOTE_D, 4, 455),
    FD(NOTE_AS, 3, 455),
    FD(NOTE_AS, 5, 227),
    FD(NOTE_D, 3, 227),
    /* Events 113-128 */
    FD(NOTE_AS, 5, 303),
    FD(NOTE_C, 6, 152),
    FD(NOTE_D, 3, 152),
    FD(NOTE_D, 6, 985),
    FD(NOTE_D, 3, 227),
    FD(NOTE_A, 5, 455),
    FD(NOTE_D, 3, 455),
    FD(NOTE_DS, 3, 455),
    FD(NOTE_G, 5, 227),
    FD(NOTE_AS, 3, 227),
    FD(NOTE_G, 5, 303),
    FD(NOTE_A, 5, 152),
    FD(NOTE_AS, 3, 152),
    FD(NOTE_AS, 5, 985),
    FD(NOTE_AS, 3, 227),
    FD(NOTE_F, 5, 455),
    /* Events 129-144 */
    FD(NOTE_AS, 3, 455),
    FD(NOTE_C, 3, 455),
    FD(NOTE_DS, 5, 227),
    FD(NOTE_G, 3, 227),
    FD(NOTE_DS, 5, 303),
    FD(NOTE_F, 5, 152),
    FD(NOTE_G, 3, 152),
    FD(NOTE_G, 5, 985),
    FD(NOTE_G, 3, 227),
    FD(NOTE_G, 5, 227),
    FD(NOTE_A, 5, 227),
    FD(NOTE_AS, 5, 227),
    FD(NOTE_G, 5, 227),
    FD(NOTE_A, 5, 682),
    FD(NOTE_E, 3, 227),
    FD(NOTE_G, 5, 227),
    /* Events 145-160 */
    FD(NOTE_A, 5, 227),
    FD(NOTE_AS, 5, 227),
    FD(NOTE_G, 5, 227),
    FD(NOTE_AS, 5, 455),
    FD(NOTE_DS, 3, 455),
    FD(NOTE_A, 5, 455),
    FD(NOTE_D, 3, 455),
    FD(NOTE_G, 3, 455),
    FD(NOTE_AS, 5, 227),
    FD(NOTE_D, 3, 227),
    FD(NOTE_AS, 5, 303),
    FD(NOTE_C, 6, 152),
    FD(NOTE_D, 3, 152),
    FD(NOTE_D, 6, 985),
    FD(NOTE_D, 3, 227),
    FD(NOTE_A, 5, 455),
    /* Events 161-176 */
    FD(NOTE_D, 3, 455),
    FD(NOTE_DS, 3, 455),
    FD(NOTE_G, 5, 227),
    FD(NOTE_AS, 3, 227),
    FD(NOTE_G, 5, 303),
    FD(NOTE_A, 5, 152),
    FD(NOTE_AS, 3, 152),
    FD(NOTE_AS, 5, 985),
    FD(NOTE_AS, 3, 227),
    FD(NOTE_F, 5, 455),
    FD(NOTE_AS, 3, 455),
    FD(NOTE_C, 3, 455),
    FD(NOTE_DS, 5, 227),
    FD(NOTE_G, 3, 227),
    FD(NOTE_DS, 5, 303),
    FD(NOTE_F, 5, 152),
    /* Events 177-192 */
    FD(NOTE_G, 3, 152),
    FD(NOTE_G, 5, 985),
    FD(NOTE_G, 3, 227),
    FD(NOTE_G, 5, 227),
    FD(NOTE_A, 5, 227),
    FD(NOTE_AS, 5, 227),
    FD(NOTE_G, 5, 227),
    FD(NOTE_A, 5, 910),
    FD(NOTE_FS, 5, 227),
    FD(NOTE_G, 5, 227),
    FD(NOTE_A, 5, 227),
    FD(NOTE_FS, 5, 227),
    FD(NOTE_G, 5, 682),
    FD(NOTE_D, 3, 227),
    FD(NOTE_G, 5, 227),
    FD(NOTE_FS, 5, 227),
    /* Events 193-208 */
    FD(NOTE_E, 5, 227),
    FD(NOTE_D, 5, 227),
    FD(NOTE_B, 4, 455),
    FD_R(227),
    FD(NOTE_D, 3, 227),
    FD(NOTE_E, 5, 227),
    FD(NOTE_D, 5, 227),
    FD(NOTE_B, 4, 227),
    FD(NOTE_G, 4, 227),
    FD(NOTE_D, 4, 455),
    FD_R(227),
    FD(NOTE_D, 3, 227),
    FD(NOTE_D, 5, 227),
    FD(NOTE_E, 5, 227),
    FD(NOTE_FS, 5, 227),
    FD(NOTE_G, 5, 227),
    /* Events 209-224 */
    FD(NOTE_B, 5, 227),
    FD(NOTE_FS, 5, 455),
    FD(NOTE_A, 5, 114),
    FD(NOTE_G, 5, 114),
    FD(NOTE_D, 5, 455),
    FD(NOTE_D, 3, 227),
    FD(NOTE_B, 4, 227),
    FD(NOTE_C, 5, 455),
    FD_R(227),
    FD(NOTE_E, 3, 227),
    FD(NOTE_C, 6, 227),
    FD(NOTE_B, 5, 227),
    FD(NOTE_E, 3, 227),
    FD(NOTE_D, 6, 114),
    FD(NOTE_C, 6, 114),
    FD(NOTE_A, 5, 455),
    /* Events 225-240 */
    FD_R(227),
    FD(NOTE_E, 3, 227),
    FD(NOTE_A, 5, 227),
    FD(NOTE_GS, 5, 227),
    FD(NOTE_DS, 3, 227),
    FD(NOTE_B, 5, 114),
    FD(NOTE_A, 5, 114),
    FD(NOTE_FS, 5, 455),
    FD_R(227),
    FD(NOTE_A, 3, 227),
    FD(NOTE_FS, 5, 227),
    FD(NOTE_G, 5, 227),
    FD(NOTE_GS, 5, 227),
    FD(NOTE_A, 5, 227),
    FD(NOTE_B, 5, 227),
    FD(NOTE_A, 5, 227),
    /* Events 241-256 */
    FD(NOTE_FS, 5, 227),
    FD(NOTE_D, 5, 227),
    FD(NOTE_DS, 5, 227),
    FD(NOTE_FS, 5, 227),
    FD(NOTE_E, 5, 227),
    FD(NOTE_C, 5, 227),
    FD(NOTE_B, 4, 455),
    FD_R(227),
    FD(NOTE_D, 3, 227),
    FD(NOTE_B, 4, 227),
    FD(NOTE_C, 5, 227),
    FD(NOTE_CS, 5, 227),
    FD(NOTE_D, 5, 227),
    FD(NOTE_E, 5, 227),
    FD(NOTE_D, 5, 227),
    FD_R(227),
    /* Events 257-272 */
    FD(NOTE_D, 3, 227),
    FD(NOTE_CS, 5, 227),
    FD(NOTE_D, 5, 227),
    FD(NOTE_E, 5, 227),
    FD(NOTE_FS, 5, 227),
    FD(NOTE_A, 5, 227),
    FD(NOTE_G, 5, 227),
    FD_R(227),
    FD(NOTE_D, 3, 227),
    FD(NOTE_G, 5, 227),
    FD(NOTE_A, 5, 227),
    FD(NOTE_B, 5, 227),
    FD(NOTE_G, 5, 227),
    FD(NOTE_A, 5, 227),
    FD(NOTE_G, 5, 227),
    FD(NOTE_A, 5, 227),
    /* Events 273-288 */
    FD(NOTE_B, 5, 227),
    FD(NOTE_A, 5, 455),
    FD(NOTE_D, 3, 227),
    FD(NOTE_G, 5, 227),
    FD(NOTE_E, 6, 455),
    FD_R(227),
    FD(NOTE_C, 3, 227),
    FD(NOTE_A, 5, 227),
    FD(NOTE_G, 5, 227),
    FD(NOTE_E, 5, 227),
    FD(NOTE_C, 5, 227),
    FD(NOTE_B, 4, 227),
    FD(NOTE_A, 4, 227),
    FD(NOTE_B, 4, 227),
    FD(NOTE_C, 5, 227),
    FD(NOTE_DS, 5, 227),
    /* Events 289-304 */
    FD(NOTE_G, 5, 227),
    FD(NOTE_C, 3, 227),
    FD(NOTE_F, 5, 114),
    FD(NOTE_DS, 5, 114),
    FD(NOTE_G, 5, 455),
    FD(NOTE_D, 5, 227),
    FD(NOTE_D, 3, 227),
    FD(NOTE_G, 5, 227),
    FD(NOTE_A, 5, 227),
    FD(NOTE_B, 5, 227),
    FD(NOTE_G, 5, 227),
    FD(NOTE_A, 5, 910),
    FD(NOTE_FS, 5, 227),
    FD(NOTE_G, 5, 227),
    FD(NOTE_A, 5, 227),
    FD(NOTE_FS, 5, 227),
    /* Events 305-320 */
    FD(NOTE_G, 5, 682),
    FD(NOTE_D, 4, 227),
    FD(NOTE_G, 4, 455),
    FD(NOTE_D, 4, 455),
    FD(NOTE_AS, 3, 455),
    FD(NOTE_AS, 5, 227),
    FD(NOTE_D, 3, 227),
    FD(NOTE_AS, 5, 303),
    FD(NOTE_C, 6, 152),
    FD(NOTE_D, 3, 152),
    FD(NOTE_D, 6, 985),
    FD(NOTE_D, 3, 227),
    FD(NOTE_A, 5, 455),
    FD(NOTE_D, 3, 455),
    FD(NOTE_DS, 3, 455),
    FD(NOTE_G, 5, 227),
    /* Events 321-336 */
    FD(NOTE_AS, 3, 227),
    FD(NOTE_G, 5, 303),
    FD(NOTE_A, 5, 152),
    FD(NOTE_AS, 3, 152),
    FD(NOTE_AS, 5, 985),
    FD(NOTE_AS, 3, 227),
    FD(NOTE_F, 5, 455),
    FD(NOTE_AS, 3, 455),
    FD(NOTE_C, 3, 455),
    FD(NOTE_DS, 5, 227),
    FD(NOTE_G, 3, 227),
    FD(NOTE_DS, 5, 303),
    FD(NOTE_F, 5, 152),
    FD(NOTE_G, 3, 152),
    FD(NOTE_G, 5, 985),
    FD(NOTE_G, 3, 227),
    /* Events 337-352 */
    FD(NOTE_G, 5, 227),
    FD(NOTE_A, 5, 227),
    FD(NOTE_AS, 5, 227),
    FD(NOTE_G, 5, 227),
    FD(NOTE_A, 5, 682),
    FD(NOTE_E, 3, 227),
    FD(NOTE_G, 5, 227),
    FD(NOTE_A, 5, 227),
    FD(NOTE_AS, 5, 227),
    FD(NOTE_G, 5, 227),
    FD(NOTE_AS, 5, 455),
    FD(NOTE_DS, 3, 455),
    FD(NOTE_A, 5, 455),
    FD(NOTE_D, 3, 455),
    FD(NOTE_G, 3, 455),
    FD(NOTE_AS, 5, 227),
    /* Events 353-368 */
    FD(NOTE_D, 3, 227),
    FD(NOTE_AS, 5, 303),
    FD(NOTE_C, 6, 152),
    FD(NOTE_D, 3, 152),
    FD(NOTE_D, 6, 985),
    FD(NOTE_D, 3, 227),
    FD(NOTE_A, 5, 455),
    FD(NOTE_D, 3, 455),
    FD(NOTE_DS, 3, 455),
    FD(NOTE_G, 5, 227),
    FD(NOTE_AS, 3, 227),
    FD(NOTE_G, 5, 303),
    FD(NOTE_A, 5, 152),
    FD(NOTE_AS, 3, 152),
    FD(NOTE_AS, 5, 985),
    FD(NOTE_AS, 3, 227),
    /* Events 369-384 */
    FD(NOTE_F, 5, 455),
    FD(NOTE_AS, 3, 455),
    FD(NOTE_C, 3, 455),
    FD(NOTE_DS, 5, 227),
    FD(NOTE_G, 3, 227),
    FD(NOTE_DS, 5, 303),
    FD(NOTE_F, 5, 152),
    FD(NOTE_G, 3, 152),
    FD(NOTE_G, 5, 985),
    FD(NOTE_G, 3, 227),
    FD(NOTE_G, 5, 227),
    FD(NOTE_A, 5, 227),
    FD(NOTE_AS, 5, 227),
    FD(NOTE_G, 5, 227),
    FD(NOTE_A, 5, 910),
    FD(NOTE_FS, 5, 227),
    /* Events 385-389 */
    FD(NOTE_G, 5, 227),
    FD(NOTE_A, 5, 227),
    FD(NOTE_FS, 5, 227),
    FD(NOTE_G, 5, 909),
    FD(NOTE_G, 6, 909)
};

#undef FD_R
#undef FD
