/*
 * Beethoven - Piano Sonata No. 14, Op. 27 No. 2, movement I.
 * Single-line PWM buzzer reduction from the local PDF score. The source
 * texture is a continuous triplet accompaniment, so this table keeps those
 * pulses and folds sustained melody notes into the highest available line.
 * Tempo follows the score marking at quarter = 44 BPM. Bass notes below C3
 * are raised by octaves so small buzzers can reproduce them.
 */
#define MLS(note, octave, ms) {note, octave, (uint16_t)(ms)}
#define MLS_R(ms) {NOTE_REST, 0, (uint16_t)(ms)}

const Tone_t MOONLIGHT_SONATA_1ST[] = {
    /* Bars 1-4 */
    MLS(NOTE_GS, 3, 455), MLS(NOTE_CS, 4, 455), MLS(NOTE_E, 4, 455), MLS(NOTE_GS, 3, 455),
    MLS(NOTE_CS, 4, 455), MLS(NOTE_E, 4, 455), MLS(NOTE_GS, 3, 455), MLS(NOTE_CS, 4, 455),
    MLS(NOTE_E, 4, 455), MLS(NOTE_GS, 3, 455), MLS(NOTE_CS, 4, 455), MLS(NOTE_E, 4, 455),
    MLS(NOTE_GS, 3, 455), MLS(NOTE_CS, 4, 455), MLS(NOTE_E, 4, 455), MLS(NOTE_GS, 3, 455),
    MLS(NOTE_CS, 4, 455), MLS(NOTE_E, 4, 455), MLS(NOTE_GS, 3, 455), MLS(NOTE_CS, 4, 455),
    MLS(NOTE_E, 4, 455), MLS(NOTE_GS, 3, 455), MLS(NOTE_CS, 4, 455), MLS(NOTE_E, 4, 455),
    MLS(NOTE_A, 3, 455), MLS(NOTE_CS, 4, 455), MLS(NOTE_E, 4, 455), MLS(NOTE_A, 3, 455),
    MLS(NOTE_CS, 4, 455), MLS(NOTE_E, 4, 455), MLS(NOTE_A, 3, 455), MLS(NOTE_D, 4, 455),
    MLS(NOTE_FS, 4, 455), MLS(NOTE_A, 3, 455), MLS(NOTE_D, 4, 455), MLS(NOTE_FS, 4, 455),
    MLS(NOTE_GS, 3, 455), MLS(NOTE_C, 4, 455), MLS(NOTE_FS, 4, 455), MLS(NOTE_GS, 3, 455),
    MLS(NOTE_CS, 4, 455), MLS(NOTE_E, 4, 455), MLS(NOTE_GS, 3, 455), MLS(NOTE_CS, 4, 455),
    MLS(NOTE_DS, 4, 455), MLS(NOTE_FS, 3, 455), MLS(NOTE_C, 4, 455), MLS(NOTE_DS, 4, 455),
    /* Bars 5-8 */
    MLS(NOTE_GS, 3, 455), MLS(NOTE_GS, 3, 455), MLS(NOTE_CS, 4, 455), MLS(NOTE_GS, 3, 455),
    MLS(NOTE_CS, 4, 455), MLS(NOTE_E, 4, 455), MLS(NOTE_GS, 3, 455), MLS(NOTE_CS, 4, 455),
    MLS(NOTE_E, 4, 455), MLS(NOTE_GS, 4, 455), MLS(NOTE_CS, 4, 455), MLS(NOTE_E, 4, 114),
    MLS(NOTE_GS, 4, 341), MLS(NOTE_GS, 4, 455), MLS(NOTE_DS, 4, 455), MLS(NOTE_FS, 4, 455),
    MLS(NOTE_GS, 3, 455), MLS(NOTE_DS, 4, 455), MLS(NOTE_FS, 4, 455), MLS(NOTE_GS, 3, 455),
    MLS(NOTE_DS, 4, 455), MLS(NOTE_FS, 4, 455), MLS(NOTE_GS, 4, 455), MLS(NOTE_DS, 4, 455),
    MLS(NOTE_FS, 4, 114), MLS(NOTE_GS, 4, 341), MLS(NOTE_GS, 4, 455), MLS(NOTE_CS, 4, 455),
    MLS(NOTE_E, 4, 455), MLS(NOTE_GS, 3, 455), MLS(NOTE_CS, 4, 455), MLS(NOTE_E, 4, 455),
    MLS(NOTE_A, 4, 455), MLS(NOTE_CS, 4, 455), MLS(NOTE_FS, 4, 455), MLS(NOTE_A, 3, 455),
    MLS(NOTE_CS, 4, 455), MLS(NOTE_FS, 4, 455), MLS(NOTE_GS, 4, 455), MLS(NOTE_B, 3, 455),
    MLS(NOTE_E, 4, 455), MLS(NOTE_GS, 3, 455), MLS(NOTE_B, 3, 455), MLS(NOTE_E, 4, 455),
    MLS(NOTE_FS, 4, 455), MLS(NOTE_B, 3, 455), MLS(NOTE_DS, 4, 455), MLS(NOTE_B, 4, 455),
    MLS(NOTE_B, 3, 455), MLS(NOTE_DS, 4, 455),
    /* Bars 9-12 */
    MLS(NOTE_E, 4, 455), MLS(NOTE_B, 3, 451), MLS_R(458), MLS(NOTE_GS, 3, 455),
    MLS(NOTE_B, 3, 455), MLS(NOTE_E, 4, 455), MLS(NOTE_GS, 3, 455), MLS(NOTE_B, 3, 455),
    MLS(NOTE_E, 4, 455), MLS(NOTE_GS, 3, 455), MLS(NOTE_B, 3, 455), MLS(NOTE_E, 4, 455),
    MLS(NOTE_G, 3, 455), MLS(NOTE_B, 3, 455), MLS(NOTE_E, 4, 455), MLS(NOTE_G, 3, 455),
    MLS(NOTE_B, 3, 455), MLS(NOTE_E, 4, 455), MLS(NOTE_G, 3, 455), MLS(NOTE_B, 3, 455),
    MLS(NOTE_E, 4, 455), MLS(NOTE_G, 4, 455), MLS(NOTE_B, 3, 455), MLS(NOTE_E, 4, 114),
    MLS(NOTE_G, 4, 341), MLS(NOTE_G, 4, 455), MLS(NOTE_B, 3, 455), MLS(NOTE_F, 4, 455),
    MLS(NOTE_G, 3, 455), MLS(NOTE_B, 3, 455), MLS(NOTE_F, 4, 455), MLS(NOTE_G, 3, 455),
    MLS(NOTE_B, 3, 455), MLS(NOTE_F, 4, 455), MLS(NOTE_G, 4, 455), MLS(NOTE_B, 3, 455),
    MLS(NOTE_F, 4, 114), MLS(NOTE_G, 4, 341), MLS(NOTE_G, 4, 455), MLS(NOTE_C, 4, 455),
    MLS(NOTE_E, 4, 455), MLS(NOTE_G, 3, 455), MLS(NOTE_B, 3, 455), MLS(NOTE_E, 4, 455),
    MLS(NOTE_G, 3, 455), MLS(NOTE_CS, 4, 455), MLS(NOTE_E, 4, 455), MLS(NOTE_FS, 4, 455),
    MLS(NOTE_CS, 4, 455), MLS(NOTE_E, 4, 455),
    /* Bars 13-16 */
    MLS(NOTE_FS, 4, 455), MLS(NOTE_B, 3, 455), MLS(NOTE_D, 4, 455), MLS(NOTE_FS, 3, 455),
    MLS(NOTE_B, 3, 455), MLS(NOTE_D, 4, 455), MLS(NOTE_G, 4, 455), MLS(NOTE_B, 3, 455),
    MLS(NOTE_CS, 4, 455), MLS(NOTE_E, 4, 455), MLS(NOTE_B, 3, 455), MLS(NOTE_CS, 4, 455),
    MLS(NOTE_FS, 4, 455), MLS(NOTE_B, 3, 455), MLS(NOTE_D, 4, 455), MLS(NOTE_FS, 3, 455),
    MLS(NOTE_B, 3, 455), MLS(NOTE_D, 4, 455), MLS(NOTE_FS, 4, 455), MLS(NOTE_AS, 3, 455),
    MLS(NOTE_CS, 4, 455), MLS(NOTE_FS, 3, 455), MLS(NOTE_AS, 3, 455), MLS(NOTE_CS, 4, 455),
    MLS(NOTE_B, 3, 455), MLS(NOTE_D, 4, 455), MLS(NOTE_FS, 4, 455), MLS(NOTE_B, 3, 455),
    MLS(NOTE_D, 4, 455), MLS(NOTE_FS, 4, 455), MLS(NOTE_B, 3, 455), MLS(NOTE_DS, 4, 455),
    MLS(NOTE_FS, 4, 455), MLS(NOTE_B, 4, 455), MLS(NOTE_DS, 4, 455), MLS(NOTE_FS, 4, 455),
    MLS(NOTE_C, 5, 455), MLS(NOTE_E, 4, 455), MLS(NOTE_G, 4, 455), MLS(NOTE_B, 3, 455),
    MLS(NOTE_E, 4, 455), MLS(NOTE_G, 4, 455), MLS(NOTE_B, 3, 455), MLS(NOTE_E, 4, 455),
    MLS(NOTE_G, 4, 455), MLS(NOTE_AS, 4, 455), MLS(NOTE_E, 4, 455), MLS(NOTE_G, 4, 455),
    /* Bars 17-20 */
    MLS(NOTE_B, 4, 455), MLS(NOTE_DS, 4, 455), MLS(NOTE_FS, 4, 455), MLS(NOTE_B, 3, 455),
    MLS(NOTE_DS, 4, 455), MLS(NOTE_FS, 4, 455), MLS(NOTE_B, 3, 455), MLS(NOTE_DS, 4, 455),
    MLS(NOTE_FS, 4, 455), MLS(NOTE_B, 4, 455), MLS(NOTE_DS, 4, 455), MLS(NOTE_FS, 4, 455),
    MLS(NOTE_C, 5, 455), MLS(NOTE_E, 4, 455), MLS(NOTE_G, 4, 455), MLS(NOTE_B, 3, 455),
    MLS(NOTE_E, 4, 455), MLS(NOTE_G, 4, 455), MLS(NOTE_B, 3, 455), MLS(NOTE_E, 4, 455),
    MLS(NOTE_G, 4, 455), MLS(NOTE_AS, 4, 455), MLS(NOTE_E, 4, 455), MLS(NOTE_G, 4, 455),
    MLS(NOTE_B, 4, 455), MLS(NOTE_DS, 4, 455), MLS(NOTE_FS, 4, 455), MLS(NOTE_B, 3, 455),
    MLS(NOTE_DS, 4, 455), MLS(NOTE_FS, 4, 455), MLS(NOTE_B, 4, 455), MLS(NOTE_D, 4, 455),
    MLS(NOTE_F, 4, 455), MLS(NOTE_B, 3, 455), MLS(NOTE_D, 4, 455), MLS(NOTE_F, 4, 455),
    MLS(NOTE_B, 4, 455), MLS(NOTE_CS, 4, 455), MLS(NOTE_GS, 4, 455), MLS(NOTE_B, 3, 455),
    MLS(NOTE_CS, 4, 455), MLS(NOTE_GS, 4, 455), MLS(NOTE_A, 4, 455), MLS(NOTE_CS, 4, 455),
    MLS(NOTE_FS, 4, 455), MLS(NOTE_A, 3, 455), MLS(NOTE_CS, 4, 455), MLS(NOTE_FS, 4, 455),
    /* Bars 21-24 */
    MLS(NOTE_G, 4, 455), MLS(NOTE_B, 3, 455), MLS(NOTE_D, 4, 455), MLS(NOTE_G, 3, 455),
    MLS(NOTE_B, 3, 455), MLS(NOTE_D, 4, 455), MLS(NOTE_FS, 4, 455), MLS(NOTE_A, 3, 455),
    MLS(NOTE_DS, 4, 455), MLS(NOTE_FS, 3, 455), MLS(NOTE_A, 3, 455), MLS(NOTE_DS, 4, 455),
    MLS(NOTE_CS, 4, 455), MLS(NOTE_FS, 3, 455), MLS(NOTE_A, 3, 455), MLS(NOTE_CS, 3, 455),
    MLS(NOTE_FS, 3, 455), MLS(NOTE_A, 3, 455), MLS(NOTE_CS, 4, 455), MLS(NOTE_FS, 3, 455),
    MLS(NOTE_GS, 3, 455), MLS(NOTE_CS, 4, 455), MLS(NOTE_F, 3, 455), MLS(NOTE_GS, 3, 455),
    MLS(NOTE_FS, 3, 455), MLS(NOTE_A, 3, 455), MLS(NOTE_CS, 4, 455), MLS(NOTE_A, 3, 455),
    MLS(NOTE_CS, 4, 455), MLS(NOTE_FS, 4, 455), MLS(NOTE_CS, 4, 455), MLS(NOTE_FS, 4, 455),
    MLS(NOTE_A, 4, 455), MLS(NOTE_CS, 5, 455), MLS(NOTE_FS, 4, 455), MLS(NOTE_A, 4, 114),
    MLS(NOTE_CS, 5, 341), MLS(NOTE_CS, 5, 455), MLS(NOTE_GS, 4, 455), MLS(NOTE_B, 4, 455),
    MLS(NOTE_CS, 4, 455), MLS(NOTE_GS, 4, 455), MLS(NOTE_B, 4, 455), MLS(NOTE_CS, 4, 455),
    MLS(NOTE_GS, 4, 455), MLS(NOTE_B, 4, 455), MLS(NOTE_CS, 5, 455), MLS(NOTE_GS, 4, 455),
    MLS(NOTE_B, 4, 114), MLS(NOTE_CS, 5, 341),
    /* Bars 25-28 */
    MLS(NOTE_CS, 5, 455), MLS(NOTE_FS, 4, 455), MLS(NOTE_A, 4, 455), MLS(NOTE_CS, 4, 455),
    MLS(NOTE_FS, 4, 455), MLS(NOTE_A, 4, 455), MLS(NOTE_C, 5, 455), MLS(NOTE_FS, 4, 455),
    MLS(NOTE_A, 4, 455), MLS(NOTE_CS, 5, 455), MLS(NOTE_FS, 4, 455), MLS(NOTE_A, 4, 455),
    MLS(NOTE_DS, 5, 455), MLS(NOTE_FS, 4, 455), MLS(NOTE_GS, 4, 455), MLS(NOTE_DS, 4, 455),
    MLS(NOTE_FS, 4, 455), MLS(NOTE_GS, 4, 455), MLS(NOTE_DS, 4, 455), MLS(NOTE_FS, 4, 455),
    MLS(NOTE_GS, 4, 455), MLS(NOTE_DS, 5, 455), MLS(NOTE_FS, 4, 455), MLS(NOTE_GS, 4, 455),
    MLS(NOTE_E, 5, 455), MLS(NOTE_GS, 4, 455), MLS(NOTE_CS, 5, 455), MLS(NOTE_E, 4, 455),
    MLS(NOTE_GS, 4, 455), MLS(NOTE_CS, 5, 455), MLS(NOTE_DS, 5, 455), MLS(NOTE_FS, 4, 455),
    MLS(NOTE_A, 4, 455), MLS(NOTE_CS, 5, 455), MLS(NOTE_E, 4, 455), MLS(NOTE_AS, 4, 455),
    MLS(NOTE_C, 5, 455), MLS(NOTE_C, 4, 455), MLS(NOTE_DS, 4, 455), MLS(NOTE_GS, 4, 455),
    MLS(NOTE_C, 4, 455), MLS(NOTE_DS, 4, 455), MLS(NOTE_A, 4, 455), MLS(NOTE_C, 4, 455),
    MLS(NOTE_DS, 4, 455), MLS(NOTE_FS, 4, 455), MLS(NOTE_C, 4, 455), MLS(NOTE_DS, 4, 455),
    /* Bars 29-32 */
    MLS(NOTE_GS, 3, 455), MLS(NOTE_C, 4, 455), MLS(NOTE_DS, 4, 455), MLS(NOTE_GS, 3, 455),
    MLS(NOTE_C, 4, 455), MLS(NOTE_DS, 4, 455), MLS(NOTE_A, 3, 455), MLS(NOTE_C, 4, 455),
    MLS(NOTE_DS, 4, 455), MLS(NOTE_FS, 3, 455), MLS(NOTE_C, 4, 455), MLS(NOTE_DS, 4, 455),
    MLS(NOTE_GS, 3, 455), MLS(NOTE_E, 4, 455), MLS(NOTE_GS, 4, 455), MLS(NOTE_CS, 5, 455),
    MLS(NOTE_E, 4, 455), MLS(NOTE_GS, 4, 455), MLS(NOTE_E, 5, 455), MLS(NOTE_E, 4, 455),
    MLS(NOTE_GS, 4, 455), MLS(NOTE_CS, 5, 455), MLS(NOTE_E, 4, 455), MLS(NOTE_GS, 4, 455),
    MLS(NOTE_GS, 3, 455), MLS(NOTE_E, 3, 455), MLS(NOTE_GS, 3, 455), MLS(NOTE_CS, 4, 455),
    MLS(NOTE_E, 3, 455), MLS(NOTE_GS, 3, 455), MLS(NOTE_E, 4, 455), MLS(NOTE_E, 3, 455),
    MLS(NOTE_GS, 3, 455), MLS(NOTE_CS, 4, 455), MLS(NOTE_E, 3, 455), MLS(NOTE_GS, 3, 455),
    MLS(NOTE_GS, 3, 455), MLS(NOTE_A, 3, 455), MLS(NOTE_FS, 3, 455), MLS(NOTE_C, 4, 455),
    MLS(NOTE_A, 3, 455), MLS(NOTE_DS, 4, 455), MLS(NOTE_C, 4, 455), MLS(NOTE_FS, 4, 455),
    MLS(NOTE_DS, 4, 455), MLS(NOTE_A, 4, 455), MLS(NOTE_FS, 4, 455), MLS(NOTE_C, 5, 455),
    /* Bars 33-36 */
    MLS(NOTE_GS, 3, 455), MLS(NOTE_CS, 4, 455), MLS(NOTE_GS, 3, 455), MLS(NOTE_E, 4, 455),
    MLS(NOTE_CS, 4, 455), MLS(NOTE_GS, 4, 455), MLS(NOTE_E, 4, 455), MLS(NOTE_CS, 5, 455),
    MLS(NOTE_GS, 4, 455), MLS(NOTE_E, 5, 455), MLS(NOTE_CS, 5, 455), MLS(NOTE_GS, 4, 455),
    MLS(NOTE_CS, 4, 455), MLS(NOTE_G, 4, 455), MLS(NOTE_E, 4, 455), MLS(NOTE_AS, 4, 455),
    MLS(NOTE_G, 4, 455), MLS(NOTE_CS, 5, 455), MLS(NOTE_AS, 4, 455), MLS(NOTE_E, 5, 455),
    MLS(NOTE_CS, 5, 455), MLS(NOTE_G, 5, 455), MLS(NOTE_E, 5, 455), MLS(NOTE_AS, 5, 455),
    MLS(NOTE_FS, 4, 455), MLS(NOTE_C, 5, 455), MLS(NOTE_A, 4, 455), MLS(NOTE_DS, 5, 455),
    MLS(NOTE_C, 5, 455), MLS(NOTE_FS, 5, 455), MLS(NOTE_DS, 5, 455), MLS(NOTE_A, 5, 455),
    MLS(NOTE_FS, 5, 455), MLS(NOTE_C, 6, 455), MLS(NOTE_A, 5, 455), MLS(NOTE_DS, 6, 455),
    MLS(NOTE_C, 6, 455), MLS(NOTE_FS, 5, 455), MLS(NOTE_A, 5, 455), MLS(NOTE_DS, 5, 455),
    MLS(NOTE_FS, 5, 455), MLS(NOTE_C, 5, 455), MLS(NOTE_DS, 5, 455), MLS(NOTE_A, 4, 455),
    MLS(NOTE_C, 5, 455), MLS(NOTE_FS, 4, 455), MLS(NOTE_A, 4, 455), MLS(NOTE_DS, 4, 455),
    /* Bars 37-40 */
    MLS(NOTE_FS, 4, 455), MLS(NOTE_C, 4, 455), MLS(NOTE_DS, 4, 455), MLS(NOTE_A, 3, 455),
    MLS(NOTE_C, 4, 455), MLS(NOTE_FS, 3, 455), MLS(NOTE_A, 3, 455), MLS(NOTE_DS, 3, 455),
    MLS(NOTE_FS, 3, 455), MLS(NOTE_CS, 3, 455), MLS(NOTE_FS, 3, 455), MLS(NOTE_A, 3, 455),
    MLS(NOTE_C, 3, 455), MLS(NOTE_FS, 3, 455), MLS(NOTE_GS, 3, 455), MLS(NOTE_A, 3, 455),
    MLS(NOTE_GS, 3, 455), MLS(NOTE_FS, 3, 455), MLS(NOTE_DS, 3, 455), MLS(NOTE_FS, 3, 455),
    MLS(NOTE_A, 3, 455), MLS(NOTE_CS, 3, 455), MLS(NOTE_FS, 3, 455), MLS(NOTE_A, 3, 455),
    MLS(NOTE_C, 3, 455), MLS(NOTE_FS, 3, 455), MLS(NOTE_GS, 3, 455), MLS(NOTE_A, 3, 455),
    MLS(NOTE_GS, 3, 455), MLS(NOTE_FS, 3, 455), MLS(NOTE_D, 3, 455), MLS(NOTE_FS, 3, 455),
    MLS(NOTE_A, 3, 455), MLS(NOTE_CS, 3, 455), MLS(NOTE_FS, 3, 455), MLS(NOTE_A, 3, 455),
    MLS(NOTE_C, 3, 455), MLS(NOTE_FS, 3, 455), MLS(NOTE_GS, 3, 455), MLS(NOTE_A, 3, 455),
    MLS(NOTE_GS, 3, 455), MLS(NOTE_FS, 3, 455), MLS(NOTE_CS, 3, 455), MLS(NOTE_E, 3, 455),
    MLS(NOTE_CS, 4, 455), MLS(NOTE_CS, 3, 455), MLS(NOTE_E, 3, 455), MLS(NOTE_CS, 4, 455),
    /* Bars 41-44 */
    MLS(NOTE_DS, 3, 455), MLS(NOTE_A, 3, 455), MLS(NOTE_CS, 4, 455), MLS(NOTE_DS, 3, 455),
    MLS(NOTE_A, 3, 455), MLS(NOTE_CS, 4, 455), MLS(NOTE_DS, 3, 455), MLS(NOTE_GS, 3, 455),
    MLS(NOTE_C, 4, 455), MLS(NOTE_DS, 3, 455), MLS(NOTE_FS, 3, 455), MLS(NOTE_C, 4, 455),
    MLS(NOTE_E, 3, 455), MLS(NOTE_GS, 3, 455), MLS(NOTE_CS, 4, 455), MLS(NOTE_GS, 3, 455),
    MLS(NOTE_CS, 4, 455), MLS(NOTE_E, 4, 455), MLS(NOTE_GS, 3, 455), MLS(NOTE_CS, 4, 455),
    MLS(NOTE_E, 4, 455), MLS(NOTE_GS, 4, 455), MLS(NOTE_CS, 4, 455), MLS(NOTE_E, 4, 114),
    MLS(NOTE_GS, 4, 341), MLS(NOTE_GS, 4, 455), MLS(NOTE_DS, 4, 455), MLS(NOTE_FS, 4, 455),
    MLS(NOTE_GS, 3, 455), MLS(NOTE_DS, 4, 455), MLS(NOTE_FS, 4, 455), MLS(NOTE_GS, 3, 455),
    MLS(NOTE_DS, 4, 455), MLS(NOTE_FS, 4, 455), MLS(NOTE_GS, 4, 455), MLS(NOTE_DS, 4, 455),
    MLS(NOTE_FS, 4, 114), MLS(NOTE_GS, 4, 341), MLS(NOTE_GS, 4, 455), MLS(NOTE_CS, 4, 455),
    MLS(NOTE_E, 4, 455), MLS(NOTE_GS, 3, 455), MLS(NOTE_CS, 4, 455), MLS(NOTE_E, 4, 455),
    MLS(NOTE_A, 4, 455), MLS(NOTE_CS, 4, 455), MLS(NOTE_FS, 4, 455), MLS(NOTE_A, 3, 455),
    MLS(NOTE_CS, 4, 455), MLS(NOTE_FS, 4, 455),
    /* Bars 45-48 */
    MLS(NOTE_GS, 4, 455), MLS(NOTE_B, 3, 455), MLS(NOTE_E, 4, 455), MLS(NOTE_GS, 3, 455),
    MLS(NOTE_B, 3, 455), MLS(NOTE_E, 4, 455), MLS(NOTE_FS, 4, 455), MLS(NOTE_B, 3, 455),
    MLS(NOTE_DS, 4, 455), MLS(NOTE_B, 4, 455), MLS(NOTE_B, 3, 455), MLS(NOTE_DS, 4, 455),
    MLS(NOTE_E, 4, 455), MLS(NOTE_B, 3, 451), MLS_R(458), MLS(NOTE_B, 3, 455),
    MLS(NOTE_E, 4, 455), MLS(NOTE_GS, 4, 455), MLS(NOTE_B, 3, 455), MLS(NOTE_E, 4, 455),
    MLS(NOTE_GS, 4, 455), MLS(NOTE_B, 4, 455), MLS(NOTE_E, 4, 455), MLS(NOTE_GS, 4, 114),
    MLS(NOTE_B, 4, 341), MLS(NOTE_B, 4, 455), MLS(NOTE_FS, 4, 455), MLS(NOTE_A, 4, 455),
    MLS(NOTE_B, 3, 455), MLS(NOTE_FS, 4, 455), MLS(NOTE_A, 4, 455), MLS(NOTE_B, 3, 455),
    MLS(NOTE_FS, 4, 455), MLS(NOTE_A, 4, 455), MLS(NOTE_B, 4, 455), MLS(NOTE_FS, 4, 455),
    MLS(NOTE_A, 4, 114), MLS(NOTE_B, 4, 341), MLS(NOTE_B, 4, 455), MLS(NOTE_E, 4, 455),
    MLS(NOTE_GS, 4, 455), MLS(NOTE_B, 3, 455), MLS(NOTE_E, 4, 455), MLS(NOTE_GS, 4, 455),
    MLS(NOTE_C, 5, 455), MLS(NOTE_FS, 4, 455), MLS(NOTE_GS, 4, 455), MLS(NOTE_CS, 5, 455),
    MLS(NOTE_E, 4, 455), MLS(NOTE_GS, 4, 455),
    /* Bars 49-52 */
    MLS(NOTE_DS, 5, 455), MLS(NOTE_FS, 4, 455), MLS(NOTE_GS, 4, 455), MLS(NOTE_DS, 4, 455),
    MLS(NOTE_FS, 4, 455), MLS(NOTE_GS, 4, 455), MLS(NOTE_E, 5, 455), MLS(NOTE_GS, 4, 455),
    MLS(NOTE_CS, 5, 455), MLS(NOTE_E, 4, 455), MLS(NOTE_GS, 4, 455), MLS(NOTE_CS, 5, 455),
    MLS(NOTE_D, 5, 455), MLS(NOTE_FS, 4, 455), MLS(NOTE_A, 4, 455), MLS(NOTE_D, 4, 455),
    MLS(NOTE_FS, 4, 455), MLS(NOTE_A, 4, 455), MLS(NOTE_C, 5, 455), MLS(NOTE_FS, 4, 455),
    MLS(NOTE_GS, 4, 455), MLS(NOTE_C, 4, 455), MLS(NOTE_FS, 4, 455), MLS(NOTE_GS, 4, 455),
    MLS(NOTE_CS, 5, 455), MLS(NOTE_E, 4, 455), MLS(NOTE_GS, 4, 455), MLS(NOTE_CS, 4, 455),
    MLS(NOTE_E, 4, 455), MLS(NOTE_GS, 4, 455), MLS(NOTE_CS, 4, 455), MLS(NOTE_F, 4, 455),
    MLS(NOTE_GS, 4, 455), MLS(NOTE_CS, 5, 455), MLS(NOTE_F, 4, 455), MLS(NOTE_GS, 4, 455),
    MLS(NOTE_D, 5, 455), MLS(NOTE_FS, 4, 455), MLS(NOTE_A, 4, 455), MLS(NOTE_CS, 4, 455),
    MLS(NOTE_FS, 4, 455), MLS(NOTE_A, 4, 455), MLS(NOTE_CS, 4, 455), MLS(NOTE_FS, 4, 455),
    MLS(NOTE_A, 4, 455), MLS(NOTE_C, 5, 455), MLS(NOTE_FS, 4, 455), MLS(NOTE_A, 4, 455),
    /* Bars 53-56 */
    MLS(NOTE_CS, 5, 455), MLS(NOTE_F, 4, 455), MLS(NOTE_GS, 4, 455), MLS(NOTE_CS, 4, 455),
    MLS(NOTE_F, 4, 455), MLS(NOTE_GS, 4, 455), MLS(NOTE_CS, 4, 455), MLS(NOTE_F, 4, 455),
    MLS(NOTE_GS, 4, 455), MLS(NOTE_CS, 5, 455), MLS(NOTE_F, 4, 455), MLS(NOTE_GS, 4, 455),
    MLS(NOTE_D, 5, 455), MLS(NOTE_FS, 4, 455), MLS(NOTE_A, 4, 455), MLS(NOTE_CS, 4, 455),
    MLS(NOTE_FS, 4, 455), MLS(NOTE_A, 4, 455), MLS(NOTE_CS, 4, 455), MLS(NOTE_FS, 4, 455),
    MLS(NOTE_A, 4, 455), MLS(NOTE_C, 5, 455), MLS(NOTE_FS, 4, 455), MLS(NOTE_A, 4, 455),
    MLS(NOTE_CS, 5, 455), MLS(NOTE_F, 4, 455), MLS(NOTE_GS, 4, 455), MLS(NOTE_CS, 4, 455),
    MLS(NOTE_F, 4, 455), MLS(NOTE_GS, 4, 455), MLS(NOTE_CS, 5, 455), MLS(NOTE_FS, 4, 455),
    MLS(NOTE_A, 4, 455), MLS(NOTE_CS, 4, 455), MLS(NOTE_FS, 4, 455), MLS(NOTE_A, 4, 455),
    MLS(NOTE_B, 4, 455), MLS(NOTE_FS, 4, 455), MLS(NOTE_A, 4, 455), MLS(NOTE_B, 3, 455),
    MLS(NOTE_FS, 4, 455), MLS(NOTE_A, 4, 455), MLS(NOTE_B, 3, 455), MLS(NOTE_FS, 4, 455),
    MLS(NOTE_A, 4, 455), MLS(NOTE_B, 4, 455), MLS(NOTE_E, 4, 455), MLS(NOTE_GS, 4, 455),
    /* Bars 57-60 */
    MLS(NOTE_A, 4, 455), MLS(NOTE_E, 4, 455), MLS(NOTE_GS, 4, 455), MLS(NOTE_A, 4, 455),
    MLS(NOTE_DS, 4, 455), MLS(NOTE_FS, 4, 455), MLS(NOTE_GS, 4, 455), MLS(NOTE_DS, 4, 455),
    MLS(NOTE_FS, 4, 455), MLS(NOTE_GS, 4, 455), MLS(NOTE_CS, 4, 455), MLS(NOTE_E, 4, 455),
    MLS(NOTE_FS, 4, 455), MLS(NOTE_CS, 4, 455), MLS(NOTE_DS, 4, 455), MLS(NOTE_FS, 3, 455),
    MLS(NOTE_CS, 4, 455), MLS(NOTE_DS, 4, 455), MLS(NOTE_GS, 4, 455), MLS(NOTE_CS, 4, 455),
    MLS(NOTE_DS, 4, 455), MLS(NOTE_A, 4, 455), MLS(NOTE_CS, 4, 455), MLS(NOTE_DS, 4, 455),
    MLS(NOTE_GS, 4, 455), MLS(NOTE_CS, 4, 455), MLS(NOTE_E, 4, 455), MLS(NOTE_GS, 3, 455),
    MLS(NOTE_CS, 4, 455), MLS(NOTE_E, 4, 455), MLS(NOTE_GS, 4, 455), MLS(NOTE_C, 4, 455),
    MLS(NOTE_DS, 4, 455), MLS(NOTE_FS, 3, 455), MLS(NOTE_C, 4, 455), MLS(NOTE_DS, 4, 455),
    MLS(NOTE_CS, 4, 455), MLS(NOTE_GS, 3, 455), MLS(NOTE_CS, 4, 455), MLS(NOTE_GS, 3, 455),
    MLS(NOTE_CS, 4, 455), MLS(NOTE_E, 4, 455), MLS(NOTE_GS, 3, 455), MLS(NOTE_CS, 4, 455),
    MLS(NOTE_E, 4, 455), MLS(NOTE_GS, 3, 455), MLS(NOTE_CS, 4, 455), MLS(NOTE_E, 4, 114),
    MLS(NOTE_GS, 3, 341),
    /* Bars 61-64 */
    MLS(NOTE_GS, 3, 455), MLS(NOTE_DS, 4, 455), MLS(NOTE_FS, 4, 455), MLS(NOTE_GS, 3, 455),
    MLS(NOTE_DS, 4, 455), MLS(NOTE_FS, 4, 455), MLS(NOTE_GS, 3, 455), MLS(NOTE_DS, 4, 455),
    MLS(NOTE_FS, 4, 455), MLS(NOTE_GS, 3, 455), MLS(NOTE_DS, 4, 455), MLS(NOTE_FS, 4, 114),
    MLS(NOTE_GS, 3, 341), MLS(NOTE_GS, 3, 455), MLS(NOTE_E, 4, 455), MLS(NOTE_CS, 4, 455),
    MLS(NOTE_GS, 4, 455), MLS(NOTE_E, 4, 455), MLS(NOTE_CS, 5, 455), MLS(NOTE_GS, 4, 455),
    MLS(NOTE_E, 5, 455), MLS(NOTE_CS, 5, 455), MLS(NOTE_GS, 5, 455), MLS(NOTE_E, 5, 455),
    MLS(NOTE_CS, 5, 114), MLS(NOTE_GS, 3, 341), MLS(NOTE_C, 5, 455), MLS(NOTE_DS, 5, 455),
    MLS(NOTE_A, 4, 455), MLS(NOTE_C, 5, 455), MLS(NOTE_FS, 4, 455), MLS(NOTE_A, 4, 455),
    MLS(NOTE_DS, 4, 455), MLS(NOTE_FS, 4, 455), MLS(NOTE_A, 3, 455), MLS(NOTE_C, 4, 455),
    MLS(NOTE_GS, 3, 455), MLS(NOTE_FS, 3, 114), MLS(NOTE_GS, 3, 341), MLS(NOTE_CS, 4, 455),
    MLS(NOTE_E, 4, 455), MLS(NOTE_CS, 4, 455), MLS(NOTE_GS, 4, 455), MLS(NOTE_E, 4, 455),
    MLS(NOTE_CS, 5, 455), MLS(NOTE_GS, 4, 455), MLS(NOTE_E, 5, 455), MLS(NOTE_CS, 5, 455),
    MLS(NOTE_GS, 5, 455), MLS(NOTE_E, 5, 455), MLS(NOTE_CS, 5, 114), MLS(NOTE_GS, 3, 341),
    /* Bars 65-68 */
    MLS(NOTE_C, 5, 455), MLS(NOTE_DS, 5, 455), MLS(NOTE_A, 4, 455), MLS(NOTE_C, 5, 455),
    MLS(NOTE_FS, 4, 455), MLS(NOTE_A, 4, 455), MLS(NOTE_DS, 4, 455), MLS(NOTE_FS, 4, 455),
    MLS(NOTE_A, 3, 455), MLS(NOTE_C, 4, 455), MLS(NOTE_GS, 3, 455), MLS(NOTE_FS, 3, 114),
    MLS(NOTE_GS, 3, 341), MLS(NOTE_CS, 4, 455), MLS(NOTE_GS, 3, 455), MLS(NOTE_CS, 4, 455),
    MLS(NOTE_E, 4, 455), MLS(NOTE_CS, 4, 455), MLS(NOTE_GS, 3, 455), MLS(NOTE_CS, 3, 455),
    MLS(NOTE_E, 3, 455), MLS(NOTE_GS, 3, 455), MLS(NOTE_CS, 4, 455), MLS(NOTE_GS, 3, 455),
    MLS(NOTE_E, 3, 455), MLS(NOTE_GS, 3, 455), MLS(NOTE_CS, 3, 455), MLS(NOTE_E, 3, 455),
    MLS(NOTE_GS, 3, 455), MLS(NOTE_E, 3, 455), MLS(NOTE_CS, 3, 455), MLS(NOTE_GS, 3, 455),
    MLS(NOTE_CS, 3, 455), MLS(NOTE_GS, 3, 455), MLS(NOTE_E, 3, 455), MLS(NOTE_GS, 3, 455),
    MLS(NOTE_E, 3, 455), MLS(NOTE_CS, 3, 2727), MLS(NOTE_CS, 4, 2727),
    /* Bars 69-69 */
    MLS(NOTE_CS, 4, 5455),
};

#undef MLS_R
#undef MLS
