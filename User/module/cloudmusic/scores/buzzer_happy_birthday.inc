/*
 * Happy Birthday.
 * Complete single-line PWM buzzer reduction generated from local user PDF / PiaStudy 21sk1T30094 space data, C major, quarter note = 63 BPM.
 * Simultaneous right-hand, left-hand, and chord tones are
 * arpeggiated into one buzzer line with the upper voice first;
 * notes outside the practical buzzer range are folded by octaves.
 * 131 buzzer events, about 50 seconds.
 */
#define HBD(note, octave, ms) {note, octave, (uint16_t)(ms)}
#define HBD_R(ms) {NOTE_REST, 0, (uint16_t)(ms)}

const Tone_t HAPPY_BIRTHDAY[] = {
    /* Events 1-16 */
    HBD_R(1905),
    HBD(NOTE_G, 4, 476),
    HBD(NOTE_G, 4, 476),
    HBD(NOTE_A, 4, 238),
    HBD(NOTE_C, 3, 238),
    HBD(NOTE_G, 3, 476),
    HBD(NOTE_G, 4, 238),
    HBD(NOTE_C, 4, 238),
    HBD(NOTE_D, 4, 476),
    HBD(NOTE_C, 5, 476),
    HBD(NOTE_E, 4, 476),
    HBD(NOTE_B, 4, 238),
    HBD(NOTE_G, 3, 238),
    HBD(NOTE_D, 3, 476),
    HBD(NOTE_G, 3, 476),
    HBD(NOTE_A, 3, 476),
    /* Events 17-32 */
    HBD(NOTE_G, 4, 238),
    HBD(NOTE_B, 3, 238),
    HBD(NOTE_G, 4, 476),
    HBD(NOTE_A, 4, 238),
    HBD(NOTE_G, 3, 238),
    HBD(NOTE_D, 3, 476),
    HBD(NOTE_G, 4, 238),
    HBD(NOTE_G, 3, 238),
    HBD(NOTE_A, 3, 476),
    HBD(NOTE_D, 5, 476),
    HBD(NOTE_B, 3, 476),
    HBD(NOTE_C, 5, 238),
    HBD(NOTE_C, 3, 238),
    HBD(NOTE_G, 3, 476),
    HBD(NOTE_C, 4, 476),
    HBD(NOTE_D, 4, 476),
    /* Events 33-48 */
    HBD(NOTE_G, 4, 238),
    HBD(NOTE_E, 4, 238),
    HBD(NOTE_G, 4, 476),
    HBD(NOTE_G, 5, 238),
    HBD(NOTE_C, 3, 238),
    HBD(NOTE_G, 3, 476),
    HBD(NOTE_E, 5, 238),
    HBD(NOTE_C, 4, 238),
    HBD(NOTE_D, 4, 476),
    HBD(NOTE_C, 5, 476),
    HBD(NOTE_E, 4, 476),
    HBD(NOTE_B, 4, 238),
    HBD(NOTE_D, 3, 238),
    HBD(NOTE_A, 3, 476),
    HBD(NOTE_A, 4, 238),
    HBD(NOTE_D, 4, 238),
    /* Events 49-64 */
    HBD(NOTE_E, 4, 476),
    HBD(NOTE_F, 5, 238),
    HBD(NOTE_F, 4, 238),
    HBD(NOTE_F, 5, 476),
    HBD(NOTE_E, 5, 238),
    HBD(NOTE_G, 3, 238),
    HBD(NOTE_D, 3, 476),
    HBD(NOTE_C, 5, 238),
    HBD(NOTE_G, 3, 238),
    HBD(NOTE_A, 3, 476),
    HBD(NOTE_D, 5, 476),
    HBD(NOTE_B, 3, 476),
    HBD(NOTE_C, 5, 238),
    HBD(NOTE_C, 3, 238),
    HBD(NOTE_G, 3, 476),
    HBD(NOTE_C, 4, 476),
    /* Events 65-80 */
    HBD(NOTE_D, 4, 476),
    HBD(NOTE_E, 4, 952),
    HBD(NOTE_G, 4, 476),
    HBD(NOTE_G, 4, 476),
    HBD(NOTE_A, 4, 238),
    HBD(NOTE_C, 3, 238),
    HBD(NOTE_G, 3, 476),
    HBD(NOTE_G, 4, 238),
    HBD(NOTE_C, 4, 238),
    HBD(NOTE_D, 4, 476),
    HBD(NOTE_C, 5, 476),
    HBD(NOTE_E, 4, 476),
    HBD(NOTE_B, 4, 238),
    HBD(NOTE_G, 3, 238),
    HBD(NOTE_D, 3, 476),
    HBD(NOTE_G, 3, 476),
    /* Events 81-96 */
    HBD(NOTE_A, 3, 476),
    HBD(NOTE_G, 4, 238),
    HBD(NOTE_B, 3, 238),
    HBD(NOTE_G, 4, 476),
    HBD(NOTE_A, 4, 238),
    HBD(NOTE_G, 3, 238),
    HBD(NOTE_D, 3, 476),
    HBD(NOTE_G, 4, 238),
    HBD(NOTE_G, 3, 238),
    HBD(NOTE_A, 3, 476),
    HBD(NOTE_D, 5, 476),
    HBD(NOTE_B, 3, 476),
    HBD(NOTE_C, 5, 238),
    HBD(NOTE_C, 3, 238),
    HBD(NOTE_G, 3, 476),
    HBD(NOTE_C, 4, 476),
    /* Events 97-112 */
    HBD(NOTE_D, 4, 476),
    HBD(NOTE_G, 4, 238),
    HBD(NOTE_E, 4, 238),
    HBD(NOTE_G, 4, 476),
    HBD(NOTE_G, 5, 238),
    HBD(NOTE_C, 3, 238),
    HBD(NOTE_G, 3, 476),
    HBD(NOTE_E, 5, 238),
    HBD(NOTE_C, 4, 238),
    HBD(NOTE_D, 4, 476),
    HBD(NOTE_C, 5, 476),
    HBD(NOTE_E, 4, 476),
    HBD(NOTE_B, 4, 238),
    HBD(NOTE_D, 3, 238),
    HBD(NOTE_A, 3, 476),
    HBD(NOTE_A, 4, 238),
    /* Events 113-128 */
    HBD(NOTE_D, 4, 238),
    HBD(NOTE_E, 4, 476),
    HBD(NOTE_F, 5, 238),
    HBD(NOTE_F, 4, 238),
    HBD(NOTE_F, 5, 476),
    HBD(NOTE_E, 5, 238),
    HBD(NOTE_G, 3, 238),
    HBD(NOTE_D, 3, 476),
    HBD(NOTE_C, 5, 238),
    HBD(NOTE_G, 3, 238),
    HBD(NOTE_A, 3, 476),
    HBD(NOTE_D, 5, 476),
    HBD(NOTE_B, 3, 476),
    HBD(NOTE_C, 5, 238),
    HBD(NOTE_C, 3, 238),
    HBD(NOTE_G, 3, 476),
    /* Events 129-131 */
    HBD(NOTE_C, 4, 476),
    HBD(NOTE_D, 4, 476),
    HBD(NOTE_E, 4, 952)
};

#undef HBD_R
#undef HBD
