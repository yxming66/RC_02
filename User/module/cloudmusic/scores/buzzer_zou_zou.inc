/*
 * Li Ronghao - Zou Zou.
 * Single-line PWM buzzer reduction generated from PiaStudy 1EHDscVDK space data matching the provided PDF, quarter note = 59 BPM.
 * The source is PiaStudy timestamp/space data matching the provided PDF.
 * Each visible playback onset contributes one buzzer tone, so moving
 * accompaniment is preserved instead of being hidden under long held notes.
 * Simultaneous notes are reduced upper-voice first, but repeated
 * top notes fall through to another chord tone when that exposes
 * motion that would otherwise sound like a tied note.
 * Notes outside the practical buzzer range are folded by octaves into C3-C7.
 * 750 events, about 301 seconds.
 */
#define ZZ(note, octave, ms) {note, octave, (uint16_t)(ms)}
#define ZZ_R(ms) {NOTE_REST, 0, (uint16_t)(ms)}

const Tone_t ZOU_ZOU[] = {
    /* Events 1-16 */
    ZZ_R(2542),
    ZZ(NOTE_E, 4, 508),
    ZZ(NOTE_B, 3, 508),
    ZZ(NOTE_A, 3, 508),
    ZZ(NOTE_D, 3, 254),
    ZZ(NOTE_E, 4, 508),
    ZZ(NOTE_A, 3, 254),
    ZZ(NOTE_E, 4, 508),
    ZZ(NOTE_A, 3, 254),
    ZZ(NOTE_D, 4, 254),
    ZZ(NOTE_A, 3, 254),
    ZZ(NOTE_D, 4, 254),
    ZZ(NOTE_CS, 4, 508),
    ZZ(NOTE_B, 3, 508),
    ZZ(NOTE_A, 3, 508),
    ZZ(NOTE_GS, 3, 254),
    /* Events 17-32 */
    ZZ(NOTE_E, 4, 508),
    ZZ(NOTE_GS, 3, 254),
    ZZ(NOTE_E, 4, 508),
    ZZ(NOTE_GS, 3, 254),
    ZZ(NOTE_B, 3, 254),
    ZZ(NOTE_B, 3, 1017),
    ZZ(NOTE_B, 3, 1017),
    ZZ(NOTE_A, 3, 254),
    ZZ(NOTE_E, 4, 508),
    ZZ(NOTE_A, 3, 254),
    ZZ(NOTE_E, 4, 508),
    ZZ(NOTE_A, 3, 254),
    ZZ(NOTE_D, 4, 254),
    ZZ(NOTE_D, 3, 255),
    ZZ(NOTE_D, 4, 254),
    ZZ(NOTE_CS, 4, 508),
    /* Events 33-48 */
    ZZ(NOTE_B, 3, 508),
    ZZ(NOTE_A, 3, 508),
    ZZ(NOTE_GS, 3, 254),
    ZZ(NOTE_E, 4, 508),
    ZZ(NOTE_GS, 3, 254),
    ZZ(NOTE_E, 4, 508),
    ZZ(NOTE_GS, 3, 508),
    ZZ(NOTE_B, 3, 2034),
    ZZ(NOTE_D, 3, 1017),
    ZZ(NOTE_FS, 4, 254),
    ZZ(NOTE_GS, 4, 254),
    ZZ(NOTE_A, 4, 254),
    ZZ(NOTE_FS, 4, 254),
    ZZ(NOTE_GS, 4, 1017),
    ZZ(NOTE_GS, 3, 1017),
    ZZ(NOTE_CS, 3, 1017),
    /* Events 49-64 */
    ZZ(NOTE_B, 4, 254),
    ZZ(NOTE_B, 4, 254),
    ZZ(NOTE_B, 4, 254),
    ZZ(NOTE_A, 4, 254),
    ZZ(NOTE_FS, 3, 1017),
    ZZ(NOTE_FS, 3, 1017),
    ZZ(NOTE_D, 3, 1017),
    ZZ(NOTE_FS, 4, 254),
    ZZ(NOTE_GS, 4, 254),
    ZZ(NOTE_A, 4, 254),
    ZZ(NOTE_FS, 4, 254),
    ZZ(NOTE_GS, 4, 1017),
    ZZ(NOTE_B, 3, 1017),
    ZZ(NOTE_CS, 3, 763),
    ZZ(NOTE_E, 5, 254),
    ZZ(NOTE_GS, 3, 254),
    /* Events 65-80 */
    ZZ(NOTE_B, 4, 254),
    ZZ(NOTE_B, 4, 254),
    ZZ(NOTE_A, 4, 254),
    ZZ(NOTE_FS, 3, 1017),
    ZZ(NOTE_A, 3, 1017),
    ZZ(NOTE_D, 3, 763),
    ZZ(NOTE_A, 4, 254),
    ZZ(NOTE_FS, 5, 254),
    ZZ(NOTE_FS, 5, 254),
    ZZ(NOTE_FS, 5, 254),
    ZZ(NOTE_CS, 5, 254),
    ZZ(NOTE_E, 5, 508),
    ZZ(NOTE_B, 4, 508),
    ZZ(NOTE_B, 3, 1017),
    ZZ(NOTE_CS, 3, 763),
    ZZ(NOTE_E, 5, 254),
    /* Events 81-96 */
    ZZ(NOTE_CS, 4, 254),
    ZZ(NOTE_CS, 5, 254),
    ZZ(NOTE_B, 4, 254),
    ZZ(NOTE_A, 4, 254),
    ZZ(NOTE_FS, 4, 1017),
    ZZ(NOTE_A, 3, 508),
    ZZ(NOTE_B, 4, 254),
    ZZ(NOTE_A, 4, 254),
    ZZ(NOTE_CS, 5, 254),
    ZZ(NOTE_E, 5, 254),
    ZZ(NOTE_FS, 5, 254),
    ZZ(NOTE_B, 4, 254),
    ZZ(NOTE_B, 3, 254),
    ZZ(NOTE_A, 4, 508),
    ZZ(NOTE_E, 4, 254),
    ZZ(NOTE_E, 5, 508),
    /* Events 97-112 */
    ZZ(NOTE_CS, 5, 254),
    ZZ(NOTE_B, 4, 254),
    ZZ(NOTE_E, 4, 762),
    ZZ(NOTE_A, 4, 254),
    ZZ(NOTE_GS, 4, 508),
    ZZ(NOTE_FS, 4, 254),
    ZZ(NOTE_E, 4, 254),
    ZZ(NOTE_A, 3, 1016),
    ZZ(NOTE_GS, 4, 2034),
    ZZ(NOTE_D, 3, 508),
    ZZ(NOTE_A, 3, 508),
    ZZ(NOTE_FS, 4, 254),
    ZZ(NOTE_GS, 4, 254),
    ZZ(NOTE_A, 4, 254),
    ZZ(NOTE_FS, 4, 254),
    ZZ(NOTE_GS, 4, 509),
    /* Events 113-128 */
    ZZ(NOTE_B, 3, 508),
    ZZ(NOTE_E, 4, 508),
    ZZ(NOTE_B, 3, 508),
    ZZ(NOTE_CS, 3, 508),
    ZZ(NOTE_GS, 3, 508),
    ZZ(NOTE_B, 4, 254),
    ZZ(NOTE_B, 4, 254),
    ZZ(NOTE_GS, 3, 254),
    ZZ(NOTE_A, 4, 254),
    ZZ(NOTE_FS, 3, 509),
    ZZ(NOTE_CS, 3, 508),
    ZZ(NOTE_A, 3, 508),
    ZZ(NOTE_CS, 3, 508),
    ZZ(NOTE_D, 3, 508),
    ZZ(NOTE_A, 3, 508),
    ZZ(NOTE_FS, 4, 254),
    /* Events 129-144 */
    ZZ(NOTE_GS, 4, 254),
    ZZ(NOTE_A, 4, 254),
    ZZ(NOTE_FS, 4, 254),
    ZZ(NOTE_GS, 4, 508),
    ZZ(NOTE_B, 3, 508),
    ZZ(NOTE_E, 4, 508),
    ZZ(NOTE_B, 3, 508),
    ZZ(NOTE_CS, 3, 508),
    ZZ(NOTE_GS, 3, 254),
    ZZ(NOTE_E, 5, 254),
    ZZ(NOTE_CS, 4, 254),
    ZZ(NOTE_B, 4, 254),
    ZZ(NOTE_GS, 3, 254),
    ZZ(NOTE_B, 4, 254),
    ZZ(NOTE_A, 4, 508),
    ZZ(NOTE_CS, 3, 508),
    /* Events 145-160 */
    ZZ(NOTE_A, 3, 508),
    ZZ(NOTE_CS, 3, 508),
    ZZ(NOTE_D, 3, 508),
    ZZ(NOTE_A, 3, 254),
    ZZ(NOTE_A, 4, 254),
    ZZ(NOTE_FS, 5, 254),
    ZZ(NOTE_FS, 5, 254),
    ZZ(NOTE_A, 3, 254),
    ZZ(NOTE_CS, 5, 254),
    ZZ(NOTE_E, 5, 508),
    ZZ(NOTE_B, 4, 508),
    ZZ(NOTE_E, 4, 508),
    ZZ(NOTE_B, 3, 508),
    ZZ(NOTE_CS, 3, 508),
    ZZ(NOTE_GS, 3, 254),
    ZZ(NOTE_E, 5, 254),
    /* Events 161-176 */
    ZZ(NOTE_CS, 4, 254),
    ZZ(NOTE_CS, 5, 254),
    ZZ(NOTE_B, 4, 254),
    ZZ(NOTE_A, 4, 254),
    ZZ(NOTE_FS, 4, 509),
    ZZ(NOTE_CS, 3, 508),
    ZZ(NOTE_A, 3, 508),
    ZZ(NOTE_B, 4, 254),
    ZZ(NOTE_A, 4, 254),
    ZZ(NOTE_CS, 5, 254),
    ZZ(NOTE_E, 5, 254),
    ZZ(NOTE_FS, 5, 254),
    ZZ(NOTE_B, 4, 254),
    ZZ(NOTE_B, 3, 254),
    ZZ(NOTE_A, 4, 255),
    ZZ(NOTE_B, 3, 254),
    /* Events 177-192 */
    ZZ(NOTE_E, 4, 254),
    ZZ(NOTE_CS, 5, 254),
    ZZ(NOTE_E, 5, 254),
    ZZ(NOTE_FS, 5, 254),
    ZZ(NOTE_B, 4, 254),
    ZZ(NOTE_E, 3, 508),
    ZZ(NOTE_E, 4, 254),
    ZZ(NOTE_B, 4, 254),
    ZZ(NOTE_A, 4, 508),
    ZZ(NOTE_E, 3, 508),
    ZZ(NOTE_D, 4, 254),
    ZZ(NOTE_CS, 4, 254),
    ZZ(NOTE_E, 3, 508),
    ZZ(NOTE_D, 3, 508),
    ZZ(NOTE_E, 5, 508),
    ZZ(NOTE_B, 4, 508),
    /* Events 193-208 */
    ZZ(NOTE_A, 4, 508),
    ZZ(NOTE_B, 4, 254),
    ZZ(NOTE_CS, 5, 254),
    ZZ(NOTE_E, 3, 254),
    ZZ(NOTE_B, 4, 254),
    ZZ(NOTE_CS, 5, 508),
    ZZ(NOTE_E, 3, 254),
    ZZ(NOTE_B, 4, 254),
    ZZ(NOTE_FS, 3, 254),
    ZZ(NOTE_CS, 5, 254),
    ZZ(NOTE_CS, 5, 254),
    ZZ(NOTE_B, 4, 254),
    ZZ(NOTE_CS, 5, 762),
    ZZ(NOTE_CS, 5, 254),
    ZZ(NOTE_GS, 5, 254),
    ZZ(NOTE_FS, 5, 254),
    /* Events 209-224 */
    ZZ(NOTE_CS, 3, 254),
    ZZ(NOTE_CS, 5, 254),
    ZZ(NOTE_A, 4, 508),
    ZZ(NOTE_FS, 4, 254),
    ZZ(NOTE_B, 4, 254),
    ZZ(NOTE_D, 3, 255),
    ZZ(NOTE_A, 4, 762),
    ZZ(NOTE_E, 3, 763),
    ZZ(NOTE_E, 5, 254),
    ZZ(NOTE_D, 3, 254),
    ZZ(NOTE_E, 5, 254),
    ZZ(NOTE_A, 3, 254),
    ZZ(NOTE_A, 4, 254),
    ZZ(NOTE_D, 3, 255),
    ZZ(NOTE_FS, 4, 254),
    ZZ(NOTE_A, 3, 254),
    /* Events 225-240 */
    ZZ(NOTE_E, 5, 254),
    ZZ(NOTE_GS, 3, 254),
    ZZ(NOTE_E, 5, 508),
    ZZ(NOTE_A, 4, 254),
    ZZ(NOTE_FS, 3, 254),
    ZZ(NOTE_FS, 4, 508),
    ZZ(NOTE_E, 5, 254),
    ZZ(NOTE_B, 3, 508),
    ZZ(NOTE_CS, 5, 254),
    ZZ(NOTE_FS, 5, 254),
    ZZ(NOTE_B, 3, 254),
    ZZ(NOTE_A, 4, 255),
    ZZ(NOTE_FS, 3, 254),
    ZZ(NOTE_B, 4, 254),
    ZZ(NOTE_E, 3, 508),
    ZZ(NOTE_E, 5, 508),
    /* Events 241-256 */
    ZZ(NOTE_B, 4, 508),
    ZZ(NOTE_A, 4, 508),
    ZZ(NOTE_B, 4, 254),
    ZZ(NOTE_CS, 5, 254),
    ZZ(NOTE_E, 3, 254),
    ZZ(NOTE_B, 4, 254),
    ZZ(NOTE_CS, 5, 508),
    ZZ(NOTE_E, 3, 255),
    ZZ(NOTE_B, 4, 254),
    ZZ(NOTE_FS, 3, 254),
    ZZ(NOTE_CS, 5, 254),
    ZZ(NOTE_CS, 5, 254),
    ZZ(NOTE_B, 4, 254),
    ZZ(NOTE_CS, 5, 762),
    ZZ(NOTE_CS, 5, 254),
    ZZ(NOTE_GS, 5, 254),
    /* Events 257-272 */
    ZZ(NOTE_FS, 5, 254),
    ZZ(NOTE_GS, 5, 254),
    ZZ(NOTE_A, 5, 254),
    ZZ(NOTE_FS, 3, 508),
    ZZ(NOTE_CS, 5, 254),
    ZZ(NOTE_B, 4, 254),
    ZZ(NOTE_A, 4, 1017),
    ZZ(NOTE_E, 3, 508),
    ZZ(NOTE_A, 4, 254),
    ZZ(NOTE_E, 5, 254),
    ZZ(NOTE_D, 3, 254),
    ZZ(NOTE_E, 5, 254),
    ZZ(NOTE_A, 3, 254),
    ZZ(NOTE_A, 4, 254),
    ZZ(NOTE_D, 3, 255),
    ZZ(NOTE_FS, 4, 254),
    /* Events 273-288 */
    ZZ(NOTE_A, 3, 254),
    ZZ(NOTE_E, 5, 254),
    ZZ(NOTE_GS, 3, 255),
    ZZ(NOTE_E, 5, 508),
    ZZ(NOTE_A, 4, 254),
    ZZ(NOTE_FS, 3, 255),
    ZZ(NOTE_FS, 4, 508),
    ZZ(NOTE_E, 5, 254),
    ZZ(NOTE_B, 3, 254),
    ZZ(NOTE_CS, 5, 254),
    ZZ(NOTE_FS, 3, 254),
    ZZ(NOTE_B, 4, 254),
    ZZ(NOTE_B, 3, 509),
    ZZ(NOTE_FS, 3, 254),
    ZZ(NOTE_E, 5, 254),
    ZZ(NOTE_E, 3, 254),
    /* Events 289-304 */
    ZZ(NOTE_CS, 5, 254),
    ZZ(NOTE_B, 3, 254),
    ZZ(NOTE_B, 4, 254),
    ZZ(NOTE_E, 3, 254),
    ZZ(NOTE_B, 3, 254),
    ZZ(NOTE_E, 3, 254),
    ZZ(NOTE_A, 4, 254),
    ZZ(NOTE_A, 3, 254),
    ZZ(NOTE_E, 4, 254),
    ZZ(NOTE_A, 4, 254),
    ZZ(NOTE_A, 3, 254),
    ZZ(NOTE_E, 4, 763),
    ZZ(NOTE_D, 4, 254),
    ZZ(NOTE_FS, 3, 254),
    ZZ(NOTE_E, 4, 254),
    ZZ(NOTE_CS, 4, 508),
    /* Events 305-320 */
    ZZ(NOTE_B, 3, 508),
    ZZ(NOTE_A, 3, 508),
    ZZ(NOTE_FS, 3, 254),
    ZZ(NOTE_E, 4, 254),
    ZZ(NOTE_CS, 3, 255),
    ZZ(NOTE_A, 3, 254),
    ZZ(NOTE_E, 4, 508),
    ZZ(NOTE_A, 3, 254),
    ZZ(NOTE_E, 4, 254),
    ZZ(NOTE_D, 3, 254),
    ZZ(NOTE_FS, 4, 254),
    ZZ(NOTE_CS, 4, 508),
    ZZ(NOTE_B, 3, 508),
    ZZ(NOTE_A, 3, 508),
    ZZ(NOTE_D, 3, 254),
    ZZ(NOTE_E, 4, 254),
    /* Events 321-336 */
    ZZ(NOTE_A, 3, 254),
    ZZ(NOTE_A, 3, 254),
    ZZ(NOTE_E, 4, 508),
    ZZ(NOTE_FS, 3, 254),
    ZZ(NOTE_D, 4, 254),
    ZZ(NOTE_A, 3, 254),
    ZZ(NOTE_E, 4, 254),
    ZZ(NOTE_CS, 4, 508),
    ZZ(NOTE_B, 3, 508),
    ZZ(NOTE_A, 3, 508),
    ZZ(NOTE_B, 3, 254),
    ZZ(NOTE_E, 4, 508),
    ZZ(NOTE_A, 3, 254),
    ZZ(NOTE_E, 4, 254),
    ZZ(NOTE_CS, 4, 254),
    ZZ(NOTE_A, 3, 254),
    /* Events 337-352 */
    ZZ(NOTE_B, 3, 254),
    ZZ(NOTE_E, 3, 2034),
    ZZ(NOTE_D, 3, 508),
    ZZ(NOTE_A, 3, 508),
    ZZ(NOTE_FS, 4, 254),
    ZZ(NOTE_GS, 4, 254),
    ZZ(NOTE_A, 4, 254),
    ZZ(NOTE_FS, 4, 254),
    ZZ(NOTE_GS, 4, 509),
    ZZ(NOTE_B, 3, 508),
    ZZ(NOTE_E, 4, 508),
    ZZ(NOTE_B, 3, 508),
    ZZ(NOTE_CS, 3, 508),
    ZZ(NOTE_GS, 3, 508),
    ZZ(NOTE_B, 4, 254),
    ZZ(NOTE_B, 4, 254),
    /* Events 353-368 */
    ZZ(NOTE_GS, 3, 254),
    ZZ(NOTE_A, 4, 254),
    ZZ(NOTE_FS, 3, 508),
    ZZ(NOTE_CS, 3, 508),
    ZZ(NOTE_A, 3, 508),
    ZZ(NOTE_CS, 3, 508),
    ZZ(NOTE_D, 3, 508),
    ZZ(NOTE_A, 3, 508),
    ZZ(NOTE_FS, 4, 254),
    ZZ(NOTE_GS, 4, 254),
    ZZ(NOTE_A, 4, 254),
    ZZ(NOTE_FS, 4, 254),
    ZZ(NOTE_GS, 4, 508),
    ZZ(NOTE_B, 3, 508),
    ZZ(NOTE_E, 4, 508),
    ZZ(NOTE_B, 3, 508),
    /* Events 369-384 */
    ZZ(NOTE_CS, 3, 508),
    ZZ(NOTE_GS, 3, 254),
    ZZ(NOTE_E, 5, 254),
    ZZ(NOTE_CS, 4, 254),
    ZZ(NOTE_B, 4, 254),
    ZZ(NOTE_GS, 3, 254),
    ZZ(NOTE_B, 4, 254),
    ZZ(NOTE_A, 4, 508),
    ZZ(NOTE_CS, 3, 508),
    ZZ(NOTE_A, 3, 508),
    ZZ(NOTE_CS, 3, 508),
    ZZ(NOTE_D, 3, 508),
    ZZ(NOTE_A, 3, 254),
    ZZ(NOTE_A, 4, 254),
    ZZ(NOTE_FS, 5, 254),
    ZZ(NOTE_FS, 5, 254),
    /* Events 385-400 */
    ZZ(NOTE_A, 3, 254),
    ZZ(NOTE_CS, 5, 254),
    ZZ(NOTE_E, 5, 508),
    ZZ(NOTE_B, 4, 508),
    ZZ(NOTE_E, 4, 508),
    ZZ(NOTE_B, 3, 508),
    ZZ(NOTE_CS, 3, 508),
    ZZ(NOTE_GS, 3, 254),
    ZZ(NOTE_E, 5, 254),
    ZZ(NOTE_CS, 4, 254),
    ZZ(NOTE_CS, 5, 254),
    ZZ(NOTE_B, 4, 254),
    ZZ(NOTE_A, 4, 254),
    ZZ(NOTE_FS, 4, 509),
    ZZ(NOTE_CS, 3, 508),
    ZZ(NOTE_A, 3, 508),
    /* Events 401-416 */
    ZZ(NOTE_B, 4, 254),
    ZZ(NOTE_A, 4, 254),
    ZZ(NOTE_CS, 5, 254),
    ZZ(NOTE_E, 5, 254),
    ZZ(NOTE_FS, 5, 254),
    ZZ(NOTE_B, 4, 254),
    ZZ(NOTE_B, 3, 254),
    ZZ(NOTE_A, 4, 254),
    ZZ(NOTE_B, 3, 255),
    ZZ(NOTE_E, 4, 254),
    ZZ(NOTE_CS, 5, 254),
    ZZ(NOTE_E, 5, 254),
    ZZ(NOTE_FS, 5, 254),
    ZZ(NOTE_B, 4, 254),
    ZZ(NOTE_E, 3, 508),
    ZZ(NOTE_E, 4, 254),
    /* Events 417-432 */
    ZZ(NOTE_B, 4, 254),
    ZZ(NOTE_A, 4, 508),
    ZZ(NOTE_E, 3, 508),
    ZZ(NOTE_D, 4, 254),
    ZZ(NOTE_CS, 4, 254),
    ZZ(NOTE_E, 3, 508),
    ZZ(NOTE_D, 3, 508),
    ZZ(NOTE_E, 5, 508),
    ZZ(NOTE_B, 4, 508),
    ZZ(NOTE_A, 4, 508),
    ZZ(NOTE_B, 4, 254),
    ZZ(NOTE_CS, 5, 254),
    ZZ(NOTE_E, 3, 254),
    ZZ(NOTE_B, 4, 254),
    ZZ(NOTE_CS, 5, 508),
    ZZ(NOTE_E, 3, 254),
    /* Events 433-448 */
    ZZ(NOTE_B, 4, 254),
    ZZ(NOTE_FS, 3, 254),
    ZZ(NOTE_CS, 5, 254),
    ZZ(NOTE_CS, 5, 254),
    ZZ(NOTE_B, 4, 254),
    ZZ(NOTE_CS, 5, 762),
    ZZ(NOTE_CS, 5, 254),
    ZZ(NOTE_GS, 5, 254),
    ZZ(NOTE_FS, 5, 254),
    ZZ(NOTE_CS, 3, 254),
    ZZ(NOTE_CS, 5, 254),
    ZZ(NOTE_A, 4, 508),
    ZZ(NOTE_FS, 4, 254),
    ZZ(NOTE_B, 4, 254),
    ZZ(NOTE_D, 3, 255),
    ZZ(NOTE_A, 4, 762),
    /* Events 449-464 */
    ZZ(NOTE_E, 3, 763),
    ZZ(NOTE_E, 5, 254),
    ZZ(NOTE_D, 3, 254),
    ZZ(NOTE_E, 5, 255),
    ZZ(NOTE_A, 3, 254),
    ZZ(NOTE_A, 4, 254),
    ZZ(NOTE_D, 3, 254),
    ZZ(NOTE_FS, 4, 255),
    ZZ(NOTE_A, 3, 254),
    ZZ(NOTE_E, 5, 254),
    ZZ(NOTE_GS, 3, 254),
    ZZ(NOTE_E, 5, 508),
    ZZ(NOTE_A, 4, 254),
    ZZ(NOTE_FS, 3, 254),
    ZZ(NOTE_FS, 4, 508),
    ZZ(NOTE_E, 5, 254),
    /* Events 465-480 */
    ZZ(NOTE_B, 3, 508),
    ZZ(NOTE_CS, 5, 254),
    ZZ(NOTE_FS, 5, 254),
    ZZ(NOTE_B, 3, 254),
    ZZ(NOTE_A, 4, 254),
    ZZ(NOTE_FS, 3, 255),
    ZZ(NOTE_B, 4, 254),
    ZZ(NOTE_E, 3, 508),
    ZZ(NOTE_E, 5, 508),
    ZZ(NOTE_B, 4, 508),
    ZZ(NOTE_A, 4, 508),
    ZZ(NOTE_B, 4, 254),
    ZZ(NOTE_CS, 5, 254),
    ZZ(NOTE_E, 3, 254),
    ZZ(NOTE_B, 4, 254),
    ZZ(NOTE_CS, 5, 508),
    /* Events 481-496 */
    ZZ(NOTE_E, 3, 255),
    ZZ(NOTE_B, 4, 254),
    ZZ(NOTE_FS, 3, 254),
    ZZ(NOTE_CS, 5, 254),
    ZZ(NOTE_CS, 5, 254),
    ZZ(NOTE_B, 4, 254),
    ZZ(NOTE_CS, 5, 762),
    ZZ(NOTE_CS, 5, 254),
    ZZ(NOTE_GS, 5, 254),
    ZZ(NOTE_FS, 5, 254),
    ZZ(NOTE_GS, 5, 254),
    ZZ(NOTE_A, 5, 254),
    ZZ(NOTE_FS, 3, 508),
    ZZ(NOTE_CS, 5, 254),
    ZZ(NOTE_B, 4, 254),
    ZZ(NOTE_A, 4, 1016),
    /* Events 497-512 */
    ZZ(NOTE_E, 3, 509),
    ZZ(NOTE_A, 4, 254),
    ZZ(NOTE_E, 5, 254),
    ZZ(NOTE_D, 3, 254),
    ZZ(NOTE_E, 5, 254),
    ZZ(NOTE_A, 3, 254),
    ZZ(NOTE_A, 4, 254),
    ZZ(NOTE_D, 3, 255),
    ZZ(NOTE_FS, 4, 254),
    ZZ(NOTE_A, 3, 254),
    ZZ(NOTE_E, 5, 254),
    ZZ(NOTE_GS, 3, 255),
    ZZ(NOTE_E, 5, 508),
    ZZ(NOTE_A, 4, 254),
    ZZ(NOTE_FS, 3, 255),
    ZZ(NOTE_FS, 4, 508),
    /* Events 513-528 */
    ZZ(NOTE_E, 5, 254),
    ZZ(NOTE_B, 3, 254),
    ZZ(NOTE_CS, 5, 254),
    ZZ(NOTE_FS, 3, 254),
    ZZ(NOTE_B, 4, 254),
    ZZ(NOTE_B, 3, 509),
    ZZ(NOTE_FS, 3, 254),
    ZZ(NOTE_E, 5, 254),
    ZZ(NOTE_E, 3, 254),
    ZZ(NOTE_CS, 5, 254),
    ZZ(NOTE_B, 3, 254),
    ZZ(NOTE_B, 4, 254),
    ZZ(NOTE_E, 3, 509),
    ZZ(NOTE_B, 3, 254),
    ZZ(NOTE_CS, 5, 254),
    ZZ(NOTE_D, 3, 509),
    /* Events 529-544 */
    ZZ(NOTE_A, 4, 1525),
    ZZ(NOTE_D, 4, 508),
    ZZ(NOTE_CS, 4, 508),
    ZZ(NOTE_B, 3, 508),
    ZZ(NOTE_A, 3, 508),
    ZZ(NOTE_E, 4, 508),
    ZZ(NOTE_GS, 3, 508),
    ZZ(NOTE_E, 4, 254),
    ZZ(NOTE_E, 4, 254),
    ZZ(NOTE_GS, 3, 508),
    ZZ(NOTE_D, 4, 508),
    ZZ(NOTE_CS, 4, 508),
    ZZ(NOTE_B, 3, 508),
    ZZ(NOTE_A, 3, 508),
    ZZ(NOTE_A, 3, 254),
    ZZ(NOTE_E, 4, 508),
    /* Events 545-560 */
    ZZ(NOTE_A, 3, 254),
    ZZ(NOTE_E, 4, 508),
    ZZ(NOTE_A, 3, 508),
    ZZ(NOTE_D, 4, 508),
    ZZ(NOTE_CS, 4, 508),
    ZZ(NOTE_B, 3, 508),
    ZZ(NOTE_A, 3, 508),
    ZZ(NOTE_A, 3, 254),
    ZZ(NOTE_E, 4, 508),
    ZZ(NOTE_A, 3, 254),
    ZZ(NOTE_E, 4, 509),
    ZZ(NOTE_A, 3, 508),
    ZZ(NOTE_D, 4, 508),
    ZZ(NOTE_CS, 4, 508),
    ZZ(NOTE_E, 5, 254),
    ZZ(NOTE_D, 5, 254),
    /* Events 561-576 */
    ZZ(NOTE_CS, 5, 254),
    ZZ(NOTE_D, 5, 254),
    ZZ(NOTE_E, 5, 508),
    ZZ(NOTE_B, 4, 508),
    ZZ(NOTE_E, 4, 763),
    ZZ(NOTE_CS, 4, 254),
    ZZ(NOTE_B, 4, 509),
    ZZ(NOTE_CS, 4, 508),
    ZZ(NOTE_B, 3, 508),
    ZZ(NOTE_A, 3, 508),
    ZZ(NOTE_A, 4, 508),
    ZZ(NOTE_A, 3, 508),
    ZZ(NOTE_CS, 4, 508),
    ZZ(NOTE_D, 5, 508),
    ZZ(NOTE_FS, 3, 508),
    ZZ(NOTE_CS, 5, 508),
    /* Events 577-592 */
    ZZ(NOTE_B, 4, 508),
    ZZ(NOTE_A, 4, 508),
    ZZ(NOTE_E, 4, 508),
    ZZ(NOTE_FS, 3, 508),
    ZZ(NOTE_E, 4, 508),
    ZZ(NOTE_FS, 3, 254),
    ZZ(NOTE_CS, 4, 254),
    ZZ(NOTE_D, 4, 508),
    ZZ(NOTE_CS, 4, 508),
    ZZ(NOTE_B, 3, 508),
    ZZ(NOTE_A, 3, 508),
    ZZ(NOTE_B, 3, 2034),
    ZZ_R(508),
    ZZ(NOTE_E, 5, 508),
    ZZ(NOTE_CS, 5, 254),
    ZZ(NOTE_B, 4, 254),
    /* Events 593-608 */
    ZZ(NOTE_A, 4, 508),
    ZZ(NOTE_B, 4, 254),
    ZZ(NOTE_CS, 5, 254),
    ZZ(NOTE_CS, 5, 254),
    ZZ(NOTE_B, 4, 254),
    ZZ(NOTE_CS, 5, 763),
    ZZ(NOTE_B, 4, 254),
    ZZ(NOTE_D, 4, 255),
    ZZ(NOTE_CS, 5, 254),
    ZZ(NOTE_CS, 5, 254),
    ZZ(NOTE_B, 4, 254),
    ZZ(NOTE_CS, 5, 763),
    ZZ(NOTE_CS, 5, 254),
    ZZ(NOTE_GS, 5, 254),
    ZZ(NOTE_FS, 5, 254),
    ZZ(NOTE_FS, 5, 254),
    /* Events 609-624 */
    ZZ(NOTE_CS, 5, 254),
    ZZ(NOTE_A, 4, 508),
    ZZ(NOTE_FS, 4, 254),
    ZZ(NOTE_B, 4, 254),
    ZZ(NOTE_D, 4, 254),
    ZZ(NOTE_A, 4, 763),
    ZZ(NOTE_CS, 4, 763),
    ZZ(NOTE_E, 5, 254),
    ZZ(NOTE_A, 3, 254),
    ZZ(NOTE_E, 5, 508),
    ZZ(NOTE_A, 4, 254),
    ZZ(NOTE_A, 4, 254),
    ZZ(NOTE_FS, 4, 508),
    ZZ(NOTE_E, 5, 254),
    ZZ(NOTE_GS, 3, 254),
    ZZ(NOTE_E, 5, 508),
    /* Events 625-640 */
    ZZ(NOTE_A, 4, 254),
    ZZ(NOTE_FS, 3, 254),
    ZZ(NOTE_FS, 4, 508),
    ZZ(NOTE_E, 5, 254),
    ZZ(NOTE_B, 3, 508),
    ZZ(NOTE_CS, 5, 254),
    ZZ(NOTE_FS, 5, 254),
    ZZ(NOTE_B, 3, 254),
    ZZ(NOTE_A, 4, 508),
    ZZ(NOTE_B, 4, 254),
    ZZ(NOTE_E, 3, 254),
    ZZ(NOTE_B, 3, 254),
    ZZ(NOTE_E, 5, 508),
    ZZ(NOTE_CS, 5, 254),
    ZZ(NOTE_B, 4, 254),
    ZZ(NOTE_A, 4, 508),
    /* Events 641-656 */
    ZZ(NOTE_B, 4, 254),
    ZZ(NOTE_CS, 5, 254),
    ZZ(NOTE_E, 3, 254),
    ZZ(NOTE_B, 4, 254),
    ZZ(NOTE_CS, 5, 508),
    ZZ(NOTE_E, 3, 254),
    ZZ(NOTE_B, 4, 254),
    ZZ(NOTE_FS, 3, 255),
    ZZ(NOTE_CS, 5, 254),
    ZZ(NOTE_CS, 5, 254),
    ZZ(NOTE_B, 4, 254),
    ZZ(NOTE_CS, 5, 763),
    ZZ(NOTE_CS, 5, 254),
    ZZ(NOTE_GS, 5, 254),
    ZZ(NOTE_FS, 5, 254),
    ZZ(NOTE_GS, 5, 254),
    /* Events 657-672 */
    ZZ(NOTE_A, 5, 254),
    ZZ(NOTE_FS, 3, 508),
    ZZ(NOTE_CS, 5, 254),
    ZZ(NOTE_B, 4, 254),
    ZZ(NOTE_D, 3, 255),
    ZZ(NOTE_A, 4, 762),
    ZZ(NOTE_E, 3, 763),
    ZZ(NOTE_E, 5, 254),
    ZZ(NOTE_D, 3, 254),
    ZZ(NOTE_E, 5, 255),
    ZZ(NOTE_A, 3, 254),
    ZZ(NOTE_A, 4, 254),
    ZZ(NOTE_D, 4, 254),
    ZZ(NOTE_FS, 4, 255),
    ZZ(NOTE_A, 3, 254),
    ZZ(NOTE_A, 5, 254),
    /* Events 673-688 */
    ZZ(NOTE_A, 3, 254),
    ZZ(NOTE_A, 5, 508),
    ZZ(NOTE_A, 4, 254),
    ZZ(NOTE_FS, 3, 254),
    ZZ(NOTE_FS, 4, 508),
    ZZ(NOTE_E, 5, 254),
    ZZ(NOTE_B, 3, 254),
    ZZ(NOTE_CS, 5, 254),
    ZZ(NOTE_FS, 3, 254),
    ZZ(NOTE_B, 4, 254),
    ZZ(NOTE_B, 3, 508),
    ZZ(NOTE_FS, 3, 255),
    ZZ(NOTE_E, 5, 254),
    ZZ(NOTE_E, 3, 254),
    ZZ(NOTE_CS, 5, 254),
    ZZ(NOTE_B, 3, 254),
    /* Events 689-704 */
    ZZ(NOTE_B, 4, 254),
    ZZ(NOTE_E, 3, 508),
    ZZ(NOTE_B, 3, 255),
    ZZ(NOTE_CS, 5, 254),
    ZZ(NOTE_FS, 3, 508),
    ZZ(NOTE_A, 4, 509),
    ZZ(NOTE_GS, 3, 254),
    ZZ(NOTE_FS, 3, 254),
    ZZ(NOTE_E, 3, 508),
    ZZ(NOTE_A, 4, 2034),
    ZZ(NOTE_DS, 3, 1779),
    ZZ(NOTE_E, 5, 254),
    ZZ(NOTE_B, 3, 254),
    ZZ(NOTE_CS, 5, 254),
    ZZ(NOTE_CS, 5, 254),
    ZZ(NOTE_B, 4, 254),
    /* Events 705-720 */
    ZZ(NOTE_B, 3, 763),
    ZZ(NOTE_E, 5, 254),
    ZZ(NOTE_E, 3, 254),
    ZZ(NOTE_CS, 5, 254),
    ZZ(NOTE_CS, 5, 254),
    ZZ(NOTE_B, 4, 254),
    ZZ(NOTE_B, 4, 3051),
    ZZ(NOTE_E, 3, 1526),
    ZZ(NOTE_CS, 5, 508),
    ZZ(NOTE_A, 4, 508),
    ZZ(NOTE_E, 4, 508),
    ZZ(NOTE_B, 3, 508),
    ZZ(NOTE_A, 3, 508),
    ZZ(NOTE_D, 3, 254),
    ZZ(NOTE_E, 4, 508),
    ZZ(NOTE_A, 3, 254),
    /* Events 721-736 */
    ZZ(NOTE_E, 4, 508),
    ZZ(NOTE_A, 3, 254),
    ZZ(NOTE_D, 4, 254),
    ZZ(NOTE_D, 4, 508),
    ZZ(NOTE_CS, 4, 508),
    ZZ(NOTE_B, 3, 508),
    ZZ(NOTE_A, 3, 508),
    ZZ(NOTE_GS, 3, 254),
    ZZ(NOTE_E, 4, 508),
    ZZ(NOTE_GS, 3, 254),
    ZZ(NOTE_E, 4, 508),
    ZZ(NOTE_GS, 3, 508),
    ZZ(NOTE_GS, 3, 2034),
    ZZ(NOTE_A, 3, 254),
    ZZ(NOTE_E, 4, 508),
    ZZ(NOTE_A, 3, 254),
    /* Events 737-750 */
    ZZ(NOTE_E, 4, 508),
    ZZ(NOTE_A, 3, 254),
    ZZ(NOTE_D, 4, 254),
    ZZ(NOTE_D, 3, 509),
    ZZ(NOTE_CS, 4, 508),
    ZZ(NOTE_B, 3, 508),
    ZZ(NOTE_A, 3, 508),
    ZZ(NOTE_GS, 3, 254),
    ZZ(NOTE_E, 4, 508),
    ZZ(NOTE_GS, 3, 254),
    ZZ(NOTE_E, 4, 508),
    ZZ(NOTE_GS, 3, 508),
    ZZ(NOTE_GS, 3, 2034),
    ZZ(NOTE_E, 4, 4068)
};

#undef ZZ_R
#undef ZZ
