/*
 * JJ Lin - Gu Shi Xi Ni.
 * Single-line PWM buzzer reduction generated from local PDF / PiaStudy 1hLQ4DSx4ds MIDI.
 * The right-hand line is preferred at simultaneous onsets; bass notes
 * are folded by octaves into the practical buzzer range.
 * 793 events, about 206 seconds.
 */
#define FD(note, octave, ms) {note, octave, (uint16_t)(ms)}
#define FD_R(ms) {NOTE_REST, 0, (uint16_t)(ms)}

const Tone_t GU_SHI_XI_NI[] = {
    /* Events 1-16 */
    FD(NOTE_A, 3, 250),
    FD(NOTE_E, 3, 250),
    FD(NOTE_G, 3, 250),
    FD(NOTE_C, 4, 250),
    FD_R(500),
    FD(NOTE_A, 3, 250),
    FD(NOTE_E, 3, 250),
    FD(NOTE_G, 3, 250),
    FD(NOTE_D, 4, 250),
    FD_R(1500),
    FD(NOTE_A, 3, 250),
    FD(NOTE_E, 3, 250),
    FD(NOTE_G, 3, 250),
    FD(NOTE_C, 4, 250),
    FD_R(500),
    FD(NOTE_A, 3, 250),
    /* Events 17-32 */
    FD(NOTE_E, 3, 250),
    FD(NOTE_G, 3, 250),
    FD(NOTE_D, 4, 250),
    FD(NOTE_C, 4, 250),
    FD(NOTE_G, 3, 250),
    FD_R(1000),
    FD(NOTE_A, 3, 250),
    FD(NOTE_E, 3, 250),
    FD(NOTE_G, 3, 250),
    FD(NOTE_B, 3, 250),
    FD(NOTE_C, 4, 250),
    FD(NOTE_G, 3, 250),
    FD(NOTE_A, 3, 250),
    FD(NOTE_E, 3, 250),
    FD(NOTE_G, 3, 250),
    FD(NOTE_D, 4, 250),
    /* Events 33-48 */
    FD_R(2000),
    FD(NOTE_A, 3, 250),
    FD(NOTE_E, 3, 250),
    FD(NOTE_G, 3, 250),
    FD(NOTE_B, 3, 250),
    FD(NOTE_C, 4, 250),
    FD(NOTE_G, 3, 250),
    FD(NOTE_A, 3, 217),
    FD(NOTE_B, 4, 33),
    FD(NOTE_C, 5, 250),
    FD(NOTE_B, 4, 250),
    FD(NOTE_G, 4, 250),
    FD(NOTE_C, 4, 250),
    FD(NOTE_G, 3, 250),
    FD(NOTE_A, 4, 250),
    FD(NOTE_C, 3, 250),
    /* Events 49-64 */
    FD(NOTE_G, 3, 250),
    FD(NOTE_C, 5, 250),
    FD(NOTE_B, 4, 250),
    FD(NOTE_G, 4, 250),
    FD(NOTE_A, 4, 250),
    FD(NOTE_D, 3, 250),
    FD(NOTE_G, 3, 250),
    FD(NOTE_C, 5, 250),
    FD(NOTE_B, 4, 250),
    FD(NOTE_G, 4, 250),
    FD(NOTE_A, 4, 500),
    FD(NOTE_E, 4, 250),
    FD(NOTE_E, 3, 250),
    FD(NOTE_G, 3, 250),
    FD(NOTE_C, 4, 250),
    FD_R(500),
    /* Events 65-80 */
    FD(NOTE_A, 3, 217),
    FD(NOTE_B, 4, 33),
    FD(NOTE_C, 5, 250),
    FD(NOTE_B, 4, 250),
    FD(NOTE_G, 4, 250),
    FD_R(500),
    FD(NOTE_A, 4, 250),
    FD(NOTE_C, 3, 250),
    FD(NOTE_G, 3, 250),
    FD(NOTE_C, 5, 250),
    FD(NOTE_B, 4, 250),
    FD(NOTE_G, 4, 250),
    FD(NOTE_A, 4, 250),
    FD(NOTE_D, 3, 250),
    FD(NOTE_G, 3, 375),
    FD(NOTE_A, 3, 125),
    /* Events 81-96 */
    FD(NOTE_B, 3, 125),
    FD(NOTE_C, 4, 125),
    FD(NOTE_D, 4, 125),
    FD(NOTE_F, 4, 125),
    FD(NOTE_E, 4, 500),
    FD(NOTE_A, 3, 250),
    FD(NOTE_E, 3, 250),
    FD(NOTE_G, 3, 250),
    FD(NOTE_C, 4, 250),
    FD_R(500),
    FD(NOTE_A, 3, 217),
    FD(NOTE_B, 4, 33),
    FD(NOTE_C, 5, 250),
    FD(NOTE_B, 4, 250),
    FD(NOTE_G, 4, 250),
    FD_R(500),
    /* Events 97-112 */
    FD(NOTE_A, 4, 250),
    FD(NOTE_C, 3, 250),
    FD(NOTE_G, 3, 250),
    FD(NOTE_C, 5, 250),
    FD(NOTE_B, 4, 250),
    FD(NOTE_G, 4, 250),
    FD(NOTE_A, 4, 250),
    FD(NOTE_D, 3, 250),
    FD(NOTE_G, 3, 250),
    FD(NOTE_C, 5, 250),
    FD(NOTE_B, 4, 250),
    FD(NOTE_G, 4, 250),
    FD(NOTE_A, 4, 500),
    FD(NOTE_E, 4, 250),
    FD(NOTE_E, 3, 250),
    FD(NOTE_G, 3, 250),
    /* Events 113-128 */
    FD(NOTE_C, 4, 250),
    FD_R(500),
    FD(NOTE_A, 3, 217),
    FD(NOTE_B, 4, 33),
    FD(NOTE_C, 5, 250),
    FD(NOTE_B, 4, 250),
    FD(NOTE_G, 4, 250),
    FD_R(500),
    FD(NOTE_A, 4, 250),
    FD(NOTE_C, 3, 250),
    FD(NOTE_G, 3, 250),
    FD(NOTE_C, 5, 250),
    FD(NOTE_B, 4, 250),
    FD(NOTE_G, 4, 250),
    FD(NOTE_A, 4, 250),
    FD(NOTE_D, 3, 250),
    /* Events 129-144 */
    FD(NOTE_G, 3, 250),
    FD(NOTE_A, 3, 125),
    FD(NOTE_B, 3, 125),
    FD(NOTE_C, 4, 125),
    FD(NOTE_D, 4, 125),
    FD(NOTE_E, 4, 125),
    FD(NOTE_F, 4, 125),
    FD(NOTE_E, 4, 250),
    FD(NOTE_E, 3, 250),
    FD(NOTE_G, 3, 250),
    FD(NOTE_C, 5, 250),
    FD(NOTE_D, 5, 250),
    FD(NOTE_E, 5, 250),
    FD(NOTE_A, 4, 250),
    FD(NOTE_E, 3, 250),
    FD(NOTE_G, 3, 250),
    /* Events 145-160 */
    FD(NOTE_C, 4, 250),
    FD(NOTE_B, 3, 250),
    FD(NOTE_G, 3, 250),
    FD(NOTE_A, 3, 250),
    FD(NOTE_C, 3, 250),
    FD(NOTE_E, 4, 250),
    FD(NOTE_C, 4, 250),
    FD(NOTE_B, 3, 250),
    FD(NOTE_G, 3, 250),
    FD(NOTE_A, 3, 250),
    FD(NOTE_D, 3, 250),
    FD(NOTE_D, 4, 250),
    FD(NOTE_C, 4, 250),
    FD(NOTE_B, 3, 250),
    FD(NOTE_G, 3, 250),
    FD(NOTE_C, 4, 250),
    /* Events 161-176 */
    FD(NOTE_B, 3, 250),
    FD(NOTE_C, 6, 250),
    FD(NOTE_C, 4, 250),
    FD(NOTE_A, 5, 250),
    FD(NOTE_A, 3, 250),
    FD(NOTE_E, 5, 250),
    FD(NOTE_E, 3, 250),
    FD(NOTE_C, 5, 250),
    FD(NOTE_E, 3, 125),
    FD(NOTE_C, 3, 125),
    FD(NOTE_A, 3, 250),
    FD_R(250),
    FD(NOTE_A, 3, 250),
    FD(NOTE_C, 3, 250),
    FD(NOTE_E, 4, 250),
    FD(NOTE_C, 4, 250),
    /* Events 177-192 */
    FD(NOTE_B, 3, 250),
    FD(NOTE_G, 3, 250),
    FD(NOTE_A, 3, 250),
    FD(NOTE_D, 3, 250),
    FD(NOTE_E, 4, 250),
    FD(NOTE_G, 3, 250),
    FD(NOTE_D, 4, 250),
    FD(NOTE_C, 4, 250),
    FD(NOTE_B, 3, 250),
    FD(NOTE_E, 3, 250),
    FD(NOTE_C, 6, 250),
    FD(NOTE_B, 5, 500),
    FD(NOTE_G, 5, 500),
    FD(NOTE_E, 3, 250),
    FD(NOTE_D, 5, 250),
    FD(NOTE_B, 3, 250),
    /* Events 193-208 */
    FD(NOTE_A, 4, 250),
    FD(NOTE_G, 3, 250),
    FD(NOTE_A, 3, 25),
    FD(NOTE_E, 4, 25),
    FD(NOTE_C, 5, 200),
    FD(NOTE_A, 4, 125),
    FD(NOTE_A, 3, 125),
    FD(NOTE_E, 4, 250),
    FD(NOTE_C, 4, 250),
    FD(NOTE_D, 4, 125),
    FD(NOTE_A, 3, 375),
    FD(NOTE_B, 3, 25),
    FD(NOTE_E, 4, 25),
    FD(NOTE_C, 5, 200),
    FD(NOTE_A, 4, 125),
    FD(NOTE_B, 3, 125),
    /* Events 209-224 */
    FD(NOTE_E, 4, 250),
    FD(NOTE_D, 4, 250),
    FD(NOTE_E, 4, 125),
    FD(NOTE_B, 3, 125),
    FD(NOTE_B, 4, 250),
    FD(NOTE_B, 3, 25),
    FD(NOTE_E, 4, 25),
    FD(NOTE_B, 4, 200),
    FD(NOTE_A, 4, 250),
    FD(NOTE_E, 4, 250),
    FD(NOTE_C, 4, 250),
    FD(NOTE_D, 4, 250),
    FD(NOTE_A, 3, 275),
    FD(NOTE_E, 4, 25),
    FD(NOTE_C, 5, 200),
    FD(NOTE_A, 4, 250),
    /* Events 225-240 */
    FD(NOTE_E, 4, 250),
    FD(NOTE_C, 4, 250),
    FD(NOTE_A, 3, 250),
    FD(NOTE_E, 3, 250),
    FD(NOTE_A, 3, 25),
    FD(NOTE_E, 4, 25),
    FD(NOTE_C, 5, 200),
    FD(NOTE_A, 4, 125),
    FD(NOTE_A, 3, 125),
    FD(NOTE_E, 4, 250),
    FD(NOTE_C, 4, 250),
    FD(NOTE_D, 4, 125),
    FD(NOTE_A, 3, 375),
    FD(NOTE_B, 3, 25),
    FD(NOTE_E, 4, 25),
    FD(NOTE_B, 4, 200),
    /* Events 241-256 */
    FD(NOTE_A, 4, 125),
    FD(NOTE_B, 3, 125),
    FD(NOTE_E, 4, 250),
    FD(NOTE_D, 4, 250),
    FD(NOTE_E, 4, 125),
    FD(NOTE_B, 3, 125),
    FD(NOTE_B, 4, 250),
    FD(NOTE_B, 3, 25),
    FD(NOTE_E, 4, 25),
    FD(NOTE_B, 4, 200),
    FD(NOTE_A, 4, 250),
    FD(NOTE_E, 4, 250),
    FD(NOTE_C, 4, 250),
    FD(NOTE_D, 4, 250),
    FD(NOTE_A, 3, 250),
    FD(NOTE_C, 5, 250),
    /* Events 257-272 */
    FD(NOTE_A, 4, 250),
    FD(NOTE_E, 4, 500),
    FD(NOTE_C, 5, 125),
    FD(NOTE_E, 3, 125),
    FD(NOTE_B, 4, 250),
    FD(NOTE_C, 5, 500),
    FD(NOTE_E, 3, 250),
    FD(NOTE_C, 5, 250),
    FD(NOTE_D, 5, 125),
    FD(NOTE_E, 3, 125),
    FD(NOTE_E, 5, 750),
    FD(NOTE_F, 5, 250),
    FD(NOTE_G, 3, 250),
    FD(NOTE_A, 4, 125),
    FD(NOTE_C, 3, 125),
    FD(NOTE_C, 5, 750),
    /* Events 273-288 */
    FD(NOTE_B, 4, 500),
    FD(NOTE_G, 5, 250),
    FD(NOTE_F, 5, 250),
    FD(NOTE_E, 5, 250),
    FD(NOTE_E, 3, 250),
    FD(NOTE_D, 5, 500),
    FD(NOTE_E, 3, 250),
    FD(NOTE_B, 4, 250),
    FD(NOTE_C, 5, 250),
    FD(NOTE_E, 3, 125),
    FD(NOTE_G, 3, 125),
    FD(NOTE_C, 4, 125),
    FD(NOTE_D, 4, 125),
    FD(NOTE_C, 5, 250),
    FD(NOTE_D, 5, 250),
    FD(NOTE_E, 5, 275),
    /* Events 289-304 */
    FD(NOTE_C, 3, 25),
    FD(NOTE_A, 3, 450),
    FD(NOTE_D, 5, 250),
    FD(NOTE_C, 3, 250),
    FD(NOTE_A, 4, 250),
    FD(NOTE_C, 5, 500),
    FD(NOTE_B, 3, 250),
    FD(NOTE_B, 4, 250),
    FD(NOTE_B, 3, 500),
    FD(NOTE_E, 3, 375),
    FD(NOTE_B, 3, 125),
    FD(NOTE_E, 3, 125),
    FD(NOTE_GS, 3, 125),
    FD(NOTE_B, 3, 125),
    FD(NOTE_C, 4, 125),
    FD(NOTE_E, 5, 125),
    /* Events 305-320 */
    FD(NOTE_C, 4, 125),
    FD(NOTE_C, 6, 125),
    FD(NOTE_GS, 3, 125),
    FD(NOTE_B, 5, 250),
    FD(NOTE_C, 6, 250),
    FD(NOTE_E, 3, 125),
    FD(NOTE_A, 3, 125),
    FD(NOTE_C, 3, 125),
    FD(NOTE_E, 3, 125),
    FD(NOTE_C, 6, 250),
    FD(NOTE_D, 6, 250),
    FD(NOTE_E, 6, 500),
    FD(NOTE_C, 3, 125),
    FD(NOTE_F, 3, 125),
    FD(NOTE_F, 6, 125),
    FD(NOTE_C, 4, 125),
    /* Events 321-336 */
    FD(NOTE_F, 4, 250),
    FD(NOTE_F, 3, 250),
    FD(NOTE_A, 6, 250),
    FD(NOTE_D, 6, 250),
    FD(NOTE_D, 3, 250),
    FD(NOTE_G, 3, 250),
    FD(NOTE_B, 3, 250),
    FD(NOTE_G, 6, 250),
    FD(NOTE_F, 6, 250),
    FD(NOTE_E, 6, 250),
    FD(NOTE_E, 3, 125),
    FD(NOTE_A, 3, 125),
    FD(NOTE_D, 6, 500),
    FD(NOTE_E, 3, 125),
    FD(NOTE_B, 3, 125),
    FD(NOTE_B, 5, 250),
    /* Events 337-352 */
    FD(NOTE_C, 6, 250),
    FD(NOTE_E, 3, 125),
    FD(NOTE_B, 3, 125),
    FD(NOTE_C, 4, 125),
    FD(NOTE_D, 4, 125),
    FD(NOTE_C, 5, 250),
    FD(NOTE_D, 5, 250),
    FD(NOTE_E, 5, 500),
    FD(NOTE_D, 5, 250),
    FD(NOTE_C, 5, 250),
    FD(NOTE_E, 5, 250),
    FD(NOTE_D, 5, 250),
    FD(NOTE_C, 5, 250),
    FD(NOTE_D, 5, 250),
    FD(NOTE_D, 3, 250),
    FD(NOTE_G, 3, 250),
    /* Events 353-368 */
    FD(NOTE_D, 3, 250),
    FD(NOTE_G, 3, 250),
    FD(NOTE_C, 4, 250),
    FD(NOTE_B, 3, 250),
    FD(NOTE_G, 3, 250),
    FD(NOTE_D, 3, 250),
    FD(NOTE_B, 3, 250),
    FD(NOTE_A, 4, 250),
    FD(NOTE_C, 5, 250),
    FD(NOTE_E, 5, 1250),
    FD(NOTE_F, 5, 250),
    FD(NOTE_E, 5, 250),
    FD(NOTE_D, 3, 250),
    FD(NOTE_D, 5, 250),
    FD(NOTE_G, 3, 250),
    FD(NOTE_E, 5, 250),
    /* Events 369-384 */
    FD(NOTE_F, 5, 250),
    FD(NOTE_G, 5, 1250),
    FD(NOTE_A, 5, 250),
    FD(NOTE_C, 5, 250),
    FD(NOTE_D, 4, 250),
    FD(NOTE_A, 3, 217),
    FD(NOTE_B, 4, 33),
    FD(NOTE_C, 5, 250),
    FD(NOTE_B, 4, 250),
    FD(NOTE_G, 4, 250),
    FD_R(500),
    FD(NOTE_E, 4, 250),
    FD(NOTE_C, 3, 250),
    FD(NOTE_G, 3, 250),
    FD(NOTE_C, 5, 250),
    FD(NOTE_B, 4, 250),
    /* Events 385-400 */
    FD(NOTE_G, 4, 250),
    FD(NOTE_E, 4, 250),
    FD(NOTE_D, 3, 250),
    FD(NOTE_G, 3, 250),
    FD(NOTE_C, 5, 250),
    FD(NOTE_B, 4, 250),
    FD(NOTE_G, 4, 250),
    FD(NOTE_A, 4, 250),
    FD(NOTE_E, 3, 250),
    FD(NOTE_G, 3, 250),
    FD(NOTE_C, 4, 500),
    FD_R(250),
    FD(NOTE_A, 3, 250),
    FD(NOTE_C, 5, 250),
    FD(NOTE_B, 4, 250),
    FD(NOTE_D, 4, 500),
    /* Events 401-416 */
    FD_R(250),
    FD(NOTE_A, 3, 250),
    FD(NOTE_E, 4, 750),
    FD(NOTE_C, 4, 250),
    FD(NOTE_G, 3, 250),
    FD(NOTE_A, 3, 250),
    FD(NOTE_E, 3, 250),
    FD(NOTE_G, 3, 250),
    FD(NOTE_B, 3, 250),
    FD(NOTE_C, 4, 250),
    FD(NOTE_G, 3, 250),
    FD(NOTE_A, 3, 250),
    FD(NOTE_E, 3, 250),
    FD(NOTE_G, 3, 250),
    FD(NOTE_D, 4, 250),
    FD(NOTE_C, 4, 250),
    /* Events 417-432 */
    FD(NOTE_G, 3, 250),
    FD(NOTE_A, 3, 250),
    FD(NOTE_E, 3, 250),
    FD(NOTE_G, 3, 250),
    FD(NOTE_B, 3, 250),
    FD(NOTE_C, 4, 250),
    FD(NOTE_G, 3, 250),
    FD_R(500),
    FD(NOTE_A, 3, 217),
    FD(NOTE_B, 4, 33),
    FD(NOTE_C, 5, 250),
    FD(NOTE_B, 4, 250),
    FD(NOTE_G, 4, 250),
    FD(NOTE_A, 4, 250),
    FD(NOTE_G, 3, 250),
    FD(NOTE_F, 3, 250),
    /* Events 433-448 */
    FD(NOTE_C, 5, 250),
    FD(NOTE_B, 4, 250),
    FD(NOTE_G, 4, 250),
    FD_R(250),
    FD(NOTE_F, 3, 250),
    FD(NOTE_A, 4, 250),
    FD(NOTE_D, 3, 250),
    FD(NOTE_G, 3, 250),
    FD(NOTE_C, 5, 250),
    FD(NOTE_B, 4, 250),
    FD(NOTE_G, 4, 250),
    FD(NOTE_A, 4, 250),
    FD(NOTE_E, 3, 250),
    FD(NOTE_E, 4, 250),
    FD(NOTE_C, 4, 750),
    FD_R(500),
    /* Events 449-464 */
    FD(NOTE_A, 3, 217),
    FD(NOTE_B, 4, 33),
    FD(NOTE_C, 5, 250),
    FD(NOTE_B, 4, 250),
    FD(NOTE_G, 4, 250),
    FD(NOTE_A, 4, 500),
    FD(NOTE_F, 3, 250),
    FD(NOTE_C, 5, 250),
    FD(NOTE_B, 4, 250),
    FD(NOTE_G, 4, 250),
    FD_R(250),
    FD(NOTE_F, 3, 250),
    FD(NOTE_A, 4, 875),
    FD(NOTE_B, 4, 125),
    FD(NOTE_C, 5, 125),
    FD(NOTE_D, 5, 125),
    /* Events 465-480 */
    FD(NOTE_E, 5, 125),
    FD(NOTE_B, 5, 125),
    FD(NOTE_A, 5, 250),
    FD(NOTE_D, 3, 250),
    FD(NOTE_G, 3, 217),
    FD(NOTE_E, 4, 33),
    FD(NOTE_GS, 4, 217),
    FD(NOTE_F, 4, 33),
    FD(NOTE_A, 4, 217),
    FD(NOTE_G, 4, 33),
    FD(NOTE_B, 4, 250),
    FD(NOTE_A, 3, 250),
    FD(NOTE_E, 3, 250),
    FD(NOTE_G, 3, 250),
    FD(NOTE_C, 4, 500),
    FD_R(217),
    /* Events 481-496 */
    FD(NOTE_F, 4, 33),
    FD(NOTE_A, 4, 217),
    FD(NOTE_G, 4, 33),
    FD(NOTE_B, 4, 217),
    FD(NOTE_A, 4, 33),
    FD(NOTE_C, 5, 217),
    FD(NOTE_G, 4, 33),
    FD(NOTE_B, 4, 217),
    FD(NOTE_A, 4, 33),
    FD(NOTE_C, 5, 217),
    FD(NOTE_B, 4, 33),
    FD(NOTE_D, 5, 250),
    FD(NOTE_E, 5, 1000),
    FD(NOTE_D, 5, 250),
    FD(NOTE_C, 5, 250),
    FD(NOTE_C, 4, 750),
    /* Events 497-512 */
    FD(NOTE_G, 3, 750),
    FD(NOTE_E, 3, 250),
    FD(NOTE_C, 3, 250),
    FD(NOTE_F, 3, 250),
    FD(NOTE_F, 4, 717),
    FD(NOTE_C, 5, 33),
    FD(NOTE_D, 5, 500),
    FD(NOTE_C, 5, 217),
    FD(NOTE_B, 4, 33),
    FD(NOTE_C, 5, 250),
    FD(NOTE_B, 4, 250),
    FD(NOTE_A, 4, 250),
    FD(NOTE_G, 4, 250),
    FD(NOTE_G, 3, 250),
    FD(NOTE_F, 5, 500),
    FD(NOTE_E, 5, 250),
    /* Events 513-528 */
    FD(NOTE_D, 5, 250),
    FD(NOTE_E, 3, 250),
    FD(NOTE_E, 4, 750),
    FD(NOTE_C, 5, 250),
    FD(NOTE_E, 3, 250),
    FD(NOTE_G, 3, 250),
    FD(NOTE_C, 5, 125),
    FD(NOTE_D, 5, 125),
    FD(NOTE_C, 5, 125),
    FD(NOTE_B, 4, 125),
    FD(NOTE_C, 5, 125),
    FD(NOTE_B, 4, 125),
    FD(NOTE_A, 4, 250),
    FD(NOTE_C, 3, 250),
    FD(NOTE_E, 3, 250),
    FD(NOTE_G, 3, 125),
    /* Events 529-544 */
    FD(NOTE_C, 5, 125),
    FD(NOTE_B, 4, 125),
    FD(NOTE_A, 4, 125),
    FD(NOTE_B, 4, 125),
    FD(NOTE_G, 4, 125),
    FD(NOTE_A, 4, 125),
    FD(NOTE_G, 4, 125),
    FD(NOTE_A, 4, 375),
    FD(NOTE_D, 4, 125),
    FD(NOTE_A, 4, 125),
    FD(NOTE_C, 4, 125),
    FD(NOTE_A, 4, 375),
    FD(NOTE_B, 3, 125),
    FD(NOTE_A, 3, 250),
    FD(NOTE_C, 4, 250),
    FD(NOTE_A, 3, 250),
    /* Events 545-560 */
    FD(NOTE_E, 3, 250),
    FD(NOTE_C, 3, 250),
    FD(NOTE_A, 3, 250),
    FD(NOTE_B, 4, 1750),
    FD(NOTE_A, 4, 250),
    FD(NOTE_A, 3, 250),
    FD(NOTE_E, 3, 250),
    FD(NOTE_C, 3, 250),
    FD(NOTE_A, 3, 250),
    FD(NOTE_A, 4, 25),
    FD(NOTE_E, 3, 25),
    FD(NOTE_C, 4, 200),
    FD(NOTE_A, 4, 1250),
    FD(NOTE_A, 3, 250),
    FD(NOTE_C, 4, 250),
    FD(NOTE_A, 3, 250),
    /* Events 561-576 */
    FD(NOTE_E, 3, 250),
    FD(NOTE_C, 3, 250),
    FD(NOTE_A, 3, 250),
    FD(NOTE_B, 4, 1750),
    FD(NOTE_A, 4, 250),
    FD(NOTE_A, 3, 250),
    FD(NOTE_E, 3, 250),
    FD(NOTE_C, 3, 250),
    FD(NOTE_A, 3, 250),
    FD(NOTE_B, 3, 25),
    FD(NOTE_E, 3, 25),
    FD(NOTE_G, 3, 200),
    FD(NOTE_C, 4, 250),
    FD(NOTE_E, 4, 250),
    FD(NOTE_A, 4, 250),
    FD(NOTE_B, 4, 250),
    /* Events 577-592 */
    FD(NOTE_E, 5, 250),
    FD(NOTE_C, 6, 250),
    FD(NOTE_B, 5, 250),
    FD(NOTE_C, 6, 500),
    FD(NOTE_E, 3, 250),
    FD(NOTE_C, 6, 250),
    FD(NOTE_D, 6, 125),
    FD(NOTE_E, 3, 125),
    FD(NOTE_E, 6, 750),
    FD(NOTE_F, 6, 250),
    FD(NOTE_G, 3, 250),
    FD(NOTE_A, 5, 125),
    FD(NOTE_C, 3, 125),
    FD(NOTE_C, 6, 750),
    FD(NOTE_B, 4, 500),
    FD(NOTE_G, 5, 250),
    /* Events 593-608 */
    FD(NOTE_F, 5, 250),
    FD(NOTE_G, 4, 25),
    FD(NOTE_C, 5, 25),
    FD(NOTE_E, 5, 200),
    FD(NOTE_E, 3, 250),
    FD(NOTE_D, 5, 500),
    FD(NOTE_E, 3, 250),
    FD(NOTE_B, 4, 250),
    FD(NOTE_C, 5, 250),
    FD(NOTE_E, 3, 125),
    FD(NOTE_G, 3, 125),
    FD(NOTE_C, 4, 125),
    FD(NOTE_D, 4, 125),
    FD(NOTE_C, 5, 250),
    FD(NOTE_D, 5, 250),
    FD(NOTE_E, 5, 275),
    /* Events 609-624 */
    FD(NOTE_C, 3, 25),
    FD(NOTE_A, 3, 450),
    FD(NOTE_D, 5, 250),
    FD(NOTE_C, 3, 250),
    FD(NOTE_A, 4, 250),
    FD(NOTE_C, 5, 500),
    FD(NOTE_B, 4, 250),
    FD(NOTE_E, 3, 250),
    FD(NOTE_GS, 3, 250),
    FD(NOTE_B, 3, 250),
    FD(NOTE_E, 3, 250),
    FD(NOTE_E, 4, 125),
    FD(NOTE_B, 3, 125),
    FD(NOTE_A, 3, 125),
    FD(NOTE_B, 3, 125),
    FD(NOTE_A, 4, 125),
    /* Events 625-640 */
    FD(NOTE_E, 4, 125),
    FD(NOTE_A, 5, 125),
    FD(NOTE_E, 4, 125),
    FD(NOTE_E, 5, 125),
    FD(NOTE_C, 4, 125),
    FD(NOTE_D, 5, 125),
    FD(NOTE_A, 3, 125),
    FD(NOTE_C, 6, 250),
    FD(NOTE_E, 3, 125),
    FD(NOTE_A, 3, 125),
    FD(NOTE_C, 4, 125),
    FD(NOTE_E, 4, 125),
    FD(NOTE_C, 6, 250),
    FD(NOTE_D, 6, 250),
    FD(NOTE_E, 6, 500),
    FD(NOTE_C, 3, 125),
    /* Events 641-656 */
    FD(NOTE_F, 3, 125),
    FD(NOTE_F, 6, 125),
    FD(NOTE_C, 4, 125),
    FD(NOTE_F, 4, 250),
    FD(NOTE_F, 3, 250),
    FD(NOTE_A, 6, 250),
    FD(NOTE_D, 6, 250),
    FD(NOTE_D, 3, 250),
    FD(NOTE_G, 3, 250),
    FD(NOTE_B, 3, 250),
    FD(NOTE_G, 6, 250),
    FD(NOTE_F, 6, 250),
    FD(NOTE_E, 6, 250),
    FD(NOTE_E, 3, 125),
    FD(NOTE_A, 3, 125),
    FD(NOTE_A, 6, 250),
    /* Events 657-672 */
    FD(NOTE_D, 6, 250),
    FD(NOTE_E, 3, 125),
    FD(NOTE_B, 3, 125),
    FD(NOTE_B, 5, 250),
    FD(NOTE_C, 6, 250),
    FD(NOTE_E, 3, 125),
    FD(NOTE_B, 3, 125),
    FD(NOTE_C, 4, 125),
    FD(NOTE_D, 4, 125),
    FD(NOTE_C, 5, 250),
    FD(NOTE_D, 5, 250),
    FD(NOTE_E, 5, 500),
    FD(NOTE_D, 5, 250),
    FD(NOTE_C, 5, 250),
    FD(NOTE_E, 5, 250),
    FD(NOTE_D, 5, 250),
    /* Events 673-688 */
    FD(NOTE_C, 5, 250),
    FD(NOTE_D, 5, 250),
    FD(NOTE_D, 3, 250),
    FD(NOTE_G, 3, 250),
    FD(NOTE_D, 3, 250),
    FD(NOTE_G, 3, 250),
    FD(NOTE_C, 4, 250),
    FD(NOTE_B, 3, 250),
    FD(NOTE_G, 3, 250),
    FD(NOTE_D, 3, 250),
    FD(NOTE_B, 3, 250),
    FD(NOTE_A, 4, 250),
    FD(NOTE_C, 5, 250),
    FD(NOTE_E, 5, 1250),
    FD(NOTE_F, 5, 250),
    FD(NOTE_E, 5, 250),
    /* Events 689-704 */
    FD(NOTE_D, 3, 250),
    FD(NOTE_D, 5, 250),
    FD(NOTE_G, 3, 250),
    FD(NOTE_E, 5, 250),
    FD(NOTE_F, 5, 250),
    FD(NOTE_G, 5, 1250),
    FD(NOTE_A, 5, 250),
    FD(NOTE_C, 5, 250),
    FD(NOTE_D, 4, 250),
    FD(NOTE_A, 3, 217),
    FD(NOTE_B, 4, 33),
    FD(NOTE_C, 5, 250),
    FD(NOTE_B, 4, 250),
    FD(NOTE_G, 4, 250),
    FD_R(500),
    FD(NOTE_E, 4, 250),
    /* Events 705-720 */
    FD(NOTE_C, 3, 250),
    FD(NOTE_G, 3, 250),
    FD(NOTE_C, 5, 250),
    FD(NOTE_B, 4, 250),
    FD(NOTE_G, 4, 250),
    FD(NOTE_E, 4, 250),
    FD(NOTE_D, 3, 250),
    FD(NOTE_G, 3, 250),
    FD(NOTE_C, 5, 250),
    FD(NOTE_B, 4, 250),
    FD(NOTE_G, 4, 250),
    FD(NOTE_A, 4, 500),
    FD(NOTE_A, 3, 250),
    FD(NOTE_E, 3, 250),
    FD(NOTE_G, 3, 250),
    FD(NOTE_E, 4, 250),
    /* Events 721-736 */
    FD(NOTE_B, 3, 250),
    FD(NOTE_G, 3, 250),
    FD(NOTE_A, 3, 217),
    FD(NOTE_B, 4, 33),
    FD(NOTE_C, 5, 250),
    FD(NOTE_B, 4, 250),
    FD(NOTE_G, 4, 250),
    FD_R(250),
    FD(NOTE_G, 3, 250),
    FD(NOTE_E, 4, 250),
    FD(NOTE_C, 3, 250),
    FD(NOTE_G, 3, 250),
    FD(NOTE_C, 5, 250),
    FD(NOTE_B, 4, 250),
    FD(NOTE_G, 4, 250),
    FD(NOTE_E, 4, 250),
    /* Events 737-752 */
    FD(NOTE_D, 3, 250),
    FD(NOTE_G, 3, 250),
    FD(NOTE_D, 5, 250),
    FD(NOTE_B, 4, 250),
    FD(NOTE_G, 4, 250),
    FD(NOTE_A, 4, 250),
    FD(NOTE_B, 4, 250),
    FD(NOTE_C, 5, 250),
    FD(NOTE_B, 4, 250),
    FD(NOTE_A, 4, 250),
    FD(NOTE_E, 4, 250),
    FD(NOTE_C, 4, 750),
    FD(NOTE_B, 3, 750),
    FD(NOTE_A, 3, 25),
    FD(NOTE_C, 4, 25),
    FD(NOTE_E, 4, 25),
    /* Events 753-768 */
    FD(NOTE_A, 4, 175),
    FD(NOTE_E, 3, 250),
    FD(NOTE_G, 3, 250),
    FD(NOTE_C, 4, 750),
    FD(NOTE_A, 3, 250),
    FD(NOTE_E, 3, 250),
    FD(NOTE_G, 3, 250),
    FD(NOTE_D, 4, 250),
    FD_R(500),
    FD(NOTE_A, 3, 250),
    FD(NOTE_E, 3, 250),
    FD(NOTE_G, 3, 250),
    FD(NOTE_C, 4, 750),
    FD(NOTE_A, 3, 250),
    FD(NOTE_E, 3, 250),
    FD(NOTE_G, 3, 250),
    /* Events 769-784 */
    FD(NOTE_D, 4, 250),
    FD(NOTE_C, 4, 250),
    FD(NOTE_G, 3, 250),
    FD_R(1000),
    FD(NOTE_A, 3, 250),
    FD(NOTE_E, 3, 250),
    FD(NOTE_G, 3, 250),
    FD(NOTE_B, 3, 250),
    FD(NOTE_C, 4, 250),
    FD(NOTE_G, 3, 250),
    FD(NOTE_A, 3, 250),
    FD(NOTE_E, 3, 250),
    FD(NOTE_G, 3, 250),
    FD(NOTE_D, 4, 750),
    FD_R(1000),
    FD(NOTE_A, 3, 250),
    /* Events 785-793 */
    FD(NOTE_E, 3, 250),
    FD(NOTE_G, 3, 250),
    FD(NOTE_B, 3, 250),
    FD(NOTE_C, 4, 250),
    FD(NOTE_G, 3, 250),
    FD(NOTE_A, 3, 250),
    FD(NOTE_E, 3, 250),
    FD(NOTE_G, 3, 250),
    FD(NOTE_D, 4, 750)
};

#undef FD_R
#undef FD
