/*
 * Beethoven - Fur Elise, WoO 59.
 * Source material: Mutopia Project, Breitkopf & Hartel 1888 edition,
 * public domain. The piano score is reduced to one note at a time for the
 * passive PWM buzzer; bass notes below C3 are raised one octave so they remain
 * audible on small buzzers.
 */
const Tone_t FUR_ELISE[] = {
    /* ~measure 1 */
    {NOTE_E, 5, 208}, {NOTE_DS, 5, 208}, {NOTE_E, 5, 208},
    {NOTE_DS, 5, 208}, {NOTE_E, 5, 208}, {NOTE_B, 4, 208},
    {NOTE_D, 5, 208}, {NOTE_C, 5, 208}, {NOTE_A, 4, 208},
    {NOTE_E, 3, 208}, {NOTE_A, 3, 208}, {NOTE_C, 4, 208},
    {NOTE_E, 4, 208}, {NOTE_A, 4, 208}, {NOTE_B, 4, 208},
    {NOTE_E, 3, 208}, {NOTE_GS, 3, 208}, {NOTE_E, 4, 208},
    {NOTE_GS, 4, 208}, {NOTE_B, 4, 208}, {NOTE_C, 5, 208},
    {NOTE_E, 3, 208}, {NOTE_A, 3, 208}, {NOTE_E, 4, 208},
    {NOTE_E, 5, 208}, {NOTE_DS, 5, 208}, {NOTE_E, 5, 208},
    {NOTE_DS, 5, 208}, {NOTE_E, 5, 208}, {NOTE_B, 4, 208},
    {NOTE_D, 5, 208}, {NOTE_C, 5, 208}, {NOTE_A, 4, 208},
    {NOTE_E, 3, 208}, {NOTE_A, 3, 208}, {NOTE_C, 4, 208},
    {NOTE_E, 4, 208}, {NOTE_A, 4, 208}, {NOTE_B, 4, 208},
    {NOTE_E, 3, 208}, {NOTE_GS, 3, 208}, {NOTE_E, 4, 208},
    {NOTE_C, 5, 208}, {NOTE_B, 4, 208}, {NOTE_A, 4, 208},
    {NOTE_E, 3, 208}, {NOTE_A, 3, 208}, {NOTE_REST, 0, 208},
    /* ~measure 9 */
    {NOTE_A, 4, 208}, {NOTE_E, 3, 208}, {NOTE_A, 3, 208},
    {NOTE_B, 4, 208}, {NOTE_C, 5, 208}, {NOTE_D, 5, 208},
    {NOTE_E, 5, 208}, {NOTE_G, 3, 208}, {NOTE_C, 4, 208},
    {NOTE_G, 4, 208}, {NOTE_F, 5, 208}, {NOTE_E, 5, 208},
    {NOTE_D, 5, 208}, {NOTE_G, 3, 208}, {NOTE_B, 3, 208},
    {NOTE_F, 4, 208}, {NOTE_E, 5, 208}, {NOTE_D, 5, 208},
    {NOTE_C, 5, 208}, {NOTE_E, 3, 208}, {NOTE_A, 3, 208},
    {NOTE_E, 4, 208}, {NOTE_D, 5, 208}, {NOTE_C, 5, 208},
    {NOTE_B, 4, 208}, {NOTE_E, 3, 208}, {NOTE_E, 4, 208},
    {NOTE_E, 4, 208}, {NOTE_E, 5, 208}, {NOTE_E, 4, 208},
    {NOTE_E, 5, 208}, {NOTE_E, 5, 208}, {NOTE_E, 6, 208},
    {NOTE_DS, 5, 208}, {NOTE_E, 5, 208}, {NOTE_DS, 5, 208},
    {NOTE_E, 5, 208}, {NOTE_DS, 5, 208}, {NOTE_E, 5, 208},
    {NOTE_DS, 5, 208}, {NOTE_E, 5, 208}, {NOTE_DS, 5, 208},
    {NOTE_E, 5, 208}, {NOTE_DS, 5, 208}, {NOTE_E, 5, 208},
    {NOTE_B, 4, 208}, {NOTE_D, 5, 208}, {NOTE_C, 5, 208},
    /* ~measure 17 */
    {NOTE_A, 4, 208}, {NOTE_E, 3, 208}, {NOTE_A, 3, 208},
    {NOTE_C, 4, 208}, {NOTE_E, 4, 208}, {NOTE_A, 4, 208},
    {NOTE_B, 4, 208}, {NOTE_E, 3, 208}, {NOTE_GS, 3, 208},
    {NOTE_E, 4, 208}, {NOTE_GS, 4, 208}, {NOTE_B, 4, 208},
    {NOTE_C, 5, 208}, {NOTE_E, 3, 208}, {NOTE_A, 3, 208},
    {NOTE_E, 4, 208}, {NOTE_E, 5, 208}, {NOTE_DS, 5, 208},
    {NOTE_E, 5, 208}, {NOTE_DS, 5, 208}, {NOTE_E, 5, 208},
    {NOTE_B, 4, 208}, {NOTE_D, 5, 208}, {NOTE_C, 5, 208},
    {NOTE_A, 4, 208}, {NOTE_E, 3, 208}, {NOTE_A, 3, 208},
    {NOTE_C, 4, 208}, {NOTE_E, 4, 208}, {NOTE_A, 4, 208},
    {NOTE_B, 4, 208}, {NOTE_E, 3, 208}, {NOTE_GS, 3, 208},
    {NOTE_E, 4, 208}, {NOTE_C, 5, 208}, {NOTE_B, 4, 208},
    {NOTE_A, 4, 208}, {NOTE_E, 3, 208}, {NOTE_A, 3, 208},
    {NOTE_B, 4, 208}, {NOTE_C, 5, 208}, {NOTE_D, 5, 208},
    {NOTE_A, 4, 208}, {NOTE_E, 3, 208}, {NOTE_A, 3, 208},
    {NOTE_C, 5, 208}, {NOTE_C, 5, 208}, {NOTE_C, 5, 113},
    {NOTE_F, 4, 46}, {NOTE_A, 4, 46},
    /* ~measure 25 */
    {NOTE_C, 5, 208}, {NOTE_A, 3, 208}, {NOTE_C, 4, 208},
    {NOTE_A, 3, 208}, {NOTE_F, 5, 208}, {NOTE_A, 3, 104},
    {NOTE_E, 5, 104}, {NOTE_E, 5, 208}, {NOTE_AS, 3, 208},
    {NOTE_D, 5, 208}, {NOTE_AS, 3, 208}, {NOTE_AS, 5, 208},
    {NOTE_AS, 3, 104}, {NOTE_A, 5, 104}, {NOTE_A, 5, 208},
    {NOTE_G, 5, 208}, {NOTE_F, 5, 208}, {NOTE_E, 5, 208},
    {NOTE_D, 5, 208}, {NOTE_C, 5, 208}, {NOTE_AS, 4, 208},
    {NOTE_A, 3, 208}, {NOTE_A, 4, 208}, {NOTE_A, 3, 184},
    {NOTE_AS, 4, 22}, {NOTE_A, 4, 104}, {NOTE_G, 4, 104},
    {NOTE_A, 4, 104}, {NOTE_AS, 4, 104}, {NOTE_C, 5, 208},
    {NOTE_A, 3, 208}, {NOTE_C, 4, 208}, {NOTE_A, 3, 208},
    {NOTE_D, 5, 208}, {NOTE_DS, 5, 208}, {NOTE_E, 5, 208},
    {NOTE_A, 3, 208}, {NOTE_C, 4, 208}, {NOTE_E, 5, 208},
    {NOTE_F, 5, 208}, {NOTE_A, 4, 208}, {NOTE_C, 5, 208},
    {NOTE_E, 4, 208}, {NOTE_G, 3, 208}, {NOTE_E, 4, 208},
    {NOTE_D, 5, 208}, {NOTE_F, 4, 104}, {NOTE_B, 4, 104},
    {NOTE_C, 5, 104}, {NOTE_G, 5, 104}, {NOTE_G, 4, 104},
    {NOTE_G, 5, 104}, {NOTE_A, 4, 104}, {NOTE_G, 5, 104},
    {NOTE_B, 4, 104}, {NOTE_G, 5, 104}, {NOTE_C, 5, 104},
    {NOTE_G, 5, 104}, {NOTE_D, 5, 104}, {NOTE_G, 5, 104},
    /* ~measure 33 */
    {NOTE_E, 5, 104}, {NOTE_G, 5, 104}, {NOTE_C, 6, 104},
    {NOTE_B, 5, 104}, {NOTE_A, 5, 104}, {NOTE_G, 5, 104},
    {NOTE_F, 5, 104}, {NOTE_E, 5, 104}, {NOTE_D, 5, 104},
    {NOTE_G, 5, 104}, {NOTE_F, 5, 104}, {NOTE_D, 5, 104},
    {NOTE_C, 5, 104}, {NOTE_G, 5, 104}, {NOTE_G, 4, 104},
    {NOTE_G, 5, 104}, {NOTE_A, 4, 104}, {NOTE_G, 5, 104},
    {NOTE_B, 4, 104}, {NOTE_G, 5, 104}, {NOTE_C, 5, 104},
    {NOTE_G, 5, 104}, {NOTE_D, 5, 104}, {NOTE_G, 5, 104},
    {NOTE_E, 5, 104}, {NOTE_G, 5, 104}, {NOTE_C, 6, 104},
    {NOTE_B, 5, 104}, {NOTE_A, 5, 104}, {NOTE_G, 5, 104},
    {NOTE_F, 5, 104}, {NOTE_E, 5, 104}, {NOTE_D, 5, 104},
    {NOTE_G, 5, 104}, {NOTE_F, 5, 104}, {NOTE_D, 5, 104},
    {NOTE_E, 5, 104}, {NOTE_F, 5, 104}, {NOTE_E, 5, 104},
    {NOTE_DS, 5, 104}, {NOTE_E, 5, 104}, {NOTE_B, 4, 104},
    {NOTE_E, 5, 104}, {NOTE_DS, 5, 104}, {NOTE_E, 5, 104},
    {NOTE_B, 4, 104}, {NOTE_E, 5, 104}, {NOTE_DS, 5, 104},
    {NOTE_E, 5, 625}, {NOTE_B, 4, 208}, {NOTE_E, 5, 208},
    {NOTE_DS, 5, 208}, {NOTE_E, 5, 625}, {NOTE_B, 4, 208},
    {NOTE_E, 5, 208}, {NOTE_DS, 5, 208}, {NOTE_E, 5, 208},
    {NOTE_DS, 5, 208}, {NOTE_E, 5, 208}, {NOTE_DS, 5, 208},
    {NOTE_E, 5, 208}, {NOTE_DS, 5, 208}, {NOTE_E, 5, 208},
    {NOTE_DS, 5, 208}, {NOTE_E, 5, 208}, {NOTE_B, 4, 208},
    {NOTE_D, 5, 208}, {NOTE_C, 5, 208},
    /* ~measure 41 */
    {NOTE_A, 4, 208}, {NOTE_E, 3, 208}, {NOTE_A, 3, 208},
    {NOTE_C, 4, 208}, {NOTE_E, 4, 208}, {NOTE_A, 4, 208},
    {NOTE_B, 4, 208}, {NOTE_E, 3, 208}, {NOTE_GS, 3, 208},
    {NOTE_E, 4, 208}, {NOTE_GS, 4, 208}, {NOTE_B, 4, 208},
    {NOTE_C, 5, 208}, {NOTE_E, 3, 208}, {NOTE_A, 3, 208},
    {NOTE_E, 4, 208}, {NOTE_E, 5, 208}, {NOTE_DS, 5, 208},
    {NOTE_E, 5, 208}, {NOTE_DS, 5, 208}, {NOTE_E, 5, 208},
    {NOTE_B, 4, 208}, {NOTE_D, 5, 208}, {NOTE_C, 5, 208},
    {NOTE_A, 4, 208}, {NOTE_E, 3, 208}, {NOTE_A, 3, 208},
    {NOTE_C, 4, 208}, {NOTE_E, 4, 208}, {NOTE_A, 4, 208},
    {NOTE_B, 4, 208}, {NOTE_E, 3, 208}, {NOTE_GS, 3, 208},
    {NOTE_E, 4, 208}, {NOTE_C, 5, 208}, {NOTE_B, 4, 208},
    {NOTE_A, 4, 208}, {NOTE_E, 3, 208}, {NOTE_A, 3, 208},
    {NOTE_B, 4, 208}, {NOTE_C, 5, 208}, {NOTE_D, 5, 208},
    {NOTE_E, 5, 208}, {NOTE_G, 3, 208}, {NOTE_C, 4, 208},
    {NOTE_G, 4, 208}, {NOTE_F, 5, 208}, {NOTE_E, 5, 208},
    /* ~measure 49 */
    {NOTE_D, 5, 208}, {NOTE_G, 3, 208}, {NOTE_B, 3, 208},
    {NOTE_F, 4, 208}, {NOTE_E, 5, 208}, {NOTE_D, 5, 208},
    {NOTE_C, 5, 208}, {NOTE_E, 3, 208}, {NOTE_A, 3, 208},
    {NOTE_E, 4, 208}, {NOTE_D, 5, 208}, {NOTE_C, 5, 208},
    {NOTE_B, 4, 208}, {NOTE_E, 3, 208}, {NOTE_E, 4, 208},
    {NOTE_E, 4, 208}, {NOTE_E, 5, 208}, {NOTE_E, 4, 208},
    {NOTE_E, 5, 208}, {NOTE_E, 5, 208}, {NOTE_E, 6, 208},
    {NOTE_DS, 5, 208}, {NOTE_E, 5, 208}, {NOTE_DS, 5, 208},
    {NOTE_E, 5, 208}, {NOTE_DS, 5, 208}, {NOTE_E, 5, 208},
    {NOTE_DS, 5, 208}, {NOTE_E, 5, 208}, {NOTE_DS, 5, 208},
    {NOTE_E, 5, 208}, {NOTE_DS, 5, 208}, {NOTE_E, 5, 208},
    {NOTE_B, 4, 208}, {NOTE_D, 5, 208}, {NOTE_C, 5, 208},
    {NOTE_A, 4, 208}, {NOTE_E, 3, 208}, {NOTE_A, 3, 208},
    {NOTE_C, 4, 208}, {NOTE_E, 4, 208}, {NOTE_A, 4, 208},
    {NOTE_B, 4, 208}, {NOTE_E, 3, 208}, {NOTE_GS, 3, 208},
    {NOTE_E, 4, 208}, {NOTE_GS, 4, 208}, {NOTE_B, 4, 208},
    /* ~measure 57 */
    {NOTE_C, 5, 208}, {NOTE_E, 3, 208}, {NOTE_A, 3, 208},
    {NOTE_E, 4, 208}, {NOTE_E, 5, 208}, {NOTE_DS, 5, 208},
    {NOTE_E, 5, 208}, {NOTE_DS, 5, 208}, {NOTE_E, 5, 208},
    {NOTE_B, 4, 208}, {NOTE_D, 5, 208}, {NOTE_C, 5, 208},
    {NOTE_A, 4, 208}, {NOTE_E, 3, 208}, {NOTE_A, 3, 208},
    {NOTE_C, 4, 208}, {NOTE_E, 4, 208}, {NOTE_A, 4, 208},
    {NOTE_B, 4, 208}, {NOTE_E, 3, 208}, {NOTE_GS, 3, 208},
    {NOTE_E, 4, 208}, {NOTE_C, 5, 208}, {NOTE_B, 4, 208},
    {NOTE_A, 4, 208}, {NOTE_A, 3, 208}, {NOTE_A, 3, 208},
    {NOTE_A, 3, 208}, {NOTE_A, 3, 208}, {NOTE_A, 3, 208},
    {NOTE_CS, 5, 208}, {NOTE_A, 3, 208}, {NOTE_A, 3, 208},
    {NOTE_A, 3, 208}, {NOTE_A, 3, 208}, {NOTE_A, 3, 208},
    {NOTE_D, 5, 208}, {NOTE_A, 3, 208}, {NOTE_A, 3, 208},
    {NOTE_A, 3, 208}, {NOTE_E, 5, 208}, {NOTE_F, 5, 208},
    {NOTE_F, 5, 208}, {NOTE_A, 3, 208}, {NOTE_A, 3, 208},
    {NOTE_A, 3, 208}, {NOTE_F, 5, 208}, {NOTE_A, 3, 208},
    /* ~measure 65 */
    {NOTE_E, 5, 208}, {NOTE_A, 3, 208}, {NOTE_A, 3, 208},
    {NOTE_A, 3, 208}, {NOTE_A, 3, 208}, {NOTE_A, 3, 208},
    {NOTE_D, 5, 208}, {NOTE_A, 3, 208}, {NOTE_A, 3, 208},
    {NOTE_A, 3, 208}, {NOTE_C, 5, 208}, {NOTE_B, 4, 208},
    {NOTE_A, 4, 208}, {NOTE_A, 3, 208}, {NOTE_A, 3, 208},
    {NOTE_A, 3, 208}, {NOTE_A, 4, 208}, {NOTE_A, 3, 208},
    {NOTE_A, 4, 208}, {NOTE_A, 3, 208}, {NOTE_C, 5, 208},
    {NOTE_A, 3, 208}, {NOTE_B, 4, 208}, {NOTE_GS, 3, 208},
    {NOTE_A, 4, 208}, {NOTE_A, 3, 208}, {NOTE_A, 3, 208},
    {NOTE_A, 3, 208}, {NOTE_A, 3, 208}, {NOTE_A, 3, 208},
    {NOTE_CS, 5, 208}, {NOTE_A, 3, 208}, {NOTE_A, 3, 208},
    {NOTE_A, 3, 208}, {NOTE_A, 3, 208}, {NOTE_A, 3, 208},
    {NOTE_D, 5, 208}, {NOTE_A, 3, 208}, {NOTE_A, 3, 208},
    {NOTE_A, 3, 208}, {NOTE_E, 5, 208}, {NOTE_F, 5, 208},
    {NOTE_F, 5, 208}, {NOTE_A, 3, 208}, {NOTE_A, 3, 208},
    {NOTE_A, 3, 208}, {NOTE_F, 5, 208}, {NOTE_A, 3, 208},
    /* ~measure 73 */
    {NOTE_F, 5, 208}, {NOTE_AS, 3, 208}, {NOTE_AS, 3, 208},
    {NOTE_AS, 3, 208}, {NOTE_AS, 3, 208}, {NOTE_AS, 3, 208},
    {NOTE_DS, 5, 208}, {NOTE_AS, 3, 208}, {NOTE_AS, 3, 208},
    {NOTE_AS, 3, 208}, {NOTE_D, 5, 208}, {NOTE_C, 5, 208},
    {NOTE_AS, 4, 208}, {NOTE_AS, 3, 208}, {NOTE_AS, 3, 208},
    {NOTE_AS, 3, 208}, {NOTE_A, 4, 208}, {NOTE_AS, 3, 208},
    {NOTE_GS, 4, 208}, {NOTE_B, 3, 208}, {NOTE_B, 3, 208},
    {NOTE_B, 3, 208}, {NOTE_GS, 4, 208}, {NOTE_B, 3, 208},
    {NOTE_A, 4, 833}, {NOTE_REST, 0, 417}, {NOTE_B, 4, 417},
    {NOTE_REST, 0, 833}, {NOTE_A, 3, 139}, {NOTE_C, 4, 139},
    {NOTE_E, 4, 139}, {NOTE_A, 4, 139}, {NOTE_C, 5, 139},
    {NOTE_E, 5, 139}, {NOTE_D, 5, 139}, {NOTE_C, 5, 139},
    {NOTE_B, 4, 139}, {NOTE_A, 4, 139}, {NOTE_C, 5, 139},
    {NOTE_E, 5, 139}, {NOTE_A, 5, 139}, {NOTE_C, 6, 139},
    {NOTE_E, 6, 139}, {NOTE_D, 6, 139}, {NOTE_C, 6, 139},
    {NOTE_B, 5, 139},
    /* ~measure 81 */
    {NOTE_A, 5, 139}, {NOTE_C, 6, 139}, {NOTE_E, 6, 139},
    {NOTE_A, 6, 139}, {NOTE_C, 7, 139}, {NOTE_E, 7, 139},
    {NOTE_D, 7, 139}, {NOTE_C, 7, 139}, {NOTE_B, 6, 139},
    {NOTE_AS, 6, 139}, {NOTE_A, 6, 139}, {NOTE_GS, 6, 139},
    {NOTE_G, 6, 139}, {NOTE_FS, 6, 139}, {NOTE_F, 6, 139},
    {NOTE_E, 6, 139}, {NOTE_DS, 6, 139}, {NOTE_D, 6, 139},
    {NOTE_CS, 6, 139}, {NOTE_C, 6, 139}, {NOTE_B, 5, 139},
    {NOTE_AS, 5, 139}, {NOTE_A, 5, 139}, {NOTE_GS, 5, 139},
    {NOTE_G, 5, 139}, {NOTE_FS, 5, 139}, {NOTE_F, 5, 139},
    {NOTE_E, 5, 208}, {NOTE_DS, 5, 208}, {NOTE_E, 5, 208},
    {NOTE_B, 4, 208}, {NOTE_D, 5, 208}, {NOTE_C, 5, 208},
    {NOTE_A, 4, 208}, {NOTE_E, 3, 208}, {NOTE_A, 3, 208},
    {NOTE_C, 4, 208}, {NOTE_E, 4, 208}, {NOTE_A, 4, 208},
    {NOTE_B, 4, 208}, {NOTE_E, 3, 208}, {NOTE_GS, 3, 208},
    {NOTE_E, 4, 208}, {NOTE_GS, 4, 208}, {NOTE_B, 4, 208},
    {NOTE_C, 5, 208}, {NOTE_E, 3, 208}, {NOTE_A, 3, 208},
    {NOTE_E, 4, 208}, {NOTE_E, 5, 208}, {NOTE_DS, 5, 208},
    {NOTE_E, 5, 208}, {NOTE_DS, 5, 208}, {NOTE_E, 5, 208},
    {NOTE_B, 4, 208}, {NOTE_D, 5, 208}, {NOTE_C, 5, 208},
    /* ~measure 89 */
    {NOTE_A, 4, 208}, {NOTE_E, 3, 208}, {NOTE_A, 3, 208},
    {NOTE_C, 4, 208}, {NOTE_E, 4, 208}, {NOTE_A, 4, 208},
    {NOTE_B, 4, 208}, {NOTE_E, 3, 208}, {NOTE_GS, 3, 208},
    {NOTE_E, 4, 208}, {NOTE_C, 5, 208}, {NOTE_B, 4, 208},
    {NOTE_A, 4, 208}, {NOTE_E, 3, 208}, {NOTE_A, 3, 208},
    {NOTE_B, 4, 208}, {NOTE_C, 5, 208}, {NOTE_D, 5, 208},
    {NOTE_E, 5, 208}, {NOTE_G, 3, 208}, {NOTE_C, 4, 208},
    {NOTE_G, 4, 208}, {NOTE_F, 5, 208}, {NOTE_E, 5, 208},
    {NOTE_D, 5, 208}, {NOTE_G, 3, 208}, {NOTE_B, 3, 208},
    {NOTE_F, 4, 208}, {NOTE_E, 5, 208}, {NOTE_D, 5, 208},
    {NOTE_C, 5, 208}, {NOTE_E, 3, 208}, {NOTE_A, 3, 208},
    {NOTE_E, 4, 208}, {NOTE_D, 5, 208}, {NOTE_C, 5, 208},
    {NOTE_B, 4, 208}, {NOTE_E, 3, 208}, {NOTE_E, 4, 208},
    {NOTE_E, 4, 208}, {NOTE_E, 5, 208}, {NOTE_E, 4, 208},
    {NOTE_E, 5, 208}, {NOTE_E, 5, 208}, {NOTE_E, 6, 208},
    {NOTE_DS, 5, 208}, {NOTE_E, 5, 208}, {NOTE_DS, 5, 208},
    /* ~measure 97 */
    {NOTE_E, 5, 208}, {NOTE_DS, 5, 208}, {NOTE_E, 5, 208},
    {NOTE_DS, 5, 208}, {NOTE_E, 5, 208}, {NOTE_DS, 5, 208},
    {NOTE_E, 5, 208}, {NOTE_DS, 5, 208}, {NOTE_E, 5, 208},
    {NOTE_B, 4, 208}, {NOTE_D, 5, 208}, {NOTE_C, 5, 208},
    {NOTE_A, 4, 208}, {NOTE_E, 3, 208}, {NOTE_A, 3, 208},
    {NOTE_C, 4, 208}, {NOTE_E, 4, 208}, {NOTE_A, 4, 208},
    {NOTE_B, 4, 208}, {NOTE_E, 3, 208}, {NOTE_GS, 3, 208},
    {NOTE_E, 4, 208}, {NOTE_GS, 4, 208}, {NOTE_B, 4, 208},
    {NOTE_C, 5, 208}, {NOTE_E, 3, 208}, {NOTE_A, 3, 208},
    {NOTE_E, 4, 208}, {NOTE_E, 5, 208}, {NOTE_DS, 5, 208},
    {NOTE_E, 5, 208}, {NOTE_DS, 5, 208}, {NOTE_E, 5, 208},
    {NOTE_B, 4, 208}, {NOTE_D, 5, 208}, {NOTE_C, 5, 208},
    {NOTE_A, 4, 208}, {NOTE_E, 3, 208}, {NOTE_A, 3, 208},
    {NOTE_C, 4, 208}, {NOTE_E, 4, 208}, {NOTE_A, 4, 208},
    {NOTE_B, 4, 208}, {NOTE_E, 3, 208}, {NOTE_GS, 3, 208},
    {NOTE_E, 4, 208}, {NOTE_C, 5, 208}, {NOTE_B, 4, 208},
    /* ~measure 105 */
    {NOTE_A, 4, 417}
};

