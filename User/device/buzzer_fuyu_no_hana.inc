/*
 * Fuyu no Hana.
 * Complete single-line PWM buzzer reduction generated from local user PDF / PiaStudy Hembn7G2 space data, D major, quarter note = 96 BPM.
 * Simultaneous right-hand, left-hand, and chord tones are
 * arpeggiated into one buzzer line with the upper voice first;
 * notes outside the practical buzzer range are folded by octaves.
 * 900 buzzer events, about 101 seconds.
 */
#define FNH(note, octave, ms) {note, octave, (uint16_t)(ms)}
#define FNH_R(ms) {NOTE_REST, 0, (uint16_t)(ms)}

const Tone_t FUYU_NO_HANA[] = {
    /* Events 1-16 */
    FNH_R(313),
    FNH(NOTE_FS, 4, 939),
    FNH_R(1250),
    FNH(NOTE_D, 5, 79),
    FNH(NOTE_D, 4, 78),
    FNH(NOTE_B, 3, 78),
    FNH(NOTE_FS, 3, 78),
    FNH(NOTE_E, 5, 313),
    FNH(NOTE_CS, 5, 313),
    FNH(NOTE_D, 5, 313),
    FNH(NOTE_A, 4, 157),
    FNH(NOTE_CS, 4, 156),
    FNH(NOTE_A, 3, 156),
    FNH(NOTE_FS, 3, 156),
    FNH(NOTE_FS, 4, 313),
    FNH(NOTE_A, 4, 313),
    /* Events 17-32 */
    FNH(NOTE_B, 4, 79),
    FNH(NOTE_B, 3, 78),
    FNH(NOTE_G, 3, 78),
    FNH(NOTE_D, 3, 78),
    FNH(NOTE_B, 4, 313),
    FNH(NOTE_A, 4, 313),
    FNH(NOTE_B, 4, 313),
    FNH(NOTE_FS, 4, 157),
    FNH(NOTE_A, 3, 156),
    FNH(NOTE_FS, 3, 156),
    FNH(NOTE_D, 3, 156),
    FNH(NOTE_E, 4, 313),
    FNH(NOTE_FS, 4, 313),
    FNH(NOTE_G, 4, 157),
    FNH(NOTE_E, 3, 156),
    FNH(NOTE_FS, 4, 157),
    /* Events 33-48 */
    FNH(NOTE_G, 3, 156),
    FNH(NOTE_E, 4, 157),
    FNH(NOTE_B, 3, 156),
    FNH(NOTE_G, 4, 313),
    FNH(NOTE_FS, 4, 157),
    FNH(NOTE_B, 3, 156),
    FNH(NOTE_B, 4, 157),
    FNH(NOTE_FS, 3, 156),
    FNH(NOTE_CS, 5, 157),
    FNH(NOTE_D, 4, 156),
    FNH(NOTE_D, 5, 313),
    FNH(NOTE_CS, 5, 157),
    FNH(NOTE_CS, 3, 156),
    FNH(NOTE_GS, 4, 157),
    FNH(NOTE_GS, 3, 156),
    FNH(NOTE_AS, 4, 105),
    /* Events 49-64 */
    FNH(NOTE_F, 4, 104),
    FNH(NOTE_CS, 4, 104),
    FNH(NOTE_B, 4, 156),
    FNH(NOTE_CS, 5, 78),
    FNH(NOTE_AS, 4, 78),
    FNH(NOTE_CS, 5, 157),
    FNH(NOTE_FS, 3, 469),
    FNH(NOTE_FS, 4, 105),
    FNH(NOTE_CS, 4, 104),
    FNH(NOTE_AS, 3, 104),
    FNH(NOTE_FS, 4, 313),
    FNH(NOTE_D, 5, 105),
    FNH(NOTE_FS, 4, 104),
    FNH(NOTE_B, 3, 104),
    FNH(NOTE_E, 5, 157),
    FNH(NOTE_FS, 3, 156),
    /* Events 65-80 */
    FNH(NOTE_CS, 5, 79),
    FNH(NOTE_FS, 4, 78),
    FNH(NOTE_D, 4, 78),
    FNH(NOTE_B, 3, 78),
    FNH(NOTE_D, 5, 157),
    FNH(NOTE_FS, 3, 156),
    FNH(NOTE_A, 4, 105),
    FNH(NOTE_FS, 4, 104),
    FNH(NOTE_FS, 3, 417),
    FNH(NOTE_FS, 4, 105),
    FNH(NOTE_CS, 4, 104),
    FNH(NOTE_A, 3, 104),
    FNH(NOTE_A, 4, 313),
    FNH(NOTE_B, 4, 53),
    FNH(NOTE_G, 4, 52),
    FNH(NOTE_D, 4, 52),
    /* Events 81-96 */
    FNH(NOTE_G, 3, 52),
    FNH(NOTE_D, 3, 52),
    FNH(NOTE_G, 3, 52),
    FNH(NOTE_B, 4, 313),
    FNH(NOTE_A, 4, 53),
    FNH(NOTE_E, 4, 52),
    FNH(NOTE_CS, 4, 52),
    FNH(NOTE_A, 3, 52),
    FNH(NOTE_E, 3, 52),
    FNH(NOTE_A, 3, 52),
    FNH(NOTE_A, 4, 313),
    FNH(NOTE_FS, 4, 79),
    FNH(NOTE_D, 4, 78),
    FNH(NOTE_A, 3, 78),
    FNH(NOTE_D, 3, 78),
    FNH(NOTE_A, 3, 313),
    /* Events 97-112 */
    FNH(NOTE_E, 4, 157),
    FNH(NOTE_D, 4, 156),
    FNH(NOTE_FS, 4, 313),
    FNH(NOTE_G, 4, 157),
    FNH(NOTE_E, 3, 156),
    FNH(NOTE_A, 4, 157),
    FNH(NOTE_B, 3, 156),
    FNH(NOTE_B, 4, 157),
    FNH(NOTE_E, 4, 156),
    FNH(NOTE_CS, 5, 313),
    FNH(NOTE_D, 5, 157),
    FNH(NOTE_B, 3, 156),
    FNH(NOTE_E, 5, 157),
    FNH(NOTE_FS, 3, 156),
    FNH(NOTE_FS, 5, 157),
    FNH(NOTE_B, 3, 156),
    /* Events 113-128 */
    FNH(NOTE_G, 5, 313),
    FNH(NOTE_FS, 5, 53),
    FNH(NOTE_CS, 5, 52),
    FNH(NOTE_AS, 4, 52),
    FNH(NOTE_E, 4, 52),
    FNH(NOTE_AS, 3, 52),
    FNH(NOTE_FS, 3, 52),
    FNH(NOTE_E, 5, 313),
    FNH(NOTE_CS, 5, 79),
    FNH(NOTE_AS, 4, 78),
    FNH(NOTE_FS, 3, 156),
    FNH(NOTE_D, 5, 313),
    FNH(NOTE_B, 4, 125),
    FNH(NOTE_FS, 4, 125),
    FNH(NOTE_B, 3, 125),
    FNH(NOTE_FS, 3, 125),
    /* Events 129-144 */
    FNH(NOTE_B, 3, 750),
    FNH(NOTE_D, 6, 105),
    FNH(NOTE_D, 5, 104),
    FNH(NOTE_B, 3, 104),
    FNH(NOTE_E, 6, 105),
    FNH(NOTE_E, 5, 104),
    FNH(NOTE_FS, 3, 104),
    FNH(NOTE_FS, 6, 79),
    FNH(NOTE_FS, 5, 78),
    FNH(NOTE_D, 4, 78),
    FNH(NOTE_B, 3, 78),
    FNH(NOTE_B, 5, 105),
    FNH(NOTE_B, 4, 104),
    FNH(NOTE_FS, 3, 104),
    FNH(NOTE_A, 5, 105),
    FNH(NOTE_A, 4, 104),
    /* Events 145-160 */
    FNH(NOTE_FS, 3, 104),
    FNH(NOTE_B, 5, 105),
    FNH(NOTE_B, 4, 104),
    FNH(NOTE_CS, 3, 104),
    FNH(NOTE_CS, 6, 79),
    FNH(NOTE_CS, 5, 78),
    FNH(NOTE_A, 3, 78),
    FNH(NOTE_FS, 3, 78),
    FNH(NOTE_A, 5, 105),
    FNH(NOTE_A, 4, 104),
    FNH(NOTE_CS, 3, 104),
    FNH(NOTE_B, 5, 105),
    FNH(NOTE_D, 5, 104),
    FNH(NOTE_B, 4, 104),
    FNH(NOTE_G, 3, 104),
    FNH(NOTE_D, 3, 104),
    /* Events 161-176 */
    FNH(NOTE_G, 3, 104),
    FNH(NOTE_A, 5, 105),
    FNH(NOTE_CS, 5, 104),
    FNH(NOTE_A, 4, 104),
    FNH(NOTE_FS, 3, 104),
    FNH(NOTE_CS, 3, 104),
    FNH(NOTE_FS, 3, 104),
    FNH(NOTE_B, 5, 157),
    FNH(NOTE_FS, 5, 156),
    FNH(NOTE_D, 5, 156),
    FNH(NOTE_B, 4, 261),
    FNH(NOTE_B, 3, 208),
    FNH(NOTE_CS, 5, 313),
    FNH(NOTE_D, 5, 157),
    FNH(NOTE_B, 3, 156),
    FNH(NOTE_E, 5, 157),
    /* Events 177-192 */
    FNH(NOTE_FS, 3, 156),
    FNH(NOTE_CS, 5, 105),
    FNH(NOTE_D, 4, 104),
    FNH(NOTE_B, 3, 104),
    FNH(NOTE_D, 5, 157),
    FNH(NOTE_FS, 3, 156),
    FNH(NOTE_A, 4, 157),
    FNH(NOTE_FS, 3, 156),
    FNH(NOTE_CS, 3, 313),
    FNH(NOTE_FS, 4, 105),
    FNH(NOTE_A, 3, 104),
    FNH(NOTE_FS, 3, 104),
    FNH(NOTE_A, 4, 157),
    FNH(NOTE_CS, 3, 156),
    FNH(NOTE_B, 4, 157),
    FNH(NOTE_G, 3, 156),
    /* Events 193-208 */
    FNH(NOTE_D, 3, 313),
    FNH(NOTE_A, 4, 105),
    FNH(NOTE_B, 3, 104),
    FNH(NOTE_G, 3, 104),
    FNH(NOTE_B, 4, 78),
    FNH(NOTE_D, 3, 78),
    FNH(NOTE_A, 4, 156),
    FNH(NOTE_FS, 4, 157),
    FNH(NOTE_D, 3, 156),
    FNH(NOTE_A, 3, 313),
    FNH(NOTE_E, 4, 105),
    FNH(NOTE_FS, 3, 104),
    FNH(NOTE_D, 3, 104),
    FNH(NOTE_FS, 4, 157),
    FNH(NOTE_A, 3, 156),
    FNH(NOTE_G, 4, 157),
    /* Events 209-224 */
    FNH(NOTE_E, 3, 156),
    FNH(NOTE_FS, 4, 157),
    FNH(NOTE_B, 3, 156),
    FNH(NOTE_E, 4, 105),
    FNH(NOTE_G, 3, 104),
    FNH(NOTE_E, 3, 104),
    FNH(NOTE_G, 4, 157),
    FNH(NOTE_B, 3, 156),
    FNH(NOTE_FS, 4, 157),
    FNH(NOTE_B, 3, 156),
    FNH(NOTE_B, 4, 157),
    FNH(NOTE_FS, 3, 156),
    FNH(NOTE_CS, 5, 105),
    FNH(NOTE_D, 4, 104),
    FNH(NOTE_B, 3, 104),
    FNH(NOTE_D, 5, 157),
    /* Events 225-240 */
    FNH(NOTE_FS, 3, 156),
    FNH(NOTE_CS, 5, 157),
    FNH(NOTE_CS, 3, 156),
    FNH(NOTE_GS, 4, 157),
    FNH(NOTE_GS, 3, 156),
    FNH(NOTE_AS, 4, 105),
    FNH(NOTE_F, 4, 104),
    FNH(NOTE_CS, 4, 104),
    FNH(NOTE_B, 4, 156),
    FNH(NOTE_CS, 5, 78),
    FNH(NOTE_AS, 4, 78),
    FNH(NOTE_CS, 5, 157),
    FNH(NOTE_FS, 3, 469),
    FNH(NOTE_FS, 4, 105),
    FNH(NOTE_CS, 4, 104),
    FNH(NOTE_AS, 3, 104),
    /* Events 241-256 */
    FNH(NOTE_FS, 4, 313),
    FNH(NOTE_D, 5, 79),
    FNH(NOTE_FS, 4, 78),
    FNH(NOTE_B, 3, 156),
    FNH(NOTE_E, 5, 78),
    FNH(NOTE_B, 3, 78),
    FNH(NOTE_D, 3, 156),
    FNH(NOTE_CS, 5, 79),
    FNH(NOTE_FS, 4, 78),
    FNH(NOTE_B, 3, 78),
    FNH(NOTE_FS, 3, 78),
    FNH(NOTE_D, 5, 157),
    FNH(NOTE_D, 3, 156),
    FNH(NOTE_A, 4, 79),
    FNH(NOTE_FS, 4, 78),
    FNH(NOTE_FS, 3, 156),
    /* Events 257-272 */
    FNH(NOTE_CS, 3, 156),
    FNH(NOTE_FS, 3, 156),
    FNH(NOTE_FS, 4, 105),
    FNH(NOTE_CS, 4, 104),
    FNH(NOTE_A, 3, 104),
    FNH(NOTE_A, 4, 157),
    FNH(NOTE_FS, 3, 156),
    FNH(NOTE_B, 4, 53),
    FNH(NOTE_G, 4, 52),
    FNH(NOTE_D, 4, 52),
    FNH(NOTE_G, 3, 52),
    FNH(NOTE_D, 3, 52),
    FNH(NOTE_G, 3, 52),
    FNH(NOTE_B, 4, 313),
    FNH(NOTE_A, 4, 53),
    FNH(NOTE_E, 4, 52),
    /* Events 273-288 */
    FNH(NOTE_CS, 4, 52),
    FNH(NOTE_A, 3, 52),
    FNH(NOTE_E, 3, 52),
    FNH(NOTE_A, 3, 52),
    FNH(NOTE_B, 4, 156),
    FNH(NOTE_A, 4, 156),
    FNH(NOTE_FS, 4, 63),
    FNH(NOTE_D, 4, 63),
    FNH(NOTE_A, 3, 63),
    FNH(NOTE_D, 3, 280),
    FNH(NOTE_FS, 3, 156),
    FNH(NOTE_E, 4, 105),
    FNH(NOTE_D, 4, 104),
    FNH(NOTE_A, 3, 104),
    FNH(NOTE_FS, 4, 313),
    FNH(NOTE_G, 4, 79),
    /* Events 289-304 */
    FNH(NOTE_E, 4, 78),
    FNH(NOTE_E, 3, 156),
    FNH(NOTE_A, 4, 78),
    FNH(NOTE_E, 4, 78),
    FNH(NOTE_E, 3, 156),
    FNH(NOTE_B, 4, 79),
    FNH(NOTE_E, 4, 78),
    FNH(NOTE_B, 3, 78),
    FNH(NOTE_G, 3, 78),
    FNH(NOTE_CS, 5, 105),
    FNH(NOTE_E, 4, 104),
    FNH(NOTE_E, 3, 104),
    FNH(NOTE_D, 5, 79),
    FNH(NOTE_B, 4, 78),
    FNH(NOTE_B, 3, 156),
    FNH(NOTE_E, 5, 78),
    /* Events 305-320 */
    FNH(NOTE_B, 4, 78),
    FNH(NOTE_B, 3, 156),
    FNH(NOTE_FS, 5, 63),
    FNH(NOTE_B, 4, 63),
    FNH(NOTE_B, 3, 63),
    FNH(NOTE_FS, 3, 62),
    FNH(NOTE_D, 3, 62),
    FNH(NOTE_G, 5, 105),
    FNH(NOTE_B, 4, 104),
    FNH(NOTE_B, 3, 104),
    FNH(NOTE_FS, 5, 53),
    FNH(NOTE_CS, 5, 52),
    FNH(NOTE_AS, 4, 52),
    FNH(NOTE_E, 4, 52),
    FNH(NOTE_AS, 3, 52),
    FNH(NOTE_FS, 3, 52),
    /* Events 321-336 */
    FNH(NOTE_E, 5, 313),
    FNH(NOTE_CS, 5, 79),
    FNH(NOTE_AS, 4, 78),
    FNH(NOTE_FS, 3, 156),
    FNH(NOTE_D, 5, 156),
    FNH(NOTE_CS, 5, 156),
    FNH(NOTE_B, 4, 79),
    FNH(NOTE_FS, 4, 78),
    FNH(NOTE_B, 3, 156),
    FNH(NOTE_D, 4, 105),
    FNH(NOTE_B, 3, 104),
    FNH(NOTE_FS, 3, 104),
    FNH(NOTE_D, 4, 105),
    FNH(NOTE_B, 3, 104),
    FNH(NOTE_FS, 3, 104),
    FNH(NOTE_D, 5, 53),
    /* Events 337-352 */
    FNH(NOTE_B, 4, 52),
    FNH(NOTE_FS, 4, 52),
    FNH(NOTE_D, 4, 52),
    FNH(NOTE_B, 3, 52),
    FNH(NOTE_FS, 3, 52),
    FNH(NOTE_FS, 5, 63),
    FNH(NOTE_B, 4, 63),
    FNH(NOTE_FS, 4, 63),
    FNH(NOTE_DS, 3, 124),
    FNH(NOTE_DS, 4, 105),
    FNH(NOTE_B, 3, 104),
    FNH(NOTE_FS, 3, 104),
    FNH(NOTE_B, 5, 53),
    FNH(NOTE_FS, 5, 52),
    FNH(NOTE_B, 4, 52),
    FNH(NOTE_DS, 4, 52),
    /* Events 353-368 */
    FNH(NOTE_B, 3, 52),
    FNH(NOTE_FS, 3, 52),
    FNH(NOTE_DS, 4, 105),
    FNH(NOTE_B, 3, 104),
    FNH(NOTE_FS, 3, 104),
    FNH(NOTE_B, 5, 53),
    FNH(NOTE_FS, 5, 52),
    FNH(NOTE_DS, 5, 52),
    FNH(NOTE_B, 4, 52),
    FNH(NOTE_B, 3, 104),
    FNH(NOTE_A, 5, 45),
    FNH(NOTE_FS, 5, 45),
    FNH(NOTE_DS, 5, 45),
    FNH(NOTE_B, 4, 45),
    FNH(NOTE_DS, 4, 45),
    FNH(NOTE_A, 3, 44),
    /* Events 369-384 */
    FNH(NOTE_FS, 3, 44),
    FNH(NOTE_A, 5, 45),
    FNH(NOTE_FS, 5, 45),
    FNH(NOTE_DS, 5, 45),
    FNH(NOTE_B, 4, 45),
    FNH(NOTE_DS, 4, 45),
    FNH(NOTE_A, 3, 44),
    FNH(NOTE_FS, 3, 44),
    FNH(NOTE_FS, 5, 53),
    FNH(NOTE_DS, 5, 52),
    FNH(NOTE_B, 4, 52),
    FNH(NOTE_DS, 4, 52),
    FNH(NOTE_A, 3, 52),
    FNH(NOTE_FS, 3, 52),
    FNH(NOTE_FS, 5, 53),
    FNH(NOTE_DS, 5, 52),
    /* Events 385-400 */
    FNH(NOTE_B, 4, 52),
    FNH(NOTE_A, 3, 52),
    FNH(NOTE_FS, 3, 52),
    FNH(NOTE_B, 3, 52),
    FNH(NOTE_DS, 5, 63),
    FNH(NOTE_B, 4, 63),
    FNH(NOTE_A, 3, 63),
    FNH(NOTE_FS, 3, 62),
    FNH(NOTE_B, 3, 62),
    FNH(NOTE_DS, 5, 79),
    FNH(NOTE_B, 4, 78),
    FNH(NOTE_B, 3, 156),
    FNH(NOTE_B, 4, 79),
    FNH(NOTE_FS, 4, 78),
    FNH(NOTE_B, 3, 156),
    FNH(NOTE_E, 5, 53),
    /* Events 401-416 */
    FNH(NOTE_B, 4, 52),
    FNH(NOTE_G, 4, 52),
    FNH(NOTE_E, 4, 52),
    FNH(NOTE_E, 3, 260),
    FNH(NOTE_G, 3, 156),
    FNH(NOTE_E, 4, 157),
    FNH(NOTE_B, 3, 156),
    FNH(NOTE_E, 6, 52),
    FNH(NOTE_E, 5, 52),
    FNH(NOTE_G, 3, 52),
    FNH(NOTE_E, 3, 156),
    FNH(NOTE_E, 6, 79),
    FNH(NOTE_E, 5, 78),
    FNH(NOTE_E, 3, 156),
    FNH(NOTE_FS, 6, 52),
    FNH(NOTE_FS, 5, 52),
    /* Events 417-432 */
    FNH(NOTE_E, 3, 52),
    FNH(NOTE_G, 3, 156),
    FNH(NOTE_G, 6, 79),
    FNH(NOTE_G, 5, 78),
    FNH(NOTE_E, 4, 78),
    FNH(NOTE_B, 3, 78),
    FNH(NOTE_B, 6, 52),
    FNH(NOTE_B, 5, 52),
    FNH(NOTE_G, 3, 52),
    FNH(NOTE_A, 6, 78),
    FNH(NOTE_A, 5, 78),
    FNH(NOTE_A, 6, 105),
    FNH(NOTE_A, 3, 208),
    FNH(NOTE_E, 3, 156),
    FNH(NOTE_A, 3, 156),
    FNH(NOTE_E, 4, 157),
    /* Events 433-448 */
    FNH(NOTE_CS, 4, 156),
    FNH(NOTE_E, 6, 52),
    FNH(NOTE_E, 5, 52),
    FNH(NOTE_A, 3, 52),
    FNH(NOTE_E, 3, 156),
    FNH(NOTE_FS, 6, 79),
    FNH(NOTE_FS, 5, 78),
    FNH(NOTE_A, 3, 156),
    FNH(NOTE_E, 3, 156),
    FNH(NOTE_A, 3, 156),
    FNH(NOTE_G, 6, 79),
    FNH(NOTE_G, 5, 78),
    FNH(NOTE_E, 4, 78),
    FNH(NOTE_CS, 4, 78),
    FNH(NOTE_A, 3, 313),
    FNH(NOTE_FS, 6, 79),
    /* Events 449-464 */
    FNH(NOTE_FS, 5, 78),
    FNH(NOTE_D, 3, 312),
    FNH(NOTE_FS, 3, 156),
    FNH(NOTE_FS, 6, 79),
    FNH(NOTE_FS, 5, 78),
    FNH(NOTE_D, 4, 78),
    FNH(NOTE_A, 3, 78),
    FNH(NOTE_G, 6, 52),
    FNH(NOTE_G, 5, 52),
    FNH(NOTE_FS, 3, 52),
    FNH(NOTE_D, 3, 156),
    FNH(NOTE_A, 6, 79),
    FNH(NOTE_A, 5, 78),
    FNH(NOTE_CS, 3, 156),
    FNH(NOTE_G, 6, 52),
    FNH(NOTE_G, 5, 52),
    /* Events 465-480 */
    FNH(NOTE_CS, 3, 52),
    FNH(NOTE_E, 3, 156),
    FNH(NOTE_FS, 6, 79),
    FNH(NOTE_FS, 5, 78),
    FNH(NOTE_CS, 4, 78),
    FNH(NOTE_A, 3, 78),
    FNH(NOTE_E, 6, 52),
    FNH(NOTE_E, 5, 52),
    FNH(NOTE_E, 3, 52),
    FNH(NOTE_DS, 6, 78),
    FNH(NOTE_DS, 5, 78),
    FNH(NOTE_DS, 6, 105),
    FNH(NOTE_B, 3, 208),
    FNH(NOTE_FS, 3, 156),
    FNH(NOTE_FS, 4, 78),
    FNH(NOTE_DS, 4, 78),
    /* Events 481-496 */
    FNH(NOTE_FS, 4, 156),
    FNH(NOTE_FS, 3, 156),
    FNH(NOTE_DS, 4, 78),
    FNH(NOTE_B, 3, 78),
    FNH(NOTE_FS, 3, 156),
    FNH(NOTE_DS, 5, 39),
    FNH(NOTE_FS, 4, 39),
    FNH(NOTE_DS, 4, 39),
    FNH(NOTE_FS, 3, 39),
    FNH(NOTE_B, 4, 156),
    FNH(NOTE_A, 4, 156),
    FNH(NOTE_FS, 4, 156),
    FNH(NOTE_B, 5, 52),
    FNH(NOTE_B, 4, 52),
    FNH(NOTE_DS, 4, 52),
    FNH(NOTE_B, 3, 156),
    /* Events 497-512 */
    FNH(NOTE_A, 5, 52),
    FNH(NOTE_A, 4, 52),
    FNH(NOTE_A, 3, 52),
    FNH(NOTE_FS, 3, 156),
    FNH(NOTE_B, 5, 79),
    FNH(NOTE_B, 4, 78),
    FNH(NOTE_E, 3, 312),
    FNH(NOTE_G, 3, 156),
    FNH(NOTE_E, 4, 157),
    FNH(NOTE_B, 3, 156),
    FNH(NOTE_B, 5, 52),
    FNH(NOTE_B, 4, 52),
    FNH(NOTE_G, 3, 52),
    FNH(NOTE_E, 3, 156),
    FNH(NOTE_B, 5, 78),
    FNH(NOTE_B, 4, 78),
    /* Events 513-528 */
    FNH(NOTE_E, 3, 156),
    FNH(NOTE_G, 3, 156),
    FNH(NOTE_B, 3, 156),
    FNH(NOTE_G, 4, 157),
    FNH(NOTE_E, 4, 156),
    FNH(NOTE_E, 6, 52),
    FNH(NOTE_E, 5, 52),
    FNH(NOTE_B, 3, 52),
    FNH(NOTE_G, 3, 156),
    FNH(NOTE_CS, 6, 79),
    FNH(NOTE_CS, 5, 78),
    FNH(NOTE_CS, 3, 312),
    FNH(NOTE_GS, 3, 156),
    FNH(NOTE_CS, 6, 79),
    FNH(NOTE_CS, 5, 78),
    FNH(NOTE_F, 4, 78),
    /* Events 529-544 */
    FNH(NOTE_CS, 4, 78),
    FNH(NOTE_D, 6, 52),
    FNH(NOTE_D, 5, 52),
    FNH(NOTE_GS, 3, 52),
    FNH(NOTE_F, 3, 156),
    FNH(NOTE_CS, 6, 78),
    FNH(NOTE_CS, 5, 78),
    FNH(NOTE_CS, 3, 156),
    FNH(NOTE_B, 5, 52),
    FNH(NOTE_B, 4, 52),
    FNH(NOTE_F, 3, 52),
    FNH(NOTE_GS, 3, 156),
    FNH(NOTE_GS, 5, 79),
    FNH(NOTE_GS, 4, 78),
    FNH(NOTE_F, 4, 78),
    FNH(NOTE_CS, 4, 78),
    /* Events 545-560 */
    FNH(NOTE_B, 5, 52),
    FNH(NOTE_B, 4, 52),
    FNH(NOTE_GS, 3, 52),
    FNH(NOTE_F, 3, 156),
    FNH(NOTE_AS, 5, 26),
    FNH(NOTE_FS, 5, 26),
    FNH(NOTE_CS, 5, 26),
    FNH(NOTE_AS, 4, 26),
    FNH(NOTE_AS, 3, 52),
    FNH(NOTE_CS, 3, 156),
    FNH(NOTE_FS, 3, 156),
    FNH(NOTE_AS, 3, 156),
    FNH(NOTE_B, 5, 32),
    FNH(NOTE_FS, 5, 31),
    FNH(NOTE_CS, 5, 31),
    FNH(NOTE_B, 4, 31),
    /* Events 561-576 */
    FNH(NOTE_CS, 4, 31),
    FNH(NOTE_AS, 3, 156),
    FNH(NOTE_FS, 3, 156),
    FNH(NOTE_CS, 3, 156),
    FNH(NOTE_CS, 6, 26),
    FNH(NOTE_AS, 5, 26),
    FNH(NOTE_G, 5, 26),
    FNH(NOTE_CS, 5, 26),
    FNH(NOTE_G, 3, 52),
    FNH(NOTE_CS, 3, 156),
    FNH(NOTE_E, 3, 156),
    FNH(NOTE_G, 3, 156),
    FNH(NOTE_G, 6, 32),
    FNH(NOTE_CS, 6, 31),
    FNH(NOTE_AS, 5, 31),
    FNH(NOTE_G, 5, 31),
    /* Events 577-592 */
    FNH(NOTE_CS, 4, 31),
    FNH(NOTE_G, 3, 156),
    FNH(NOTE_E, 3, 156),
    FNH(NOTE_CS, 3, 156),
    FNH(NOTE_FS, 6, 26),
    FNH(NOTE_CS, 6, 26),
    FNH(NOTE_AS, 5, 26),
    FNH(NOTE_FS, 5, 26),
    FNH(NOTE_FS, 3, 52),
    FNH(NOTE_CS, 3, 156),
    FNH(NOTE_FS, 3, 156),
    FNH(NOTE_AS, 3, 156),
    FNH(NOTE_CS, 4, 156),
    FNH(NOTE_E, 4, 156),
    FNH(NOTE_FS, 4, 156),
    FNH(NOTE_AS, 4, 156),
    /* Events 593-608 */
    FNH(NOTE_FS, 5, 157),
    FNH(NOTE_CS, 5, 156),
    FNH(NOTE_AS, 4, 156),
    FNH(NOTE_FS, 4, 156),
    FNH(NOTE_D, 6, 157),
    FNH(NOTE_D, 5, 156),
    FNH(NOTE_E, 6, 157),
    FNH(NOTE_E, 5, 156),
    FNH(NOTE_FS, 6, 79),
    FNH(NOTE_FS, 5, 78),
    FNH(NOTE_B, 3, 312),
    FNH(NOTE_D, 3, 156),
    FNH(NOTE_B, 6, 79),
    FNH(NOTE_B, 5, 78),
    FNH(NOTE_B, 3, 78),
    FNH(NOTE_FS, 3, 78),
    /* Events 609-624 */
    FNH(NOTE_D, 3, 313),
    FNH(NOTE_A, 6, 53),
    FNH(NOTE_E, 6, 52),
    FNH(NOTE_CS, 6, 52),
    FNH(NOTE_A, 5, 52),
    FNH(NOTE_A, 3, 260),
    FNH(NOTE_CS, 3, 156),
    FNH(NOTE_FS, 6, 79),
    FNH(NOTE_FS, 5, 78),
    FNH(NOTE_A, 3, 78),
    FNH(NOTE_E, 3, 78),
    FNH(NOTE_A, 6, 105),
    FNH(NOTE_A, 5, 104),
    FNH(NOTE_CS, 3, 104),
    FNH(NOTE_G, 6, 79),
    FNH(NOTE_G, 5, 78),
    /* Events 625-640 */
    FNH(NOTE_G, 3, 156),
    FNH(NOTE_G, 6, 52),
    FNH(NOTE_G, 5, 52),
    FNH(NOTE_D, 3, 52),
    FNH(NOTE_G, 3, 156),
    FNH(NOTE_FS, 6, 79),
    FNH(NOTE_FS, 5, 78),
    FNH(NOTE_D, 4, 78),
    FNH(NOTE_B, 3, 78),
    FNH(NOTE_E, 6, 105),
    FNH(NOTE_E, 5, 104),
    FNH(NOTE_G, 3, 104),
    FNH(NOTE_FS, 6, 79),
    FNH(NOTE_FS, 5, 78),
    FNH(NOTE_D, 3, 156),
    FNH(NOTE_D, 6, 52),
    /* Events 641-656 */
    FNH(NOTE_D, 5, 52),
    FNH(NOTE_D, 3, 52),
    FNH(NOTE_FS, 3, 156),
    FNH(NOTE_A, 5, 79),
    FNH(NOTE_A, 4, 78),
    FNH(NOTE_D, 4, 78),
    FNH(NOTE_A, 3, 78),
    FNH(NOTE_FS, 3, 313),
    FNH(NOTE_G, 5, 53),
    FNH(NOTE_E, 5, 52),
    FNH(NOTE_B, 4, 52),
    FNH(NOTE_G, 4, 52),
    FNH(NOTE_E, 3, 104),
    FNH(NOTE_A, 5, 52),
    FNH(NOTE_A, 4, 52),
    FNH(NOTE_E, 3, 52),
    /* Events 657-672 */
    FNH(NOTE_G, 3, 156),
    FNH(NOTE_B, 5, 79),
    FNH(NOTE_B, 4, 78),
    FNH(NOTE_E, 4, 78),
    FNH(NOTE_B, 3, 78),
    FNH(NOTE_G, 5, 105),
    FNH(NOTE_G, 4, 104),
    FNH(NOTE_G, 3, 104),
    FNH(NOTE_FS, 5, 79),
    FNH(NOTE_FS, 4, 78),
    FNH(NOTE_D, 3, 156),
    FNH(NOTE_B, 5, 52),
    FNH(NOTE_B, 4, 52),
    FNH(NOTE_D, 3, 52),
    FNH(NOTE_FS, 3, 156),
    FNH(NOTE_CS, 6, 79),
    /* Events 673-688 */
    FNH(NOTE_CS, 5, 78),
    FNH(NOTE_D, 4, 78),
    FNH(NOTE_B, 3, 78),
    FNH(NOTE_D, 6, 105),
    FNH(NOTE_D, 5, 104),
    FNH(NOTE_FS, 3, 104),
    FNH(NOTE_F, 6, 52),
    FNH(NOTE_F, 5, 52),
    FNH(NOTE_CS, 3, 208),
    FNH(NOTE_FS, 6, 52),
    FNH(NOTE_FS, 5, 52),
    FNH(NOTE_GS, 3, 52),
    FNH(NOTE_B, 3, 156),
    FNH(NOTE_GS, 6, 52),
    FNH(NOTE_GS, 5, 52),
    FNH(NOTE_F, 4, 52),
    /* Events 689-704 */
    FNH(NOTE_CS, 4, 156),
    FNH(NOTE_B, 6, 52),
    FNH(NOTE_B, 5, 52),
    FNH(NOTE_B, 3, 52),
    FNH(NOTE_AS, 6, 52),
    FNH(NOTE_AS, 5, 52),
    FNH(NOTE_GS, 3, 52),
    FNH(NOTE_FS, 6, 6),
    FNH(NOTE_E, 4, 5),
    FNH(NOTE_CS, 4, 5),
    FNH(NOTE_AS, 3, 5),
    FNH(NOTE_FS, 3, 5),
    FNH(NOTE_E, 6, 26),
    FNH(NOTE_CS, 6, 26),
    FNH(NOTE_AS, 5, 26),
    FNH(NOTE_FS, 5, 26),
    /* Events 705-720 */
    FNH(NOTE_E, 5, 26),
    FNH(NOTE_D, 6, 157),
    FNH(NOTE_D, 5, 156),
    FNH(NOTE_E, 6, 78),
    FNH(NOTE_E, 5, 78),
    FNH(NOTE_FS, 3, 625),
    FNH(NOTE_FS, 6, 79),
    FNH(NOTE_FS, 5, 78),
    FNH(NOTE_B, 3, 312),
    FNH(NOTE_D, 3, 156),
    FNH(NOTE_B, 6, 79),
    FNH(NOTE_B, 5, 78),
    FNH(NOTE_B, 3, 78),
    FNH(NOTE_FS, 3, 78),
    FNH(NOTE_D, 3, 156),
    FNH(NOTE_A, 6, 78),
    /* Events 721-736 */
    FNH(NOTE_A, 5, 78),
    FNH(NOTE_A, 6, 53),
    FNH(NOTE_E, 6, 52),
    FNH(NOTE_CS, 6, 52),
    FNH(NOTE_A, 5, 52),
    FNH(NOTE_A, 3, 260),
    FNH(NOTE_CS, 3, 156),
    FNH(NOTE_B, 6, 79),
    FNH(NOTE_B, 5, 78),
    FNH(NOTE_A, 3, 78),
    FNH(NOTE_E, 3, 78),
    FNH(NOTE_CS, 6, 209),
    FNH(NOTE_CS, 3, 104),
    FNH(NOTE_D, 6, 78),
    FNH(NOTE_G, 3, 78),
    FNH(NOTE_D, 3, 156),
    /* Events 737-752 */
    FNH(NOTE_CS, 6, 104),
    FNH(NOTE_G, 3, 52),
    FNH(NOTE_B, 3, 156),
    FNH(NOTE_B, 6, 52),
    FNH(NOTE_B, 5, 52),
    FNH(NOTE_A, 3, 52),
    FNH(NOTE_E, 3, 156),
    FNH(NOTE_A, 6, 52),
    FNH(NOTE_A, 5, 52),
    FNH(NOTE_A, 3, 52),
    FNH(NOTE_CS, 4, 156),
    FNH(NOTE_FS, 6, 79),
    FNH(NOTE_FS, 5, 78),
    FNH(NOTE_D, 3, 156),
    FNH(NOTE_A, 6, 52),
    FNH(NOTE_A, 5, 52),
    /* Events 753-768 */
    FNH(NOTE_D, 3, 52),
    FNH(NOTE_FS, 3, 156),
    FNH(NOTE_FS, 6, 79),
    FNH(NOTE_FS, 5, 78),
    FNH(NOTE_D, 4, 78),
    FNH(NOTE_A, 3, 78),
    FNH(NOTE_FS, 6, 105),
    FNH(NOTE_FS, 5, 104),
    FNH(NOTE_FS, 3, 104),
    FNH(NOTE_E, 6, 26),
    FNH(NOTE_B, 5, 26),
    FNH(NOTE_G, 5, 26),
    FNH(NOTE_E, 5, 26),
    FNH(NOTE_E, 3, 52),
    FNH(NOTE_B, 3, 156),
    FNH(NOTE_E, 3, 156),
    /* Events 769-784 */
    FNH(NOTE_FS, 3, 156),
    FNH(NOTE_G, 3, 156),
    FNH(NOTE_B, 3, 156),
    FNH(NOTE_B, 5, 105),
    FNH(NOTE_B, 4, 104),
    FNH(NOTE_E, 4, 104),
    FNH(NOTE_CS, 6, 79),
    FNH(NOTE_CS, 5, 78),
    FNH(NOTE_B, 3, 156),
    FNH(NOTE_FS, 3, 156),
    FNH(NOTE_B, 3, 156),
    FNH(NOTE_D, 6, 79),
    FNH(NOTE_D, 5, 78),
    FNH(NOTE_CS, 4, 78),
    FNH(NOTE_FS, 3, 78),
    FNH(NOTE_FS, 6, 157),
    /* Events 785-800 */
    FNH(NOTE_FS, 5, 156),
    FNH(NOTE_FS, 6, 39),
    FNH(NOTE_FS, 5, 39),
    FNH(NOTE_B, 3, 78),
    FNH(NOTE_FS, 3, 156),
    FNH(NOTE_B, 3, 156),
    FNH(NOTE_D, 4, 156),
    FNH(NOTE_AS, 3, 156),
    FNH(NOTE_FS, 3, 156),
    FNH(NOTE_B, 6, 52),
    FNH(NOTE_B, 5, 52),
    FNH(NOTE_B, 3, 52),
    FNH(NOTE_D, 4, 156),
    FNH(NOTE_B, 6, 39),
    FNH(NOTE_B, 5, 39),
    FNH(NOTE_A, 3, 78),
    /* Events 801-816 */
    FNH(NOTE_FS, 3, 156),
    FNH(NOTE_B, 3, 156),
    FNH(NOTE_D, 4, 156),
    FNH(NOTE_B, 6, 39),
    FNH(NOTE_B, 5, 39),
    FNH(NOTE_GS, 3, 78),
    FNH(NOTE_FS, 3, 156),
    FNH(NOTE_CS, 6, 104),
    FNH(NOTE_B, 3, 52),
    FNH(NOTE_CS, 4, 156),
    FNH(NOTE_D, 6, 26),
    FNH(NOTE_B, 6, 26),
    FNH(NOTE_G, 6, 26),
    FNH(NOTE_D, 6, 26),
    FNH(NOTE_G, 3, 52),
    FNH(NOTE_D, 3, 156),
    /* Events 817-832 */
    FNH(NOTE_G, 3, 156),
    FNH(NOTE_B, 3, 156),
    FNH(NOTE_D, 4, 156),
    FNH(NOTE_B, 3, 156),
    FNH(NOTE_E, 6, 104),
    FNH(NOTE_G, 3, 52),
    FNH(NOTE_D, 3, 156),
    FNH(NOTE_CS, 6, 26),
    FNH(NOTE_AS, 6, 26),
    FNH(NOTE_FS, 6, 26),
    FNH(NOTE_CS, 6, 26),
    FNH(NOTE_FS, 3, 52),
    FNH(NOTE_CS, 3, 156),
    FNH(NOTE_FS, 3, 156),
    FNH(NOTE_AS, 3, 156),
    FNH(NOTE_CS, 4, 156),
    /* Events 833-848 */
    FNH(NOTE_AS, 3, 156),
    FNH(NOTE_D, 6, 104),
    FNH(NOTE_FS, 3, 52),
    FNH(NOTE_CS, 3, 156),
    FNH(NOTE_B, 6, 32),
    FNH(NOTE_FS, 6, 31),
    FNH(NOTE_D, 6, 31),
    FNH(NOTE_B, 5, 31),
    FNH(NOTE_B, 3, 187),
    FNH(NOTE_D, 3, 156),
    FNH(NOTE_FS, 3, 156),
    FNH(NOTE_D, 5, 78),
    FNH(NOTE_B, 3, 78),
    FNH(NOTE_D, 4, 156),
    FNH(NOTE_CS, 5, 157),
    FNH(NOTE_FS, 4, 156),
    /* Events 849-864 */
    FNH(NOTE_B, 4, 157),
    FNH(NOTE_FS, 4, 156),
    FNH(NOTE_D, 4, 156),
    FNH(NOTE_B, 3, 156),
    FNH(NOTE_B, 5, 125),
    FNH(NOTE_D, 5, 125),
    FNH(NOTE_B, 3, 125),
    FNH(NOTE_FS, 3, 125),
    FNH(NOTE_B, 3, 125),
    FNH(NOTE_D, 6, 105),
    FNH(NOTE_D, 5, 104),
    FNH(NOTE_B, 3, 104),
    FNH(NOTE_E, 6, 105),
    FNH(NOTE_E, 5, 104),
    FNH(NOTE_FS, 3, 104),
    FNH(NOTE_FS, 6, 79),
    /* Events 865-880 */
    FNH(NOTE_FS, 5, 78),
    FNH(NOTE_D, 4, 78),
    FNH(NOTE_B, 3, 78),
    FNH(NOTE_B, 5, 105),
    FNH(NOTE_B, 4, 104),
    FNH(NOTE_FS, 3, 104),
    FNH(NOTE_A, 5, 105),
    FNH(NOTE_A, 4, 104),
    FNH(NOTE_FS, 3, 104),
    FNH(NOTE_B, 5, 105),
    FNH(NOTE_B, 4, 104),
    FNH(NOTE_CS, 3, 104),
    FNH(NOTE_CS, 6, 79),
    FNH(NOTE_CS, 5, 78),
    FNH(NOTE_A, 3, 78),
    FNH(NOTE_FS, 3, 78),
    /* Events 881-896 */
    FNH(NOTE_A, 5, 105),
    FNH(NOTE_A, 4, 104),
    FNH(NOTE_CS, 3, 104),
    FNH(NOTE_B, 5, 105),
    FNH(NOTE_D, 5, 104),
    FNH(NOTE_B, 4, 104),
    FNH(NOTE_G, 3, 104),
    FNH(NOTE_D, 3, 104),
    FNH(NOTE_G, 3, 104),
    FNH(NOTE_A, 5, 105),
    FNH(NOTE_CS, 5, 104),
    FNH(NOTE_A, 4, 104),
    FNH(NOTE_FS, 3, 104),
    FNH(NOTE_CS, 3, 104),
    FNH(NOTE_FS, 3, 104),
    FNH(NOTE_B, 5, 209),
    /* Events 897-900 */
    FNH(NOTE_FS, 5, 209),
    FNH(NOTE_D, 5, 208),
    FNH(NOTE_B, 4, 208),
    FNH(NOTE_B, 3, 416)
};

#undef FNH_R
#undef FNH
