/* Zheng Runze - Shun, piastudy MIDI.
 * Reduced to one monophonic note stream for a passive PWM buzzer.
 * Bass notes below C3 are raised one octave to keep them audible. */
const Tone_t SHUN[] = {
    /* ~measure 1 */
    {NOTE_C, 4, 429}, {NOTE_GS, 3, 429}, {NOTE_GS, 4, 21}, 
    {NOTE_DS, 5, 29}, {NOTE_GS, 5, 807}, {NOTE_GS, 5, 429}, 
    {NOTE_DS, 4, 429}, {NOTE_G, 4, 429}, {NOTE_GS, 4, 429}, 
    {NOTE_CS, 4, 21}, {NOTE_E, 4, 29}, {NOTE_AS, 4, 379}, 
    {NOTE_GS, 3, 429}, {NOTE_E, 4, 429}, {NOTE_GS, 3, 429}, 
    {NOTE_GS, 4, 429}, {NOTE_GS, 3, 429}, {NOTE_CS, 4, 857}, 
    {NOTE_C, 4, 21}, {NOTE_DS, 4, 29}, {NOTE_G, 4, 79}, 
    {NOTE_AS, 3, 429}, {NOTE_DS, 3, 300}, {NOTE_DS, 4, 129}, 
    {NOTE_AS, 3, 429}, {NOTE_GS, 3, 300}, {NOTE_GS, 4, 129}, 
    {NOTE_DS, 3, 429}, {NOTE_GS, 3, 300}, {NOTE_AS, 4, 129}, 
    {NOTE_DS, 3, 300}, {NOTE_C, 5, 143}, {NOTE_G, 5, 71}, 
    {NOTE_GS, 5, 71}, {NOTE_AS, 5, 71}, {NOTE_C, 6, 71}, 
    {NOTE_CS, 6, 429}, {NOTE_GS, 3, 429}, {NOTE_CS, 4, 857}, 
    {NOTE_CS, 5, 1714}, {NOTE_DS, 4, 29}, {NOTE_GS, 4, 29}, 
    {NOTE_CS, 5, 371}, {NOTE_C, 4, 429}, {NOTE_CS, 4, 429}, 
    {NOTE_GS, 4, 429}, {NOTE_CS, 5, 29}, {NOTE_GS, 5, 29}, 
    {NOTE_C, 6, 800}, {NOTE_DS, 4, 429}, {NOTE_AS, 3, 143}, 
    {NOTE_C, 3, 143}, {NOTE_CS, 3, 143}, {NOTE_AS, 4, 29}, 
    {NOTE_CS, 5, 29}, {NOTE_GS, 5, 371}, {NOTE_GS, 4, 429}, 
    {NOTE_E, 4, 857}, {NOTE_DS, 3, 29}, {NOTE_AS, 3, 29}, 
    {NOTE_CS, 4, 29}, {NOTE_E, 4, 21}, {NOTE_AS, 4, 1179}, 
    {NOTE_DS, 4, 429}, {NOTE_AS, 4, 1286}, {NOTE_GS, 4, 214}, 
    {NOTE_AS, 4, 214}, {NOTE_CS, 4, 429}, {NOTE_C, 5, 214}, 
    {NOTE_C, 5, 429}, {NOTE_DS, 4, 643}, {NOTE_AS, 3, 29}, 
    {NOTE_DS, 4, 400}, {NOTE_C, 4, 214}, {NOTE_DS, 4, 214}, 
    {NOTE_G, 3, 214}, {NOTE_F, 4, 214}, {NOTE_C, 4, 214}, 
    {NOTE_DS, 4, 214}, {NOTE_DS, 3, 857}, {NOTE_DS, 4, 321}, 
    {NOTE_CS, 4, 321}, {NOTE_C, 4, 214}, {NOTE_CS, 4, 429}, 
    {NOTE_CS, 4, 214}, {NOTE_GS, 4, 614}, {NOTE_F, 4, 29}, 
    {NOTE_G, 4, 214}, {NOTE_F, 4, 214}, {NOTE_AS, 3, 429}, 
    {NOTE_DS, 4, 214}, {NOTE_DS, 4, 214}, {NOTE_GS, 3, 429}, 
    {NOTE_CS, 4, 321}, {NOTE_DS, 4, 107}, {NOTE_AS, 3, 1286}, 
    {NOTE_GS, 3, 214}, {NOTE_DS, 4, 214}, {NOTE_CS, 4, 429}, 
    {NOTE_C, 4, 429}, {NOTE_AS, 3, 429}, {NOTE_DS, 4, 400}, 
    {NOTE_GS, 4, 29}, {NOTE_AS, 4, 857}, {NOTE_DS, 4, 429}, 
    {NOTE_GS, 4, 214}, {NOTE_AS, 4, 214}, {NOTE_GS, 3, 429}, 
    {NOTE_C, 5, 214}, {NOTE_C, 5, 214}, {NOTE_CS, 4, 214}, 
    {NOTE_DS, 4, 214}, {NOTE_DS, 4, 429}, {NOTE_AS, 3, 29}, 
    {NOTE_DS, 4, 400}, {NOTE_C, 4, 214}, {NOTE_DS, 4, 214}, 
    {NOTE_AS, 3, 214}, {NOTE_CS, 5, 429}, {NOTE_C, 5, 214}, 
    {NOTE_F, 3, 29}, {NOTE_A, 3, 29}, {NOTE_C, 4, 586}, 
    {NOTE_F, 3, 214}, {NOTE_FS, 4, 429}, {NOTE_F, 4, 429}, 
    {NOTE_DS, 4, 29}, {NOTE_AS, 4, 29}, {NOTE_C, 5, 29}, 
    {NOTE_CS, 5, 343}, {NOTE_AS, 4, 214}, {NOTE_AS, 4, 214}, 
    {NOTE_CS, 4, 429}, {NOTE_F, 3, 429}, {NOTE_DS, 4, 29}, 
    {NOTE_F, 4, 29}, {NOTE_GS, 4, 771}, {NOTE_G, 4, 29}, 
    {NOTE_GS, 4, 429}, {NOTE_GS, 4, 429}, {NOTE_DS, 4, 429}, 
    {NOTE_DS, 3, 429}, {NOTE_CS, 4, 429}, {NOTE_DS, 3, 429}, 
    {NOTE_C, 4, 29}, {NOTE_DS, 4, 29}, {NOTE_GS, 4, 371}, 
    {NOTE_AS, 4, 429}, {NOTE_C, 5, 400}, {NOTE_DS, 4, 29}, 
    {NOTE_F, 4, 429}, {NOTE_CS, 3, 429}, {NOTE_GS, 3, 214}, 
    {NOTE_CS, 3, 214}, {NOTE_DS, 4, 429}, {NOTE_GS, 3, 429}, 
    {NOTE_GS, 4, 429}, {NOTE_AS, 4, 214}, {NOTE_CS, 3, 214}, 
    {NOTE_C, 5, 400}, {NOTE_CS, 4, 29}, {NOTE_DS, 4, 429}, 
    {NOTE_AS, 3, 429}, {NOTE_DS, 3, 214}, {NOTE_C, 3, 214}, 
    {NOTE_DS, 4, 429}, {NOTE_G, 3, 214}, {NOTE_C, 3, 214}, 
    {NOTE_C, 4, 29}, {NOTE_DS, 4, 29}, {NOTE_GS, 4, 371}, 
    {NOTE_AS, 4, 429}, {NOTE_C, 5, 400}, {NOTE_DS, 4, 29}, 
    {NOTE_F, 4, 214}, {NOTE_F, 3, 214}, {NOTE_GS, 3, 429}, 
    {NOTE_F, 3, 429}, {NOTE_GS, 4, 214}, {NOTE_F, 3, 214}, 
    {NOTE_AS, 4, 214}, {NOTE_CS, 5, 214}, {NOTE_CS, 5, 214}, 
    {NOTE_AS, 3, 214}, {NOTE_C, 5, 214}, {NOTE_AS, 4, 214}, 
    {NOTE_AS, 4, 214}, {NOTE_GS, 4, 214}, {NOTE_DS, 3, 186}, 
    {NOTE_AS, 4, 29}, {NOTE_C, 5, 214}, {NOTE_DS, 3, 429}, 
    {NOTE_DS, 3, 214}, {NOTE_AS, 3, 214}, {NOTE_GS, 4, 214}, 
    {NOTE_CS, 4, 214}, {NOTE_AS, 4, 186}, {NOTE_AS, 4, 29}, 
    {NOTE_CS, 5, 214}, {NOTE_CS, 5, 429}, {NOTE_C, 5, 429}, 
    {NOTE_DS, 5, 29}, {NOTE_C, 6, 400}, {NOTE_DS, 5, 29}, 
    {NOTE_AS, 5, 400}, {NOTE_F, 5, 29}, {NOTE_GS, 5, 29}, 
    {NOTE_F, 6, 157}, {NOTE_GS, 3, 214}, {NOTE_DS, 3, 214}, 
    {NOTE_GS, 3, 214}, {NOTE_F, 4, 214}, {NOTE_C, 5, 214}, 
    {NOTE_GS, 4, 214}, {NOTE_AS, 4, 214}, {NOTE_DS, 5, 29}, 
    {NOTE_AS, 5, 400}, {NOTE_AS, 3, 214}, {NOTE_DS, 4, 214}, 
    {NOTE_G, 4, 214}, {NOTE_G, 5, 214}, {NOTE_DS, 5, 214}, 
    {NOTE_AS, 4, 214}, {NOTE_DS, 4, 29}, {NOTE_G, 4, 29}, 
    {NOTE_C, 5, 157}, {NOTE_G, 3, 214}, {NOTE_DS, 5, 214}, 
    {NOTE_AS, 4, 214}, {NOTE_DS, 5, 214}, {NOTE_C, 5, 214}, 
    {NOTE_F, 5, 214}, {NOTE_DS, 4, 107}, {NOTE_F, 4, 107}, 
    {NOTE_FS, 4, 29}, {NOTE_A, 4, 29}, {NOTE_CS, 5, 29}, 
    {NOTE_FS, 5, 343}, {NOTE_FS, 4, 429}, {NOTE_A, 4, 429}, 
    {NOTE_DS, 5, 429}, {NOTE_F, 5, 29}, {NOTE_AS, 5, 29}, 
    {NOTE_C, 6, 371}, {NOTE_AS, 5, 214}, {NOTE_AS, 5, 214}, 
    {NOTE_DS, 4, 429}, {NOTE_F, 3, 214}, {NOTE_DS, 5, 214}, 
    {NOTE_DS, 5, 214}, {NOTE_DS, 6, 214}, {NOTE_DS, 6, 214}, 
    {NOTE_DS, 6, 214}, {NOTE_DS, 6, 214}, {NOTE_G, 5, 214}, 
    {NOTE_G, 5, 214}, {NOTE_F, 5, 107}, {NOTE_G, 5, 107}, 
    {NOTE_DS, 3, 429}, {NOTE_F, 5, 214}, {NOTE_DS, 4, 214}, 
    {NOTE_G, 5, 214}, {NOTE_F, 5, 643}, {NOTE_F, 4, 29}, 
    {NOTE_C, 5, 29}, {NOTE_F, 5, 371}, {NOTE_G, 5, 321}, 
    {NOTE_DS, 3, 107}, {NOTE_GS, 5, 214}, {NOTE_DS, 3, 214}, 
    {NOTE_AS, 5, 429}, {NOTE_AS, 4, 29}, {NOTE_F, 5, 29}, 
    {NOTE_AS, 5, 371}, {NOTE_GS, 3, 214}, {NOTE_CS, 3, 214}, 
    {NOTE_C, 5, 214}, {NOTE_CS, 3, 214}, {NOTE_C, 6, 214}, 
    {NOTE_C, 4, 214}, {NOTE_F, 4, 429}, {NOTE_C, 6, 214}, 
    {NOTE_CS, 3, 214}, {NOTE_F, 5, 400}, {NOTE_GS, 5, 29}, 
    {NOTE_AS, 5, 143}, {NOTE_GS, 3, 143}, {NOTE_CS, 3, 143}, 
    {NOTE_AS, 5, 429}, {NOTE_GS, 3, 214}, {NOTE_CS, 3, 214}, 
    {NOTE_AS, 4, 214}, {NOTE_GS, 3, 214}, {NOTE_AS, 3, 214}, 
    {NOTE_E, 3, 214}, {NOTE_GS, 5, 400}, {NOTE_AS, 5, 29}, 
    {NOTE_C, 6, 214}, {NOTE_E, 3, 214}, {NOTE_DS, 5, 214}, 
    {NOTE_GS, 3, 214}, {NOTE_AS, 5, 429}, {NOTE_AS, 4, 29}, 
    {NOTE_DS, 5, 29}, {NOTE_GS, 5, 29}, {NOTE_AS, 5, 343}, 
    {NOTE_DS, 4, 214}, {NOTE_C, 3, 214}, {NOTE_AS, 4, 214}, 
    {NOTE_G, 3, 214}, {NOTE_DS, 5, 214}, {NOTE_C, 3, 214}, 
    {NOTE_DS, 4, 29}, {NOTE_AS, 4, 29}, {NOTE_DS, 5, 371}, 
    {NOTE_C, 6, 214}, {NOTE_C, 3, 214}, {NOTE_DS, 5, 400}, 
    {NOTE_G, 5, 29}, {NOTE_GS, 5, 429}, {NOTE_F, 3, 429}, 
    {NOTE_F, 3, 214}, {NOTE_GS, 3, 214}, {NOTE_DS, 5, 214}, 
    {NOTE_F, 3, 214}, {NOTE_AS, 3, 143}, {NOTE_C, 3, 286}, 
    {NOTE_GS, 5, 429}, {NOTE_AS, 5, 143}, {NOTE_DS, 4, 286}, 
    {NOTE_C, 6, 143}, {NOTE_DS, 3, 286}, {NOTE_DS, 6, 429}, 
    {NOTE_DS, 5, 29}, {NOTE_GS, 5, 29}, {NOTE_C, 6, 29}, 
    {NOTE_DS, 6, 343}, {NOTE_CS, 6, 214}, {NOTE_C, 6, 214}, 
    {NOTE_AS, 5, 429}, {NOTE_GS, 3, 214}, {NOTE_CS, 3, 214}, 
    {NOTE_DS, 4, 429}, {NOTE_C, 6, 214}, {NOTE_GS, 3, 214}, 
    {NOTE_DS, 5, 214}, {NOTE_GS, 3, 186}, {NOTE_GS, 5, 29}, 
    {NOTE_AS, 5, 214}, {NOTE_CS, 3, 186}, {NOTE_GS, 5, 29}, 
    {NOTE_AS, 5, 321}, {NOTE_B, 5, 107}, {NOTE_AS, 5, 107}, 
    {NOTE_B, 5, 107}, {NOTE_AS, 5, 107}, {NOTE_B, 5, 107}, 
    {NOTE_AS, 5, 429}, {NOTE_GS, 3, 214}, {NOTE_GS, 5, 214}, 
    {NOTE_G, 5, 429}, {NOTE_GS, 5, 214}, {NOTE_E, 3, 214}, 
    {NOTE_AS, 5, 214}, {NOTE_GS, 3, 214}, {NOTE_GS, 5, 429}, 
    {NOTE_AS, 4, 29}, {NOTE_DS, 5, 29}, {NOTE_G, 5, 29}, 
    {NOTE_AS, 5, 343}, {NOTE_GS, 5, 214}, {NOTE_C, 3, 214}, 
    {NOTE_AS, 5, 214}, {NOTE_G, 3, 214}, {NOTE_GS, 5, 214}, 
    {NOTE_DS, 3, 214}, {NOTE_AS, 4, 29}, {NOTE_DS, 5, 29}, 
    {NOTE_AS, 5, 371}, {NOTE_C, 6, 214}, {NOTE_C, 3, 214}, 
    {NOTE_DS, 6, 214}, {NOTE_C, 3, 429}, {NOTE_C, 5, 29}, 
    {NOTE_F, 5, 29}, {NOTE_A, 5, 29}, {NOTE_C, 6, 129}, 
    {NOTE_C, 6, 429}, {NOTE_C, 3, 214}, {NOTE_F, 3, 214}, 
    {NOTE_A, 3, 214}, {NOTE_C, 4, 214}, {NOTE_F, 4, 214}, 
    {NOTE_A, 4, 214}, {NOTE_F, 5, 400}, {NOTE_AS, 5, 29}, 
    {NOTE_C, 6, 429}, {NOTE_C, 5, 429}, {NOTE_AS, 5, 400}, 
    {NOTE_GS, 5, 29}, {NOTE_AS, 5, 1686}, {NOTE_AS, 5, 29}, 
    {NOTE_C, 6, 429}, {NOTE_DS, 5, 429}, {NOTE_C, 6, 400}, 
    {NOTE_GS, 5, 29}, {NOTE_AS, 5, 429}, {NOTE_AS, 5, 3429}, 
    {NOTE_GS, 4, 214}, {NOTE_AS, 3, 214}, {NOTE_C, 4, 214}, 
    {NOTE_DS, 4, 214}, {NOTE_GS, 3, 214}, {NOTE_AS, 3, 214}, 
    {NOTE_C, 4, 214}, {NOTE_DS, 4, 214}, {NOTE_GS, 4, 29}, 
    {NOTE_DS, 5, 186}, {NOTE_AS, 3, 214}, {NOTE_C, 4, 214}, 
    {NOTE_DS, 4, 214}, {NOTE_DS, 5, 214}, {NOTE_AS, 3, 214}, 
    {NOTE_C, 4, 214}, {NOTE_DS, 4, 214}, {NOTE_G, 4, 29}, 
    {NOTE_DS, 5, 186}, {NOTE_AS, 3, 214}, {NOTE_C, 4, 214}, 
    {NOTE_DS, 4, 214}, {NOTE_GS, 3, 214}, {NOTE_AS, 3, 214}, 
    {NOTE_C, 4, 214}, {NOTE_DS, 4, 214}, {NOTE_AS, 4, 214}, 
    {NOTE_AS, 3, 214}, {NOTE_C, 4, 214}, {NOTE_DS, 4, 214}, 
    {NOTE_GS, 4, 29}, {NOTE_DS, 5, 186}, {NOTE_AS, 3, 214}, 
    {NOTE_C, 4, 214}, {NOTE_DS, 4, 214}, {NOTE_GS, 4, 214}, 
    {NOTE_AS, 3, 214}, {NOTE_GS, 5, 214}, {NOTE_GS, 4, 214}, 
    {NOTE_GS, 5, 214}, {NOTE_AS, 3, 214}, {NOTE_C, 4, 214}, 
    {NOTE_DS, 4, 214}, {NOTE_GS, 4, 214}, {NOTE_AS, 3, 214}, 
    {NOTE_C, 4, 214}, {NOTE_DS, 4, 214}, {NOTE_GS, 5, 214}, 
    {NOTE_AS, 3, 214}, {NOTE_DS, 6, 214}, {NOTE_DS, 4, 214}, 
    {NOTE_DS, 5, 29}, {NOTE_GS, 5, 29}, {NOTE_DS, 6, 157}, 
    {NOTE_AS, 3, 214}, {NOTE_C, 4, 214}, {NOTE_G, 6, 214}, 
    {NOTE_G, 6, 214}, {NOTE_AS, 3, 214}, {NOTE_C, 4, 214}, 
    {NOTE_DS, 4, 214}, {NOTE_GS, 5, 29}, {NOTE_GS, 6, 186}, 
    {NOTE_AS, 3, 214}, {NOTE_C, 4, 214}, {NOTE_DS, 4, 214}, 
    {NOTE_DS, 6, 214}, {NOTE_AS, 3, 214}, {NOTE_C, 4, 214}, 
    {NOTE_DS, 4, 214}, {NOTE_GS, 4, 29}, {NOTE_C, 5, 29}, 
    {NOTE_DS, 5, 29}, {NOTE_G, 5, 129}, {NOTE_AS, 4, 214}, 
    {NOTE_C, 5, 214}, {NOTE_DS, 5, 214}, {NOTE_GS, 5, 214}, 
    {NOTE_AS, 4, 214}, {NOTE_C, 5, 214}, {NOTE_DS, 5, 214}, 
    {NOTE_GS, 4, 214}, {NOTE_AS, 4, 214}, {NOTE_C, 5, 214}, 
    {NOTE_DS, 5, 214}, {NOTE_GS, 5, 214}, {NOTE_AS, 4, 214}, 
    {NOTE_C, 5, 214}, {NOTE_DS, 5, 214}, {NOTE_GS, 4, 29}, 
    {NOTE_AS, 4, 29}, {NOTE_DS, 5, 29}, {NOTE_G, 5, 129}, 
    {NOTE_AS, 4, 214}, {NOTE_C, 5, 214}, {NOTE_DS, 5, 214}, 
    {NOTE_GS, 4, 214}, {NOTE_AS, 4, 214}, {NOTE_C, 5, 214}, 
    {NOTE_DS, 5, 214}, {NOTE_DS, 5, 214}, {NOTE_GS, 4, 214}, 
    {NOTE_AS, 4, 214}, {NOTE_DS, 5, 214}, {NOTE_GS, 4, 214}, 
    {NOTE_AS, 4, 214}, {NOTE_C, 5, 214}, {NOTE_DS, 5, 214}, 
    {NOTE_GS, 4, 29}, {NOTE_C, 5, 29}, {NOTE_G, 5, 157}, 
    {NOTE_AS, 4, 214}, {NOTE_C, 5, 214}, {NOTE_DS, 5, 214}, 
    {NOTE_GS, 4, 214}, {NOTE_AS, 4, 214}, {NOTE_C, 5, 214}, 
    {NOTE_DS, 5, 214}, {NOTE_GS, 4, 214}, {NOTE_AS, 4, 214}, 
    {NOTE_C, 5, 214}, {NOTE_DS, 5, 214}, {NOTE_DS, 5, 214}, 
    {NOTE_G, 5, 214}, {NOTE_GS, 5, 143}, {NOTE_DS, 3, 71}, 
    {NOTE_DS, 6, 214}, {NOTE_AS, 4, 29}, {NOTE_DS, 5, 29}, 
    {NOTE_G, 5, 29}, {NOTE_AS, 5, 343}, {NOTE_GS, 3, 429}, 
    {NOTE_DS, 5, 29}, {NOTE_G, 5, 29}, {NOTE_DS, 6, 586}, 
    {NOTE_G, 5, 71}, {NOTE_F, 5, 71}, {NOTE_DS, 5, 71}, 
    {NOTE_AS, 4, 643}, {NOTE_C, 3, 214}, {NOTE_DS, 3, 643}, 
    {NOTE_GS, 3, 214}, {NOTE_GS, 4, 143}, {NOTE_DS, 4, 143}, 
    {NOTE_DS, 4, 143}, {NOTE_DS, 4, 143}, {NOTE_DS, 4, 143}, 
    {NOTE_DS, 4, 143}, {NOTE_DS, 5, 321}, {NOTE_DS, 4, 321}, 
    {NOTE_GS, 3, 214}, {NOTE_CS, 3, 214}, {NOTE_DS, 4, 214}, 
    {NOTE_DS, 4, 143}, {NOTE_DS, 4, 143}, {NOTE_DS, 4, 143}, 
    {NOTE_DS, 5, 321}, {NOTE_DS, 4, 107}, {NOTE_AS, 3, 214}, 
    {NOTE_GS, 3, 214}, {NOTE_AS, 4, 143}, {NOTE_DS, 4, 71}, 
    {NOTE_C, 3, 71}, {NOTE_DS, 4, 143}, {NOTE_DS, 4, 143}, 
    {NOTE_DS, 4, 143}, {NOTE_DS, 4, 143}, {NOTE_AS, 4, 214}, 
    {NOTE_C, 4, 107}, {NOTE_DS, 4, 321}, {NOTE_GS, 3, 214}, 
    {NOTE_DS, 4, 29}, {NOTE_GS, 4, 186}, {NOTE_DS, 4, 214}, 
    {NOTE_CS, 5, 143}, {NOTE_C, 5, 143}, {NOTE_AS, 4, 143}, 
    {NOTE_AS, 4, 214}, {NOTE_DS, 4, 214}, {NOTE_GS, 4, 214}, 
    {NOTE_DS, 4, 214}, {NOTE_GS, 4, 107}, {NOTE_C, 4, 107}, 
    {NOTE_DS, 4, 214}, {NOTE_C, 4, 214}, {NOTE_DS, 5, 214}, 
    {NOTE_DS, 5, 214}, {NOTE_DS, 5, 107}, {NOTE_AS, 3, 107}, 
    {NOTE_CS, 5, 107}, {NOTE_DS, 5, 107}, {NOTE_CS, 5, 214}, 
    {NOTE_C, 5, 214}, {NOTE_DS, 5, 214}, {NOTE_C, 5, 214}, 
    {NOTE_DS, 5, 214}, {NOTE_C, 5, 321}, {NOTE_AS, 4, 321}, 
    {NOTE_AS, 4, 214}, {NOTE_FS, 4, 29}, {NOTE_CS, 5, 29}, 
    {NOTE_F, 5, 157}, {NOTE_F, 5, 214}, {NOTE_F, 5, 214}, 
    {NOTE_F, 5, 107}, {NOTE_DS, 3, 107}, {NOTE_FS, 4, 29}, 
    {NOTE_AS, 4, 29}, {NOTE_F, 5, 157}, {NOTE_DS, 5, 214}, 
    {NOTE_DS, 5, 214}, {NOTE_DS, 5, 214}, {NOTE_DS, 5, 29}, 
    {NOTE_GS, 5, 186}, {NOTE_GS, 5, 107}, {NOTE_F, 5, 107}, 
    {NOTE_GS, 5, 214}, {NOTE_DS, 5, 214}, {NOTE_GS, 5, 214}, 
    {NOTE_AS, 5, 214}, {NOTE_C, 6, 214}, {NOTE_F, 5, 214}, 
    {NOTE_F, 5, 429}, {NOTE_CS, 3, 214}, {NOTE_DS, 5, 214}, 
    {NOTE_F, 5, 214}, {NOTE_F, 5, 214}, {NOTE_C, 5, 214}, 
    {NOTE_F, 5, 214}, {NOTE_F, 5, 214}, {NOTE_DS, 5, 214}, 
    {NOTE_AS, 3, 214}, {NOTE_DS, 5, 214}, {NOTE_DS, 5, 214}, 
    {NOTE_F, 5, 214}, {NOTE_GS, 5, 143}, {NOTE_B, 3, 71}, 
    {NOTE_F, 5, 186}, {NOTE_GS, 5, 29}, {NOTE_AS, 5, 214}, 
    {NOTE_DS, 5, 214}, {NOTE_DS, 5, 143}, {NOTE_DS, 3, 71}, 
    {NOTE_DS, 5, 214}, {NOTE_DS, 5, 143}, {NOTE_C, 3, 71}, 
    {NOTE_F, 5, 71}, {NOTE_DS, 3, 143}, {NOTE_GS, 5, 143}, 
    {NOTE_F, 3, 71}, {NOTE_F, 5, 214}, {NOTE_F, 5, 143}, 
    {NOTE_F, 3, 214}, {NOTE_G, 3, 71}, {NOTE_C, 5, 36}, 
    {NOTE_C, 3, 107}, {NOTE_CS, 5, 143}, {NOTE_A, 3, 286}, 
    {NOTE_DS, 5, 429}, {NOTE_C, 6, 214}, {NOTE_AS, 3, 29}, 
    {NOTE_F, 4, 29}, {NOTE_GS, 4, 29}, {NOTE_DS, 5, 21}, 
    {NOTE_GS, 5, 29}, {NOTE_C, 6, 79}, {NOTE_CS, 6, 214}, 
    {NOTE_C, 6, 214}, {NOTE_CS, 6, 214}, {NOTE_C, 6, 214}, 
    {NOTE_DS, 5, 214}, {NOTE_DS, 5, 429}, {NOTE_AS, 4, 214}, 
    {NOTE_C, 6, 214}, {NOTE_C, 6, 214}, {NOTE_CS, 6, 214}, 
    {NOTE_C, 6, 214}, {NOTE_DS, 5, 214}, {NOTE_DS, 5, 214}, 
    {NOTE_GS, 5, 107}, {NOTE_AS, 5, 107}, {NOTE_DS, 3, 214}, 
    {NOTE_GS, 5, 107}, {NOTE_G, 5, 107}, {NOTE_F, 5, 214}, 
    {NOTE_DS, 3, 214}, {NOTE_F, 5, 214}, {NOTE_GS, 5, 214}, 
    {NOTE_C, 3, 143}, {NOTE_C, 3, 143}, {NOTE_DS, 3, 143}, 
    {NOTE_F, 5, 429}, {NOTE_G, 5, 214}, {NOTE_C, 3, 214}, 
    {NOTE_GS, 5, 400}, {NOTE_GS, 5, 29}, {NOTE_AS, 5, 214}, 
    {NOTE_GS, 3, 214}, {NOTE_AS, 5, 429}, {NOTE_CS, 3, 214}, 
    {NOTE_GS, 3, 214}, {NOTE_DS, 5, 214}, {NOTE_CS, 3, 214}, 
    {NOTE_GS, 4, 214}, {NOTE_DS, 5, 214}, {NOTE_DS, 5, 214}, 
    {NOTE_DS, 4, 214}, {NOTE_C, 6, 214}, {NOTE_GS, 3, 214}, 
    {NOTE_DS, 5, 214}, {NOTE_CS, 3, 186}, {NOTE_GS, 5, 29}, 
    {NOTE_AS, 5, 214}, {NOTE_GS, 3, 186}, {NOTE_GS, 5, 29}, 
    {NOTE_AS, 5, 429}, {NOTE_E, 4, 214}, {NOTE_CS, 3, 214}, 
    {NOTE_AS, 4, 214}, {NOTE_CS, 3, 214}, {NOTE_GS, 4, 214}, 
    {NOTE_E, 5, 214}, {NOTE_GS, 5, 400}, {NOTE_AS, 5, 29}, 
    {NOTE_C, 6, 214}, {NOTE_CS, 3, 214}, {NOTE_DS, 5, 214}, 
    {NOTE_GS, 3, 214}, {NOTE_AS, 5, 143}, {NOTE_B, 3, 257}, 
    {NOTE_GS, 5, 29}, {NOTE_AS, 5, 214}, {NOTE_G, 3, 214}, 
    {NOTE_DS, 6, 214}, {NOTE_DS, 5, 214}, {NOTE_DS, 6, 214}, 
    {NOTE_DS, 5, 214}, {NOTE_AS, 3, 214}, {NOTE_G, 3, 214}, 
    {NOTE_AS, 4, 400}, {NOTE_AS, 5, 29}, {NOTE_C, 6, 214}, 
    {NOTE_AS, 3, 214}, {NOTE_DS, 5, 214}, {NOTE_C, 3, 214}, 
    {NOTE_GS, 5, 214}, {NOTE_DS, 3, 214}, {NOTE_GS, 5, 214}, 
    {NOTE_AS, 5, 214}, {NOTE_GS, 5, 214}, {NOTE_C, 3, 107}, 
    {NOTE_DS, 3, 107}, {NOTE_GS, 4, 214}, {NOTE_G, 4, 214}, 
    {NOTE_GS, 4, 214}, {NOTE_AS, 4, 214}, {NOTE_GS, 5, 214}, 
    {NOTE_AS, 4, 214}, {NOTE_AS, 5, 214}, {NOTE_DS, 5, 214}, 
    {NOTE_C, 6, 214}, {NOTE_DS, 5, 214}, {NOTE_DS, 6, 214}, 
    {NOTE_DS, 5, 71}, {NOTE_GS, 5, 71}, {NOTE_C, 6, 71}, 
    {NOTE_DS, 6, 429}, {NOTE_CS, 6, 214}, {NOTE_C, 6, 214}, 
    {NOTE_AS, 5, 214}, {NOTE_CS, 3, 214}, {NOTE_F, 5, 214}, 
    {NOTE_GS, 3, 214}, {NOTE_GS, 4, 29}, {NOTE_C, 5, 29}, 
    {NOTE_DS, 5, 29}, {NOTE_F, 5, 343}, {NOTE_C, 6, 429}, 
    {NOTE_DS, 5, 214}, {NOTE_CS, 3, 186}, {NOTE_GS, 5, 29}, 
    {NOTE_AS, 5, 214}, {NOTE_GS, 3, 186}, {NOTE_GS, 5, 29}, 
    {NOTE_AS, 5, 429}, {NOTE_CS, 3, 214}, {NOTE_GS, 3, 214}, 
    {NOTE_CS, 4, 214}, {NOTE_DS, 4, 214}, {NOTE_E, 4, 214}, 
    {NOTE_GS, 4, 214}, {NOTE_G, 5, 429}, {NOTE_GS, 5, 214}, 
    {NOTE_CS, 3, 214}, {NOTE_AS, 5, 214}, {NOTE_DS, 3, 214}, 
    {NOTE_GS, 5, 214}, {NOTE_GS, 3, 214}, {NOTE_AS, 4, 29}, 
    {NOTE_DS, 5, 29}, {NOTE_G, 5, 29}, {NOTE_AS, 5, 343}, 
    {NOTE_GS, 5, 214}, {NOTE_DS, 3, 214}, {NOTE_AS, 5, 214}, 
    {NOTE_C, 3, 214}, {NOTE_GS, 5, 214}, {NOTE_F, 5, 214}, 
    {NOTE_AS, 5, 429}, {NOTE_C, 6, 429}, {NOTE_DS, 6, 214}, 
    {NOTE_C, 6, 214}, {NOTE_FS, 3, 214}, {NOTE_DS, 6, 214}, 
    {NOTE_DS, 6, 214}, {NOTE_F, 3, 214}, {NOTE_F, 6, 214}, 
    {NOTE_C, 3, 107}, {NOTE_F, 3, 107}, {NOTE_F, 5, 214}, 
    {NOTE_C, 3, 214}, {NOTE_C, 6, 214}, {NOTE_F, 6, 214}, 
    {NOTE_F, 6, 214}, {NOTE_C, 6, 214}, {NOTE_C, 6, 214}, 
    {NOTE_C, 6, 214}, {NOTE_C, 6, 214}, {NOTE_C, 6, 214}, 
    {NOTE_C, 6, 214}, {NOTE_DS, 6, 214}, {NOTE_C, 6, 107}, 
    {NOTE_B, 5, 107}, {NOTE_DS, 5, 214}, {NOTE_AS, 5, 214}, 
    {NOTE_DS, 5, 214}, {NOTE_GS, 3, 214}, {NOTE_CS, 3, 214}, 
    {NOTE_GS, 5, 214}, {NOTE_GS, 5, 186}, {NOTE_AS, 5, 29}, 
    {NOTE_C, 6, 214}, {NOTE_C, 6, 214}, {NOTE_C, 6, 214}, 
    {NOTE_C, 6, 214}, {NOTE_C, 6, 214}, {NOTE_C, 6, 214}, 
    {NOTE_C, 6, 214}, {NOTE_DS, 6, 214}, {NOTE_C, 6, 107}, 
    {NOTE_B, 5, 107}, {NOTE_AS, 3, 214}, {NOTE_AS, 5, 214}, 
    {NOTE_DS, 5, 214}, {NOTE_E, 4, 214}, {NOTE_CS, 5, 214}, 
    {NOTE_E, 5, 214}, {NOTE_GS, 5, 214}, {NOTE_AS, 5, 214}, 
    {NOTE_AS, 5, 214}, {NOTE_AS, 5, 214}, {NOTE_GS, 5, 214}, 
    {NOTE_GS, 5, 214}, {NOTE_GS, 5, 214}, {NOTE_AS, 5, 214}, 
    {NOTE_GS, 5, 214}, {NOTE_AS, 4, 29}, {NOTE_DS, 5, 29}, 
    {NOTE_G, 5, 29}, {NOTE_AS, 5, 343}, {NOTE_G, 5, 214}, 
    {NOTE_G, 5, 214}, {NOTE_AS, 6, 214}, {NOTE_C, 3, 214}, 
    {NOTE_G, 6, 214}, {NOTE_C, 3, 214}, {NOTE_C, 5, 214}, 
    {NOTE_DS, 5, 107}, {NOTE_C, 3, 107}, {NOTE_C, 5, 214}, 
    {NOTE_AS, 5, 214}, {NOTE_AS, 5, 214}, {NOTE_GS, 5, 214}, 
    {NOTE_GS, 5, 214}, {NOTE_GS, 5, 214}, {NOTE_AS, 4, 29}, 
    {NOTE_DS, 5, 29}, {NOTE_G, 5, 29}, {NOTE_AS, 5, 129}, 
    {NOTE_C, 3, 107}, {NOTE_DS, 3, 107}, {NOTE_AS, 5, 214}, 
    {NOTE_F, 3, 214}, {NOTE_AS, 5, 214}, {NOTE_F, 3, 214}, 
    {NOTE_GS, 5, 143}, {NOTE_AS, 3, 286}, {NOTE_F, 4, 286}, 
    {NOTE_G, 3, 114}, {NOTE_AS, 4, 29}, {NOTE_C, 5, 143}, 
    {NOTE_GS, 3, 214}, {NOTE_DS, 3, 71}, {NOTE_F, 4, 143}, 
    {NOTE_C, 3, 286}, {NOTE_AS, 4, 214}, {NOTE_DS, 4, 186}, 
    {NOTE_GS, 4, 29}, {NOTE_AS, 4, 214}, {NOTE_F, 3, 214}, 
    {NOTE_AS, 3, 214}, {NOTE_CS, 3, 214}, {NOTE_GS, 4, 214}, 
    {NOTE_DS, 3, 214}, {NOTE_DS, 4, 214}, {NOTE_C, 3, 186}, 
    {NOTE_AS, 5, 29}, {NOTE_C, 6, 214}, {NOTE_GS, 3, 214}, 
    {NOTE_F, 5, 214}, {NOTE_F, 3, 214}, {NOTE_C, 6, 214}, 
    {NOTE_F, 3, 186}, {NOTE_GS, 5, 29}, {NOTE_AS, 5, 143}, 
    {NOTE_C, 3, 286}, {NOTE_CS, 3, 214}, {NOTE_GS, 3, 214}, 
    {NOTE_GS, 4, 214}, {NOTE_E, 3, 214}, {NOTE_GS, 4, 214}, 
    {NOTE_AS, 3, 214}, {NOTE_CS, 5, 214}, {NOTE_GS, 3, 214}, 
    {NOTE_C, 5, 400}, {NOTE_G, 5, 29}, {NOTE_GS, 5, 429}, 
    {NOTE_GS, 5, 107}, {NOTE_DS, 4, 107}, {NOTE_CS, 4, 71}, 
    {NOTE_C, 4, 71}, {NOTE_GS, 3, 71}, {NOTE_E, 5, 107}, 
    {NOTE_CS, 3, 107}, {NOTE_F, 4, 107}, {NOTE_G, 4, 107}, 
    {NOTE_DS, 5, 429}, {NOTE_GS, 5, 143}, {NOTE_C, 3, 286}, 
    {NOTE_G, 5, 143}, {NOTE_F, 3, 143}, {NOTE_GS, 3, 143}, 
    {NOTE_AS, 5, 143}, {NOTE_G, 3, 71}, {NOTE_GS, 5, 143}, 
    {NOTE_G, 3, 71}, {NOTE_AS, 5, 214}, {NOTE_G, 5, 214}, 
    {NOTE_GS, 5, 143}, {NOTE_DS, 3, 257}, {NOTE_AS, 5, 29}, 
    {NOTE_C, 6, 143}, {NOTE_DS, 3, 214}, {NOTE_G, 3, 71}, 
    {NOTE_GS, 5, 429}, {NOTE_F, 5, 214}, {NOTE_G, 5, 214}, 
    {NOTE_GS, 5, 214}, {NOTE_GS, 3, 186}, {NOTE_AS, 5, 29}, 
    {NOTE_C, 6, 214}, {NOTE_GS, 3, 214}, {NOTE_GS, 5, 214}, 
    {NOTE_C, 3, 214}, {NOTE_F, 5, 214}, {NOTE_G, 5, 214}, 
    {NOTE_GS, 5, 400}, {NOTE_AS, 5, 29}, {NOTE_C, 6, 214}, 
    {NOTE_F, 4, 214}, {NOTE_GS, 5, 214}, {NOTE_CS, 3, 107}, 
    {NOTE_AS, 5, 107}, {NOTE_AS, 5, 429}, {NOTE_DS, 5, 214}, 
    {NOTE_AS, 4, 214}, {NOTE_AS, 4, 107}, {NOTE_DS, 5, 107}, 
    {NOTE_C, 5, 214}, {NOTE_DS, 5, 214}, {NOTE_DS, 5, 214}, 
    {NOTE_C, 6, 214}, {NOTE_CS, 6, 214}, {NOTE_C, 6, 214}, 
    {NOTE_CS, 6, 214}, {NOTE_C, 6, 214}, {NOTE_CS, 6, 214}, 
    {NOTE_C, 6, 214}, {NOTE_CS, 6, 214}, {NOTE_C, 6, 214}, 
    {NOTE_AS, 3, 214}, {NOTE_AS, 5, 214}, {NOTE_AS, 3, 214}, 
    {NOTE_AS, 5, 214}, {NOTE_AS, 3, 214}, {NOTE_GS, 5, 143}, 
    {NOTE_AS, 3, 257}, {NOTE_AS, 5, 29}, {NOTE_C, 6, 429}, 
    {NOTE_AS, 5, 214}, {NOTE_DS, 3, 214}, {NOTE_GS, 5, 400}, 
    {NOTE_GS, 5, 29}, {NOTE_AS, 5, 429}, {NOTE_AS, 5, 429}, 
    {NOTE_CS, 3, 143}, {NOTE_GS, 3, 143}, {NOTE_CS, 3, 143}, 
    {NOTE_DS, 5, 143}, {NOTE_F, 3, 143}, {NOTE_GS, 3, 143}, 
    {NOTE_GS, 4, 143}, {NOTE_GS, 3, 143}, {NOTE_C, 4, 143}, 
    {NOTE_GS, 4, 143}, {NOTE_GS, 3, 143}, {NOTE_CS, 3, 143}, 
    {NOTE_C, 6, 143}, {NOTE_GS, 3, 143}, {NOTE_CS, 3, 143}, 
    {NOTE_F, 5, 143}, {NOTE_GS, 3, 143}, {NOTE_CS, 3, 114}, 
    {NOTE_GS, 5, 29}, {NOTE_AS, 5, 143}, {NOTE_CS, 3, 143}, 
    {NOTE_GS, 3, 114}, {NOTE_GS, 5, 29}, {NOTE_AS, 5, 143}, 
    {NOTE_GS, 3, 143}, {NOTE_CS, 3, 143}, {NOTE_CS, 5, 143}, 
    {NOTE_C, 5, 143}, {NOTE_GS, 3, 143}, {NOTE_AS, 4, 143}, 
    {NOTE_E, 3, 143}, {NOTE_GS, 4, 143}, {NOTE_AS, 3, 143}, 
    {NOTE_GS, 5, 143}, {NOTE_DS, 4, 143}, {NOTE_E, 4, 114}, 
    {NOTE_AS, 5, 29}, {NOTE_C, 6, 143}, {NOTE_CS, 4, 143}, 
    {NOTE_GS, 3, 143}, {NOTE_DS, 5, 143}, {NOTE_DS, 3, 143}, 
    {NOTE_CS, 3, 114}, {NOTE_GS, 5, 29}, {NOTE_AS, 5, 286}, 
    {NOTE_CS, 3, 143}, {NOTE_G, 3, 257}, {NOTE_GS, 5, 29}, 
    {NOTE_AS, 5, 143}, {NOTE_G, 3, 143}, {NOTE_C, 3, 143}, 
    {NOTE_F, 5, 143}, {NOTE_G, 5, 143}, {NOTE_F, 5, 143}, 
    {NOTE_G, 5, 143}, {NOTE_G, 3, 143}, {NOTE_AS, 3, 143}, 
    {NOTE_DS, 4, 214}, {NOTE_G, 4, 214}, {NOTE_AS, 4, 214}, 
    {NOTE_DS, 5, 143}, {NOTE_AS, 4, 71}, {NOTE_DS, 4, 71}, 
    {NOTE_G, 4, 71}, {NOTE_AS, 3, 43}, {NOTE_AS, 5, 29}, 
    {NOTE_C, 6, 71}, {NOTE_G, 3, 143}, {NOTE_DS, 4, 143}, 
    {NOTE_AS, 3, 71}, {NOTE_DS, 5, 71}, {NOTE_G, 3, 143}, 
    {NOTE_DS, 3, 143}, {NOTE_C, 3, 43}, {NOTE_G, 5, 29}, 
    {NOTE_GS, 5, 71}, {NOTE_G, 3, 143}, {NOTE_REST, 0, 214}, 
    {NOTE_GS, 5, 214}, {NOTE_AS, 5, 214}, {NOTE_GS, 5, 143}, 
    {NOTE_C, 3, 143}, {NOTE_F, 3, 143}, {NOTE_G, 3, 143}, 
    {NOTE_GS, 3, 143}, {NOTE_C, 4, 143}, {NOTE_GS, 3, 143}, 
    {NOTE_C, 4, 143}, {NOTE_DS, 4, 143}, {NOTE_GS, 5, 214}, 
    {NOTE_DS, 4, 214}, {NOTE_AS, 5, 214}, {NOTE_DS, 4, 143}, 
    {NOTE_C, 4, 71}, {NOTE_C, 6, 214}, {NOTE_C, 4, 143}, 
    {NOTE_GS, 3, 71}, {NOTE_DS, 6, 71}, {NOTE_F, 3, 143}, 
    {NOTE_F, 3, 143}, {NOTE_C, 3, 143}, {NOTE_F, 3, 143}, 
    {NOTE_DS, 5, 29}, {NOTE_GS, 5, 29}, {NOTE_C, 6, 29}, 
    {NOTE_DS, 6, 57}, {NOTE_F, 3, 143}, {NOTE_AS, 3, 143}, 
    {NOTE_CS, 6, 143}, {NOTE_F, 3, 71}, {NOTE_C, 6, 71}, 
    {NOTE_GS, 3, 143}, {NOTE_AS, 5, 143}, {NOTE_F, 3, 143}, 
    {NOTE_AS, 3, 143}, {NOTE_C, 4, 143}, {NOTE_CS, 4, 143}, 
    {NOTE_F, 4, 143}, {NOTE_DS, 5, 143}, {NOTE_F, 4, 143}, 
    {NOTE_CS, 4, 143}, {NOTE_C, 6, 143}, {NOTE_CS, 4, 143}, 
    {NOTE_AS, 3, 143}, {NOTE_DS, 5, 143}, {NOTE_F, 3, 143}, 
    {NOTE_CS, 3, 114}, {NOTE_GS, 5, 29}, {NOTE_AS, 5, 143}, 
    {NOTE_CS, 3, 143}, {NOTE_AS, 3, 114}, {NOTE_GS, 5, 29}, 
    {NOTE_AS, 5, 143}, {NOTE_AS, 3, 143}, {NOTE_DS, 3, 143}, 
    {NOTE_GS, 3, 143}, {NOTE_CS, 4, 143}, {NOTE_DS, 4, 143}, 
    {NOTE_GS, 4, 214}, {NOTE_E, 4, 214}, {NOTE_CS, 5, 214}, 
    {NOTE_GS, 5, 143}, {NOTE_E, 3, 71}, {NOTE_G, 5, 71}, 
    {NOTE_CS, 3, 143}, {NOTE_DS, 3, 143}, {NOTE_AS, 3, 71}, 
    {NOTE_GS, 5, 71}, {NOTE_DS, 3, 143}, {NOTE_GS, 3, 143}, 
    {NOTE_DS, 3, 71}, {NOTE_AS, 5, 71}, {NOTE_GS, 3, 143}, 
    {NOTE_CS, 4, 143}, {NOTE_GS, 3, 71}, {NOTE_GS, 5, 71}, 
    {NOTE_DS, 3, 143}, {NOTE_CS, 3, 143}, {NOTE_GS, 3, 143}, 
    {NOTE_CS, 3, 143}, {NOTE_AS, 4, 29}, {NOTE_DS, 5, 29}, 
    {NOTE_G, 5, 29}, {NOTE_AS, 5, 57}, {NOTE_G, 3, 143}, 
    {NOTE_C, 3, 143}, {NOTE_GS, 5, 143}, {NOTE_G, 3, 143}, 
    {NOTE_C, 3, 143}, {NOTE_AS, 5, 143}, {NOTE_DS, 3, 143}, 
    {NOTE_C, 3, 143}, {NOTE_GS, 5, 143}, {NOTE_G, 3, 286}, 
    {NOTE_AS, 4, 29}, {NOTE_DS, 5, 29}, {NOTE_G, 5, 29}, 
    {NOTE_AS, 5, 57}, {NOTE_G, 3, 143}, {NOTE_C, 3, 143}, 
    {NOTE_C, 6, 143}, {NOTE_G, 3, 143}, {NOTE_AS, 3, 143}, 
    {NOTE_DS, 6, 143}, {NOTE_AS, 3, 143}, {NOTE_DS, 4, 143}, 
    {NOTE_G, 4, 143}, {NOTE_AS, 4, 71}, {NOTE_C, 6, 214}, 
    {NOTE_C, 6, 321}, {NOTE_AS, 5, 107}, {NOTE_GS, 5, 214}, 
    {NOTE_F, 4, 214}, {NOTE_GS, 4, 214}, {NOTE_F, 4, 214}, 
    {NOTE_C, 4, 214}, {NOTE_F, 4, 214}, {NOTE_F, 5, 429}, 
    {NOTE_C, 6, 429}, {NOTE_C, 5, 429}, {NOTE_AS, 5, 429}, 
    {NOTE_CS, 5, 29}, {NOTE_GS, 5, 29}, {NOTE_AS, 5, 371}, 
    {NOTE_F, 4, 429}, {NOTE_GS, 4, 429}, {NOTE_F, 4, 400}, 
    {NOTE_AS, 5, 29}, {NOTE_C, 6, 571}, {NOTE_CS, 5, 471}, 
    {NOTE_AS, 5, 29}, {NOTE_C, 6, 71}, {NOTE_C, 5, 286}, 
    {NOTE_GS, 4, 71}, {NOTE_GS, 5, 107}, {NOTE_AS, 5, 107}, 
    {NOTE_E, 4, 1714}, {NOTE_DS, 4, 857}, {NOTE_C, 5, 286}, 
    {NOTE_AS, 3, 429}, {NOTE_AS, 4, 286}, {NOTE_GS, 4, 257}, 
    {NOTE_F, 4, 29}, {NOTE_G, 4, 857}, {NOTE_DS, 4, 857}, 
    {NOTE_DS, 4, 429}, {NOTE_GS, 3, 429}, {NOTE_G, 3, 214}, 
    {NOTE_AS, 3, 214}, {NOTE_DS, 4, 214}, {NOTE_F, 4, 214}, 
    {NOTE_G, 4, 429}, {NOTE_C, 3, 429}, {NOTE_DS, 4, 857}, 
    {NOTE_DS, 4, 857}, {NOTE_G, 3, 214}, {NOTE_GS, 3, 214}, 
    {NOTE_AS, 3, 214}, {NOTE_C, 4, 214}, {NOTE_GS, 3, 29}, 
    {NOTE_CS, 4, 400}, {NOTE_DS, 4, 429}, {NOTE_F, 4, 429}, 
    {NOTE_GS, 4, 429}, {NOTE_C, 5, 1714}, {NOTE_CS, 4, 429}, 
    {NOTE_DS, 4, 429}, {NOTE_F, 4, 429}, {NOTE_GS, 4, 429}, 
    {NOTE_E, 4, 29}, {NOTE_GS, 4, 29}, {NOTE_C, 5, 29}, 
    {NOTE_DS, 5, 1200}, {NOTE_REST, 0, 214}, {NOTE_GS, 4, 71}, 
    {NOTE_DS, 4, 71}, {NOTE_AS, 3, 71}, {NOTE_GS, 3, 29}, 
    {NOTE_GS, 3, 29}, {NOTE_GS, 3, 29}, {NOTE_AS, 3, 21}, 
    {NOTE_DS, 4, 29}, {NOTE_F, 4, 29}, {NOTE_G, 4, 3264}
};

/* 1287 buzzer events, about 279 seconds at the source tempo. */
