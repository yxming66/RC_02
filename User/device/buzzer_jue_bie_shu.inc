/*
 * Jue Bie Shu.
 * Source material: the PDF score in the local Edge save directory.
 * This is a single-line PWM buzzer reduction of the piano score: the right-hand
 * melody is kept, while accompaniment notes are folded into sustained melody
 * durations so the recognizable contour and tempo changes remain.
 */
#define JBS96_UNIT_MS 156U
#define JBS112_UNIT_MS 134U
#define JBS96(note, octave, units) {note, octave, (uint16_t)(JBS96_UNIT_MS * (units))}
#define JBS112(note, octave, units) {note, octave, (uint16_t)(JBS112_UNIT_MS * (units))}

const Tone_t JUE_BIE_SHU[] = {
    /* Bars 1-8 */
    JBS96(NOTE_D, 5, 4), JBS96(NOTE_A, 5, 3),
    JBS96(NOTE_G, 5, 3), JBS96(NOTE_A, 5, 6),
    JBS96(NOTE_A, 5, 16),
    JBS96(NOTE_C, 5, 4), JBS96(NOTE_G, 5, 3),
    JBS96(NOTE_F, 5, 3), JBS96(NOTE_G, 5, 6),
    JBS96(NOTE_G, 5, 16),
    JBS96(NOTE_C, 5, 4), JBS96(NOTE_G, 5, 3),
    JBS96(NOTE_F, 5, 3), JBS96(NOTE_G, 5, 6),
    JBS96(NOTE_G, 5, 16),
    JBS96(NOTE_C, 6, 4), JBS96(NOTE_F, 5, 3),
    JBS96(NOTE_E, 5, 3), JBS96(NOTE_F, 5, 6),
    JBS96(NOTE_F, 5, 16),

    /* Bars 9-16 */
    JBS96(NOTE_D, 5, 3), JBS96(NOTE_A, 5, 3),
    JBS96(NOTE_G, 5, 3), JBS96(NOTE_A, 5, 4),
    JBS96(NOTE_G, 5, 3),
    JBS96(NOTE_A, 5, 4), JBS96(NOTE_D, 6, 4),
    JBS96(NOTE_A, 5, 4), JBS96(NOTE_G, 5, 4),
    JBS96(NOTE_A, 5, 2), JBS96(NOTE_G, 5, 2),
    JBS96(NOTE_A, 5, 2), JBS96(NOTE_G, 5, 2),
    JBS96(NOTE_A, 5, 5), JBS96(NOTE_G, 5, 3),
    JBS96(NOTE_C, 5, 16),
    JBS96(NOTE_C, 5, 3), JBS96(NOTE_G, 5, 3),
    JBS96(NOTE_F, 5, 3), JBS96(NOTE_G, 5, 4),
    JBS96(NOTE_F, 5, 3),
    JBS96(NOTE_G, 5, 4), JBS96(NOTE_C, 6, 4),
    JBS96(NOTE_C, 6, 4), JBS96(NOTE_G, 5, 4),
    JBS96(NOTE_G, 5, 2), JBS96(NOTE_A, 5, 2),
    JBS96(NOTE_G, 5, 2), JBS96(NOTE_A, 5, 2),
    JBS96(NOTE_G, 5, 5), JBS96(NOTE_E, 5, 3),
    JBS96(NOTE_F, 5, 16),

    /* Bars 17-24 */
    JBS96(NOTE_D, 5, 3), JBS96(NOTE_A, 5, 3),
    JBS96(NOTE_G, 5, 3), JBS96(NOTE_A, 5, 4),
    JBS96(NOTE_G, 5, 3),
    JBS96(NOTE_A, 5, 4), JBS96(NOTE_D, 6, 4),
    JBS96(NOTE_A, 5, 4), JBS96(NOTE_G, 5, 4),
    JBS96(NOTE_A, 5, 2), JBS96(NOTE_G, 5, 2),
    JBS96(NOTE_A, 5, 2), JBS96(NOTE_G, 5, 2),
    JBS96(NOTE_A, 5, 5), JBS96(NOTE_G, 5, 3),
    JBS96(NOTE_C, 5, 16),
    JBS96(NOTE_C, 5, 3), JBS96(NOTE_G, 5, 3),
    JBS96(NOTE_F, 5, 3), JBS96(NOTE_G, 5, 4),
    JBS96(NOTE_F, 5, 3),
    JBS96(NOTE_G, 5, 4), JBS96(NOTE_C, 6, 4),
    JBS96(NOTE_C, 6, 4), JBS96(NOTE_E, 6, 4),
    JBS112(NOTE_D, 6, 2), JBS112(NOTE_E, 6, 2),
    JBS112(NOTE_D, 6, 2), JBS112(NOTE_E, 6, 2),
    JBS112(NOTE_D, 6, 5), JBS112(NOTE_C, 6, 3),
    JBS112(NOTE_D, 6, 16),

    /* Bars 25-32 */
    JBS112(NOTE_D, 5, 2), JBS112(NOTE_A, 5, 1),
    JBS112(NOTE_G, 5, 1), JBS112(NOTE_A, 5, 12),
    JBS112(NOTE_C, 5, 2), JBS112(NOTE_G, 5, 1),
    JBS112(NOTE_F, 5, 1), JBS112(NOTE_G, 5, 12),
    JBS112(NOTE_C, 5, 2), JBS112(NOTE_G, 5, 1),
    JBS112(NOTE_F, 5, 1), JBS112(NOTE_G, 5, 12),
    JBS112(NOTE_C, 6, 2), JBS112(NOTE_F, 5, 1),
    JBS112(NOTE_E, 5, 1), JBS112(NOTE_F, 5, 12),
    JBS112(NOTE_D, 5, 2), JBS112(NOTE_A, 5, 1),
    JBS112(NOTE_G, 5, 1), JBS112(NOTE_A, 5, 12),
    JBS112(NOTE_D, 6, 2), JBS112(NOTE_G, 5, 1),
    JBS112(NOTE_F, 5, 1), JBS112(NOTE_G, 5, 12),
    JBS112(NOTE_E, 6, 2), JBS112(NOTE_G, 5, 1),
    JBS112(NOTE_F, 5, 1), JBS112(NOTE_G, 5, 12),
    JBS112(NOTE_F, 6, 2), JBS112(NOTE_E, 6, 2),
    JBS112(NOTE_D, 6, 12),

    /* Bars 33-40 */
    JBS112(NOTE_D, 4, 2), JBS112(NOTE_A, 4, 1),
    JBS112(NOTE_G, 4, 1), JBS112(NOTE_A, 4, 2),
    JBS112(NOTE_G, 4, 2), JBS112(NOTE_A, 4, 2),
    JBS112(NOTE_D, 5, 2), JBS112(NOTE_A, 4, 2),
    JBS112(NOTE_G, 4, 2),
    JBS112(NOTE_A, 4, 1), JBS112(NOTE_G, 4, 1),
    JBS112(NOTE_A, 4, 1), JBS112(NOTE_G, 4, 1),
    JBS112(NOTE_A, 4, 2), JBS112(NOTE_G, 4, 2),
    JBS112(NOTE_C, 4, 2), JBS112(NOTE_G, 4, 2),
    JBS112(NOTE_E, 4, 2), JBS112(NOTE_C, 4, 2),
    JBS112(NOTE_C, 4, 2), JBS112(NOTE_G, 4, 1),
    JBS112(NOTE_F, 4, 1), JBS112(NOTE_G, 4, 2),
    JBS112(NOTE_F, 4, 2), JBS112(NOTE_G, 4, 2),
    JBS112(NOTE_C, 5, 2), JBS112(NOTE_C, 5, 2),
    JBS112(NOTE_G, 4, 2),
    JBS112(NOTE_G, 4, 1), JBS112(NOTE_A, 4, 1),
    JBS112(NOTE_G, 4, 1), JBS112(NOTE_A, 4, 1),
    JBS112(NOTE_G, 4, 2), JBS112(NOTE_E, 4, 2),
    JBS112(NOTE_F, 4, 5), JBS112(NOTE_E, 4, 3),
    JBS112(NOTE_D, 4, 2), JBS112(NOTE_A, 4, 1),
    JBS112(NOTE_G, 4, 1), JBS112(NOTE_A, 4, 2),
    JBS112(NOTE_G, 4, 2), JBS112(NOTE_A, 4, 2),
    JBS112(NOTE_D, 5, 2), JBS112(NOTE_A, 4, 2),
    JBS112(NOTE_G, 4, 2),
    JBS112(NOTE_A, 4, 1), JBS112(NOTE_G, 4, 1),
    JBS112(NOTE_A, 4, 1), JBS112(NOTE_G, 4, 1),
    JBS112(NOTE_A, 4, 2), JBS112(NOTE_G, 4, 2),
    JBS112(NOTE_C, 4, 2), JBS112(NOTE_G, 4, 2),
    JBS112(NOTE_E, 4, 2), JBS112(NOTE_C, 4, 2),
    JBS112(NOTE_C, 4, 2), JBS112(NOTE_G, 4, 1),
    JBS112(NOTE_F, 4, 1), JBS112(NOTE_G, 4, 2),
    JBS112(NOTE_F, 4, 2), JBS112(NOTE_G, 4, 2),
    JBS112(NOTE_C, 5, 2), JBS112(NOTE_C, 5, 2),
    JBS112(NOTE_E, 5, 2),
    JBS112(NOTE_D, 5, 1), JBS112(NOTE_E, 5, 1),
    JBS112(NOTE_D, 5, 1), JBS112(NOTE_E, 5, 1),
    JBS112(NOTE_D, 5, 2), JBS112(NOTE_C, 5, 2),
    JBS112(NOTE_D, 5, 5), JBS112(NOTE_C, 4, 3),

    /* Bars 41-48 */
    JBS112(NOTE_D, 5, 2), JBS112(NOTE_A, 5, 1),
    JBS112(NOTE_G, 5, 1), JBS112(NOTE_A, 5, 2),
    JBS112(NOTE_G, 5, 2), JBS112(NOTE_A, 5, 2),
    JBS112(NOTE_D, 6, 2), JBS112(NOTE_A, 5, 2),
    JBS112(NOTE_G, 5, 2),
    JBS112(NOTE_A, 5, 1), JBS112(NOTE_G, 5, 1),
    JBS112(NOTE_A, 5, 1), JBS112(NOTE_G, 5, 1),
    JBS112(NOTE_A, 5, 2), JBS112(NOTE_G, 5, 2),
    JBS112(NOTE_C, 5, 8),
    JBS112(NOTE_C, 5, 2), JBS112(NOTE_G, 5, 1),
    JBS112(NOTE_F, 5, 1), JBS112(NOTE_G, 5, 2),
    JBS112(NOTE_F, 5, 2), JBS112(NOTE_G, 5, 2),
    JBS112(NOTE_C, 6, 2), JBS112(NOTE_C, 6, 2),
    JBS112(NOTE_G, 5, 2),
    JBS112(NOTE_G, 5, 1), JBS112(NOTE_A, 5, 1),
    JBS112(NOTE_G, 5, 1), JBS112(NOTE_A, 5, 1),
    JBS112(NOTE_G, 5, 2), JBS112(NOTE_E, 5, 2),
    JBS112(NOTE_F, 5, 8),
    JBS112(NOTE_D, 5, 2), JBS112(NOTE_A, 5, 1),
    JBS112(NOTE_G, 5, 1), JBS112(NOTE_A, 5, 2),
    JBS112(NOTE_G, 5, 2), JBS112(NOTE_A, 5, 2),
    JBS112(NOTE_D, 6, 2), JBS112(NOTE_A, 5, 2),
    JBS112(NOTE_G, 5, 2),
    JBS112(NOTE_A, 5, 1), JBS112(NOTE_G, 5, 1),
    JBS112(NOTE_A, 5, 1), JBS112(NOTE_G, 5, 1),
    JBS112(NOTE_A, 5, 2), JBS112(NOTE_G, 5, 2),
    JBS112(NOTE_C, 5, 8),
    JBS112(NOTE_C, 5, 2), JBS112(NOTE_G, 5, 1),
    JBS112(NOTE_F, 5, 1), JBS112(NOTE_G, 5, 2),
    JBS112(NOTE_F, 5, 2), JBS112(NOTE_G, 5, 2),
    JBS112(NOTE_C, 6, 2), JBS112(NOTE_C, 6, 2),
    JBS112(NOTE_E, 6, 2),
    JBS112(NOTE_D, 6, 1), JBS112(NOTE_E, 6, 1),
    JBS112(NOTE_D, 6, 1), JBS112(NOTE_E, 6, 1),
    JBS112(NOTE_D, 6, 2), JBS112(NOTE_C, 6, 2),
    JBS112(NOTE_D, 6, 4), JBS112(NOTE_D, 6, 2),
    JBS112(NOTE_E, 6, 2),

    /* Bars 49-64 */
    JBS112(NOTE_F, 6, 12), JBS112(NOTE_A, 6, 4),
    JBS112(NOTE_A, 6, 6), JBS112(NOTE_G, 6, 2),
    JBS112(NOTE_G, 6, 8),
    JBS112(NOTE_E, 6, 6), JBS112(NOTE_C, 6, 2),
    JBS112(NOTE_C, 6, 8),
    JBS112(NOTE_A, 5, 6), JBS112(NOTE_G, 5, 2),
    JBS112(NOTE_G, 5, 8),
    JBS112(NOTE_A, 5, 8), JBS112(NOTE_A, 4, 2),
    JBS112(NOTE_A, 5, 3), JBS112(NOTE_A, 5, 3),
    JBS112(NOTE_C, 6, 6), JBS112(NOTE_A, 5, 2),
    JBS112(NOTE_A, 5, 4), JBS112(NOTE_A, 5, 4),
    JBS112(NOTE_G, 5, 6), JBS112(NOTE_F, 5, 2),
    JBS112(NOTE_F, 5, 4), JBS112(NOTE_G, 5, 4),
    JBS112(NOTE_D, 5, 11), JBS112(NOTE_D, 6, 3),
    JBS112(NOTE_E, 6, 2),
    JBS112(NOTE_F, 6, 12), JBS112(NOTE_A, 6, 4),
    JBS112(NOTE_A, 6, 6), JBS112(NOTE_G, 6, 2),
    JBS112(NOTE_G, 6, 8),
    JBS112(NOTE_A, 6, 6), JBS112(NOTE_A, 6, 2),
    JBS112(NOTE_A, 6, 8),
    JBS112(NOTE_G, 6, 6), JBS112(NOTE_F, 6, 2),
    JBS112(NOTE_F, 6, 8),
    JBS112(NOTE_A, 6, 3), JBS112(NOTE_G, 6, 2),
    JBS112(NOTE_G, 6, 2), JBS112(NOTE_D, 6, 2),
    JBS112(NOTE_D, 6, 7),
    JBS112(NOTE_F, 6, 3), JBS112(NOTE_E, 6, 2),
    JBS112(NOTE_E, 6, 2), JBS112(NOTE_A, 5, 2),
    JBS112(NOTE_A, 5, 4), JBS112(NOTE_F, 6, 3),
    JBS112(NOTE_E, 6, 6), JBS112(NOTE_D, 6, 3),
    JBS112(NOTE_D, 6, 7),
    JBS112(NOTE_D, 6, 16),

    /* Bars 65-72 */
    JBS112(NOTE_D, 5, 2), JBS112(NOTE_A, 5, 1),
    JBS112(NOTE_G, 5, 1), JBS112(NOTE_A, 5, 12),
    JBS112(NOTE_C, 5, 2), JBS112(NOTE_G, 5, 1),
    JBS112(NOTE_F, 5, 1), JBS112(NOTE_G, 5, 12),
    JBS112(NOTE_C, 5, 2), JBS112(NOTE_G, 5, 1),
    JBS112(NOTE_F, 5, 1), JBS112(NOTE_G, 5, 12),
    JBS112(NOTE_C, 6, 2), JBS112(NOTE_F, 5, 1),
    JBS112(NOTE_E, 5, 1), JBS112(NOTE_F, 5, 6),
    JBS112(NOTE_F, 4, 3), JBS112(NOTE_E, 4, 3),
    JBS112(NOTE_D, 5, 2), JBS112(NOTE_A, 5, 1),
    JBS112(NOTE_G, 5, 1), JBS112(NOTE_A, 5, 12),
    JBS112(NOTE_D, 6, 2), JBS112(NOTE_G, 5, 1),
    JBS112(NOTE_F, 5, 1), JBS112(NOTE_G, 5, 12),
    JBS112(NOTE_E, 6, 2), JBS112(NOTE_G, 5, 1),
    JBS112(NOTE_F, 5, 1), JBS112(NOTE_G, 5, 12),
    JBS112(NOTE_F, 6, 2), JBS112(NOTE_E, 6, 2),
    JBS112(NOTE_D, 6, 12),

    /* Bars 73-80 */
    JBS112(NOTE_D, 4, 2), JBS112(NOTE_A, 4, 1),
    JBS112(NOTE_G, 4, 1), JBS112(NOTE_A, 4, 2),
    JBS112(NOTE_G, 4, 2), JBS112(NOTE_A, 4, 2),
    JBS112(NOTE_D, 5, 2), JBS112(NOTE_A, 4, 2),
    JBS112(NOTE_G, 4, 2),
    JBS112(NOTE_A, 4, 1), JBS112(NOTE_G, 4, 1),
    JBS112(NOTE_A, 4, 1), JBS112(NOTE_G, 4, 1),
    JBS112(NOTE_A, 4, 2), JBS112(NOTE_G, 4, 2),
    JBS112(NOTE_C, 4, 2), JBS112(NOTE_G, 4, 2),
    JBS112(NOTE_E, 4, 2), JBS112(NOTE_C, 4, 2),
    JBS112(NOTE_C, 4, 2), JBS112(NOTE_G, 4, 1),
    JBS112(NOTE_F, 4, 1), JBS112(NOTE_G, 4, 2),
    JBS112(NOTE_F, 4, 2), JBS112(NOTE_G, 4, 2),
    JBS112(NOTE_C, 5, 2), JBS112(NOTE_C, 5, 2),
    JBS112(NOTE_G, 4, 2),
    JBS112(NOTE_G, 4, 1), JBS112(NOTE_A, 4, 1),
    JBS112(NOTE_G, 4, 1), JBS112(NOTE_A, 4, 1),
    JBS112(NOTE_G, 4, 2), JBS112(NOTE_E, 4, 2),
    JBS112(NOTE_F, 4, 5), JBS112(NOTE_E, 4, 3),
    JBS112(NOTE_D, 4, 2), JBS112(NOTE_A, 4, 1),
    JBS112(NOTE_G, 4, 1), JBS112(NOTE_A, 4, 2),
    JBS112(NOTE_G, 4, 2), JBS112(NOTE_A, 4, 2),
    JBS112(NOTE_D, 5, 2), JBS112(NOTE_A, 4, 2),
    JBS112(NOTE_G, 4, 2),
    JBS112(NOTE_A, 4, 1), JBS112(NOTE_G, 4, 1),
    JBS112(NOTE_A, 4, 1), JBS112(NOTE_G, 4, 1),
    JBS112(NOTE_A, 4, 2), JBS112(NOTE_G, 4, 2),
    JBS112(NOTE_C, 4, 2), JBS112(NOTE_G, 4, 2),
    JBS112(NOTE_E, 4, 2), JBS112(NOTE_C, 4, 2),
    JBS112(NOTE_C, 4, 2), JBS112(NOTE_G, 4, 1),
    JBS112(NOTE_F, 4, 1), JBS112(NOTE_G, 4, 2),
    JBS112(NOTE_F, 4, 2), JBS112(NOTE_G, 4, 2),
    JBS112(NOTE_C, 5, 2), JBS112(NOTE_C, 5, 2),
    JBS112(NOTE_E, 5, 2),
    JBS112(NOTE_D, 5, 1), JBS112(NOTE_E, 5, 1),
    JBS112(NOTE_D, 5, 1), JBS112(NOTE_E, 5, 1),
    JBS112(NOTE_D, 5, 2), JBS112(NOTE_C, 5, 2),
    JBS112(NOTE_D, 5, 5), JBS112(NOTE_C, 4, 3),

    /* Bars 81-88 */
    JBS112(NOTE_D, 5, 2), JBS112(NOTE_A, 5, 1),
    JBS112(NOTE_G, 5, 1), JBS112(NOTE_A, 5, 2),
    JBS112(NOTE_G, 5, 2), JBS112(NOTE_A, 5, 2),
    JBS112(NOTE_D, 6, 2), JBS112(NOTE_A, 5, 2),
    JBS112(NOTE_G, 5, 2),
    JBS112(NOTE_A, 5, 1), JBS112(NOTE_G, 5, 1),
    JBS112(NOTE_A, 5, 1), JBS112(NOTE_G, 5, 1),
    JBS112(NOTE_A, 5, 2), JBS112(NOTE_G, 5, 2),
    JBS112(NOTE_C, 5, 8),
    JBS112(NOTE_C, 5, 2), JBS112(NOTE_G, 5, 1),
    JBS112(NOTE_F, 5, 1), JBS112(NOTE_G, 5, 2),
    JBS112(NOTE_F, 5, 2), JBS112(NOTE_G, 5, 2),
    JBS112(NOTE_C, 6, 2), JBS112(NOTE_C, 6, 2),
    JBS112(NOTE_G, 5, 2),
    JBS112(NOTE_G, 5, 1), JBS112(NOTE_A, 5, 1),
    JBS112(NOTE_G, 5, 1), JBS112(NOTE_A, 5, 1),
    JBS112(NOTE_G, 5, 2), JBS112(NOTE_E, 5, 2),
    JBS112(NOTE_F, 5, 8),
    JBS112(NOTE_D, 5, 2), JBS112(NOTE_A, 5, 1),
    JBS112(NOTE_G, 5, 1), JBS112(NOTE_A, 5, 2),
    JBS112(NOTE_G, 5, 2), JBS112(NOTE_A, 5, 2),
    JBS112(NOTE_D, 6, 2), JBS112(NOTE_A, 5, 2),
    JBS112(NOTE_G, 5, 2),
    JBS112(NOTE_A, 5, 1), JBS112(NOTE_G, 5, 1),
    JBS112(NOTE_A, 5, 1), JBS112(NOTE_G, 5, 1),
    JBS112(NOTE_A, 5, 2), JBS112(NOTE_G, 5, 2),
    JBS112(NOTE_C, 5, 8),
    JBS112(NOTE_C, 5, 2), JBS112(NOTE_G, 5, 1),
    JBS112(NOTE_F, 5, 1), JBS112(NOTE_G, 5, 2),
    JBS112(NOTE_F, 5, 2), JBS112(NOTE_G, 5, 2),
    JBS112(NOTE_C, 6, 2), JBS112(NOTE_C, 6, 2),
    JBS112(NOTE_E, 6, 2),
    JBS112(NOTE_D, 6, 1), JBS112(NOTE_E, 6, 1),
    JBS112(NOTE_D, 6, 1), JBS112(NOTE_E, 6, 1),
    JBS112(NOTE_D, 6, 2), JBS112(NOTE_C, 6, 2),
    JBS112(NOTE_D, 6, 4), JBS112(NOTE_D, 5, 2),
    JBS112(NOTE_E, 5, 2),

    /* Bars 89-100 */
    JBS112(NOTE_F, 5, 3), JBS112(NOTE_D, 5, 2),
    JBS112(NOTE_A, 4, 2), JBS112(NOTE_F, 5, 2),
    JBS112(NOTE_D, 5, 2), JBS112(NOTE_A, 4, 2),
    JBS112(NOTE_D, 5, 2), JBS112(NOTE_E, 5, 1),
    JBS112(NOTE_F, 5, 2), JBS112(NOTE_E, 5, 2),
    JBS112(NOTE_A, 4, 2), JBS112(NOTE_F, 5, 2),
    JBS112(NOTE_E, 5, 2), JBS112(NOTE_A, 4, 2),
    JBS112(NOTE_E, 5, 2), JBS112(NOTE_F, 5, 2),
    JBS112(NOTE_G, 5, 2), JBS112(NOTE_F, 5, 2),
    JBS112(NOTE_A, 4, 2), JBS112(NOTE_G, 5, 2),
    JBS112(NOTE_F, 5, 2), JBS112(NOTE_A, 4, 2),
    JBS112(NOTE_F, 5, 2), JBS112(NOTE_G, 5, 2),
    JBS112(NOTE_A, 5, 8), JBS112(NOTE_F, 4, 8),
    JBS112(NOTE_F, 6, 2), JBS112(NOTE_D, 6, 2),
    JBS112(NOTE_A, 5, 2), JBS112(NOTE_F, 6, 2),
    JBS112(NOTE_D, 6, 2), JBS112(NOTE_A, 5, 2),
    JBS112(NOTE_D, 6, 2), JBS112(NOTE_E, 6, 2),
    JBS112(NOTE_F, 6, 2), JBS112(NOTE_E, 6, 2),
    JBS112(NOTE_A, 5, 2), JBS112(NOTE_F, 6, 2),
    JBS112(NOTE_E, 6, 2), JBS112(NOTE_A, 5, 2),
    JBS112(NOTE_E, 6, 2), JBS112(NOTE_F, 6, 2),
    JBS112(NOTE_G, 6, 2), JBS112(NOTE_F, 6, 2),
    JBS112(NOTE_A, 5, 2), JBS112(NOTE_G, 6, 2),
    JBS112(NOTE_F, 6, 2), JBS112(NOTE_A, 5, 2),
    JBS112(NOTE_F, 6, 2), JBS112(NOTE_E, 6, 2),
    JBS112(NOTE_D, 6, 16),
    JBS112(NOTE_A, 5, 2), JBS112(NOTE_D, 6, 1),
    JBS112(NOTE_D, 6, 1), JBS112(NOTE_D, 6, 2),
    JBS112(NOTE_A, 5, 1), JBS112(NOTE_A, 5, 1),
    JBS112(NOTE_A, 5, 2), JBS112(NOTE_F, 5, 1),
    JBS112(NOTE_F, 5, 1), JBS112(NOTE_F, 5, 2),
    JBS112(NOTE_A, 5, 2),
    JBS112(NOTE_A, 5, 2), JBS112(NOTE_G, 5, 1),
    JBS112(NOTE_G, 5, 1), JBS112(NOTE_G, 5, 2),
    JBS112(NOTE_F, 5, 2), JBS112(NOTE_G, 5, 8),
    JBS112(NOTE_G, 5, 2), JBS112(NOTE_C, 6, 1),
    JBS112(NOTE_C, 6, 1), JBS112(NOTE_C, 6, 2),
    JBS112(NOTE_G, 5, 1), JBS112(NOTE_G, 5, 1),
    JBS112(NOTE_G, 5, 2), JBS112(NOTE_E, 5, 1),
    JBS112(NOTE_E, 5, 1), JBS112(NOTE_E, 5, 2),
    JBS112(NOTE_G, 5, 2),
    JBS112(NOTE_G, 5, 2), JBS112(NOTE_F, 5, 1),
    JBS112(NOTE_F, 5, 1), JBS112(NOTE_F, 5, 2),
    JBS112(NOTE_E, 5, 2), JBS112(NOTE_F, 5, 6),
    JBS112(NOTE_D, 5, 1), JBS112(NOTE_F, 5, 1),

    /* Bars 101-108 */
    JBS96(NOTE_C, 6, 2), JBS96(NOTE_A, 5, 2),
    JBS96(NOTE_F, 5, 2), JBS96(NOTE_C, 6, 2),
    JBS96(NOTE_C, 6, 2), JBS96(NOTE_A, 5, 2),
    JBS96(NOTE_A, 5, 4),
    JBS96(NOTE_A, 5, 7), JBS96(NOTE_A, 5, 2),
    JBS96(NOTE_A, 5, 4), JBS96(NOTE_E, 5, 3),
    JBS96(NOTE_E, 5, 16),
    JBS96(NOTE_D, 5, 16),
    JBS96(NOTE_A, 5, 5), JBS96(NOTE_A, 5, 2),
    JBS96(NOTE_G, 5, 2), JBS96(NOTE_A, 5, 4),
    JBS96(NOTE_G, 5, 3),
    JBS96(NOTE_E, 6, 1), JBS96(NOTE_A, 5, 4),
    JBS96(NOTE_D, 6, 4), JBS96(NOTE_A, 5, 4),
    JBS96(NOTE_G, 5, 3),
    JBS96(NOTE_A, 5, 2), JBS96(NOTE_G, 5, 2),
    JBS96(NOTE_A, 5, 2), JBS96(NOTE_G, 5, 2),
    JBS96(NOTE_A, 5, 4), JBS96(NOTE_G, 5, 4),
    JBS96(NOTE_D, 6, 16)
};

#undef JBS112
#undef JBS96
#undef JBS112_UNIT_MS
#undef JBS96_UNIT_MS
