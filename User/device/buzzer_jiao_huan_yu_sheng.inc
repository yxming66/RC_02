/*
 * JJ Lin - Jiao Huan Yu Sheng.
 * Complete single-line PWM buzzer reduction generated from PiaStudy Itb5WrQr space data matching the provided PDF, scaled to quarter note = 65 BPM.
 * Simultaneous right-hand, left-hand, and chord tones are
 * arpeggiated into one buzzer line with the upper voice first;
 * notes outside the practical buzzer range are folded by octaves.
 * 896 buzzer events, about 267 seconds.
 */
#define JHYS(note, octave, ms) {note, octave, (uint16_t)(ms)}
#define JHYS_R(ms) {NOTE_REST, 0, (uint16_t)(ms)}

const Tone_t JIAO_HUAN_YU_SHENG[] = {
    /* Events 1-16 */
    JHYS(NOTE_A, 4, 231),
    JHYS(NOTE_D, 3, 230),
    JHYS(NOTE_A, 3, 461),
    JHYS(NOTE_G, 5, 231),
    JHYS(NOTE_D, 4, 230),
    JHYS(NOTE_A, 3, 461),
    JHYS(NOTE_A, 5, 231),
    JHYS(NOTE_FS, 4, 230),
    JHYS(NOTE_A, 3, 461),
    JHYS(NOTE_D, 6, 231),
    JHYS(NOTE_D, 4, 230),
    JHYS(NOTE_A, 3, 461),
    JHYS(NOTE_C, 6, 231),
    JHYS(NOTE_A, 3, 230),
    JHYS(NOTE_E, 3, 461),
    JHYS(NOTE_A, 3, 461),
    /* Events 17-32 */
    JHYS(NOTE_E, 3, 461),
    JHYS(NOTE_B, 5, 231),
    JHYS(NOTE_C, 4, 230),
    JHYS(NOTE_E, 3, 461),
    JHYS(NOTE_A, 3, 461),
    JHYS(NOTE_E, 3, 461),
    JHYS(NOTE_E, 5, 231),
    JHYS(NOTE_C, 3, 230),
    JHYS(NOTE_G, 3, 461),
    JHYS(NOTE_FS, 5, 231),
    JHYS(NOTE_C, 4, 230),
    JHYS(NOTE_G, 3, 461),
    JHYS(NOTE_G, 5, 231),
    JHYS(NOTE_E, 4, 230),
    JHYS(NOTE_G, 3, 461),
    JHYS(NOTE_C, 4, 461),
    /* Events 33-48 */
    JHYS(NOTE_A, 5, 231),
    JHYS(NOTE_G, 3, 230),
    JHYS(NOTE_D, 5, 231),
    JHYS(NOTE_G, 3, 230),
    JHYS(NOTE_D, 3, 461),
    JHYS(NOTE_G, 3, 461),
    JHYS(NOTE_D, 3, 461),
    JHYS(NOTE_B, 3, 461),
    JHYS(NOTE_D, 3, 461),
    JHYS(NOTE_G, 3, 461),
    JHYS(NOTE_D, 3, 461),
    JHYS(NOTE_FS, 5, 231),
    JHYS(NOTE_D, 3, 230),
    JHYS(NOTE_A, 3, 461),
    JHYS(NOTE_G, 5, 231),
    JHYS(NOTE_D, 3, 230),
    /* Events 49-64 */
    JHYS(NOTE_FS, 3, 461),
    JHYS(NOTE_A, 5, 231),
    JHYS(NOTE_A, 3, 230),
    JHYS(NOTE_D, 4, 461),
    JHYS(NOTE_D, 6, 461),
    JHYS(NOTE_FS, 4, 461),
    JHYS(NOTE_C, 6, 231),
    JHYS(NOTE_A, 3, 230),
    JHYS(NOTE_E, 3, 461),
    JHYS(NOTE_A, 3, 461),
    JHYS(NOTE_C, 4, 461),
    JHYS(NOTE_B, 5, 231),
    JHYS(NOTE_E, 4, 230),
    JHYS(NOTE_C, 4, 461),
    JHYS(NOTE_A, 3, 461),
    JHYS(NOTE_E, 3, 461),
    /* Events 65-80 */
    JHYS(NOTE_G, 5, 231),
    JHYS(NOTE_C, 3, 230),
    JHYS(NOTE_G, 3, 461),
    JHYS(NOTE_C, 4, 461),
    JHYS(NOTE_G, 3, 461),
    JHYS(NOTE_E, 4, 461),
    JHYS(NOTE_G, 3, 461),
    JHYS(NOTE_FS, 5, 231),
    JHYS(NOTE_C, 4, 230),
    JHYS(NOTE_G, 5, 461),
    JHYS(NOTE_A, 5, 231),
    JHYS(NOTE_A, 3, 230),
    JHYS(NOTE_E, 3, 461),
    JHYS(NOTE_A, 3, 461),
    JHYS(NOTE_CS, 4, 461),
    JHYS(NOTE_E, 4, 1846),
    /* Events 81-96 */
    JHYS(NOTE_FS, 4, 231),
    JHYS(NOTE_D, 3, 230),
    JHYS(NOTE_FS, 4, 231),
    JHYS(NOTE_A, 3, 230),
    JHYS(NOTE_FS, 4, 116),
    JHYS(NOTE_D, 4, 115),
    JHYS(NOTE_G, 4, 231),
    JHYS(NOTE_A, 4, 231),
    JHYS(NOTE_B, 4, 231),
    JHYS(NOTE_G, 3, 461),
    JHYS(NOTE_E, 4, 231),
    JHYS(NOTE_D, 3, 230),
    JHYS(NOTE_E, 4, 116),
    JHYS(NOTE_G, 3, 115),
    JHYS(NOTE_FS, 4, 231),
    JHYS(NOTE_G, 4, 231),
    /* Events 97-112 */
    JHYS(NOTE_A, 4, 231),
    JHYS(NOTE_CS, 3, 461),
    JHYS(NOTE_E, 4, 231),
    JHYS(NOTE_A, 3, 230),
    JHYS(NOTE_E, 4, 116),
    JHYS(NOTE_CS, 4, 115),
    JHYS(NOTE_FS, 4, 231),
    JHYS(NOTE_G, 4, 231),
    JHYS(NOTE_FS, 4, 692),
    JHYS(NOTE_CS, 3, 461),
    JHYS(NOTE_FS, 3, 923),
    JHYS(NOTE_D, 4, 231),
    JHYS(NOTE_B, 3, 230),
    JHYS(NOTE_D, 4, 231),
    JHYS(NOTE_FS, 3, 230),
    JHYS(NOTE_D, 4, 116),
    /* Events 113-128 */
    JHYS(NOTE_B, 3, 115),
    JHYS(NOTE_E, 4, 231),
    JHYS(NOTE_FS, 4, 462),
    JHYS(NOTE_E, 3, 461),
    JHYS(NOTE_B, 3, 577),
    JHYS(NOTE_GS, 3, 115),
    JHYS(NOTE_CS, 4, 231),
    JHYS(NOTE_D, 4, 231),
    JHYS(NOTE_E, 4, 692),
    JHYS(NOTE_B, 3, 461),
    JHYS(NOTE_E, 3, 461),
    JHYS(NOTE_B, 3, 461),
    JHYS(NOTE_A, 3, 461),
    JHYS(NOTE_E, 3, 461),
    JHYS(NOTE_A, 3, 461),
    JHYS(NOTE_E, 3, 461),
    /* Events 129-144 */
    JHYS(NOTE_CS, 5, 231),
    JHYS(NOTE_FS, 3, 230),
    JHYS(NOTE_CS, 5, 231),
    JHYS(NOTE_CS, 3, 230),
    JHYS(NOTE_CS, 5, 116),
    JHYS(NOTE_A, 3, 115),
    JHYS(NOTE_B, 4, 231),
    JHYS(NOTE_A, 4, 231),
    JHYS(NOTE_D, 5, 692),
    JHYS(NOTE_FS, 3, 461),
    JHYS(NOTE_B, 3, 923),
    JHYS(NOTE_CS, 5, 231),
    JHYS(NOTE_FS, 3, 230),
    JHYS(NOTE_CS, 3, 231),
    JHYS(NOTE_CS, 5, 347),
    JHYS(NOTE_A, 3, 115),
    /* Events 145-160 */
    JHYS(NOTE_D, 5, 231),
    JHYS(NOTE_E, 5, 461),
    JHYS(NOTE_D, 5, 231),
    JHYS(NOTE_B, 3, 230),
    JHYS(NOTE_FS, 3, 461),
    JHYS(NOTE_FS, 5, 231),
    JHYS(NOTE_B, 3, 230),
    JHYS(NOTE_D, 5, 461),
    JHYS(NOTE_B, 4, 231),
    JHYS(NOTE_E, 3, 230),
    JHYS(NOTE_B, 3, 231),
    JHYS(NOTE_B, 4, 385),
    JHYS(NOTE_E, 3, 154),
    JHYS(NOTE_CS, 5, 154),
    JHYS(NOTE_G, 3, 154),
    JHYS(NOTE_D, 5, 539),
    /* Events 161-176 */
    JHYS(NOTE_FS, 3, 230),
    JHYS(NOTE_A, 4, 231),
    JHYS(NOTE_D, 3, 230),
    JHYS(NOTE_A, 4, 154),
    JHYS(NOTE_FS, 3, 154),
    JHYS(NOTE_G, 4, 154),
    JHYS(NOTE_A, 3, 154),
    JHYS(NOTE_FS, 4, 539),
    JHYS(NOTE_G, 3, 230),
    JHYS(NOTE_D, 3, 461),
    JHYS(NOTE_G, 4, 231),
    JHYS(NOTE_AS, 3, 230),
    JHYS(NOTE_D, 3, 461),
    JHYS(NOTE_D, 5, 461),
    JHYS(NOTE_AS, 3, 461),
    JHYS(NOTE_D, 3, 461),
    /* Events 177-192 */
    JHYS(NOTE_E, 5, 692),
    JHYS(NOTE_A, 3, 230),
    JHYS(NOTE_E, 3, 461),
    JHYS(NOTE_A, 3, 461),
    JHYS(NOTE_E, 3, 461),
    JHYS(NOTE_CS, 4, 923),
    JHYS(NOTE_FS, 5, 231),
    JHYS(NOTE_G, 5, 231),
    JHYS(NOTE_FS, 5, 231),
    JHYS(NOTE_E, 5, 231),
    JHYS(NOTE_FS, 5, 231),
    JHYS(NOTE_G, 3, 230),
    JHYS(NOTE_D, 3, 461),
    JHYS(NOTE_B, 4, 461),
    JHYS(NOTE_G, 3, 461),
    JHYS(NOTE_E, 5, 231),
    /* Events 193-208 */
    JHYS(NOTE_A, 3, 230),
    JHYS(NOTE_E, 3, 461),
    JHYS(NOTE_A, 4, 461),
    JHYS(NOTE_A, 3, 461),
    JHYS(NOTE_E, 5, 231),
    JHYS(NOTE_FS, 3, 230),
    JHYS(NOTE_CS, 3, 461),
    JHYS(NOTE_A, 4, 461),
    JHYS(NOTE_FS, 3, 461),
    JHYS(NOTE_D, 5, 231),
    JHYS(NOTE_B, 3, 230),
    JHYS(NOTE_FS, 3, 461),
    JHYS(NOTE_FS, 5, 116),
    JHYS(NOTE_B, 3, 115),
    JHYS(NOTE_G, 5, 231),
    JHYS(NOTE_FS, 5, 231),
    /* Events 209-224 */
    JHYS(NOTE_E, 5, 231),
    JHYS(NOTE_FS, 5, 231),
    JHYS(NOTE_E, 3, 230),
    JHYS(NOTE_B, 3, 461),
    JHYS(NOTE_B, 4, 461),
    JHYS(NOTE_G, 3, 461),
    JHYS(NOTE_G, 5, 231),
    JHYS(NOTE_A, 3, 230),
    JHYS(NOTE_FS, 5, 116),
    JHYS(NOTE_E, 3, 115),
    JHYS(NOTE_E, 5, 231),
    JHYS(NOTE_A, 3, 231),
    JHYS(NOTE_D, 5, 693),
    JHYS(NOTE_FS, 5, 231),
    JHYS(NOTE_A, 3, 230),
    JHYS(NOTE_E, 3, 461),
    /* Events 225-240 */
    JHYS(NOTE_C, 4, 923),
    JHYS(NOTE_D, 3, 461),
    JHYS(NOTE_A, 3, 461),
    JHYS(NOTE_FS, 5, 116),
    JHYS(NOTE_D, 4, 115),
    JHYS(NOTE_E, 5, 231),
    JHYS(NOTE_D, 5, 116),
    JHYS(NOTE_D, 3, 115),
    JHYS(NOTE_E, 5, 231),
    JHYS(NOTE_FS, 5, 231),
    JHYS(NOTE_G, 3, 230),
    JHYS(NOTE_D, 3, 461),
    JHYS(NOTE_B, 5, 231),
    JHYS(NOTE_G, 3, 230),
    JHYS(NOTE_D, 3, 461),
    JHYS(NOTE_E, 5, 231),
    /* Events 241-256 */
    JHYS(NOTE_A, 3, 230),
    JHYS(NOTE_E, 3, 461),
    JHYS(NOTE_FS, 5, 231),
    JHYS(NOTE_CS, 4, 230),
    JHYS(NOTE_E, 3, 461),
    JHYS(NOTE_A, 5, 231),
    JHYS(NOTE_FS, 3, 230),
    JHYS(NOTE_A, 5, 116),
    JHYS(NOTE_CS, 3, 115),
    JHYS(NOTE_FS, 5, 231),
    JHYS(NOTE_A, 5, 231),
    JHYS(NOTE_A, 3, 230),
    JHYS(NOTE_D, 5, 116),
    JHYS(NOTE_CS, 3, 115),
    JHYS(NOTE_D, 5, 692),
    JHYS(NOTE_FS, 3, 461),
    /* Events 257-272 */
    JHYS(NOTE_B, 3, 231),
    JHYS(NOTE_B, 4, 347),
    JHYS(NOTE_B, 3, 115),
    JHYS(NOTE_CS, 5, 231),
    JHYS(NOTE_D, 5, 231),
    JHYS(NOTE_E, 3, 230),
    JHYS(NOTE_B, 3, 461),
    JHYS(NOTE_G, 5, 231),
    JHYS(NOTE_E, 3, 230),
    JHYS(NOTE_B, 3, 461),
    JHYS(NOTE_CS, 5, 462),
    JHYS(NOTE_G, 3, 461),
    JHYS(NOTE_A, 3, 461),
    JHYS(NOTE_E, 5, 461),
    JHYS(NOTE_D, 3, 461),
    JHYS(NOTE_D, 5, 231),
    /* Events 273-288 */
    JHYS(NOTE_A, 3, 230),
    JHYS(NOTE_D, 5, 461),
    JHYS(NOTE_A, 3, 461),
    JHYS(NOTE_FS, 4, 923),
    JHYS(NOTE_A, 3, 923),
    JHYS(NOTE_FS, 4, 1846),
    JHYS(NOTE_D, 4, 1845),
    JHYS(NOTE_FS, 5, 116),
    JHYS(NOTE_D, 3, 115),
    JHYS(NOTE_A, 3, 231),
    JHYS(NOTE_D, 4, 231),
    JHYS(NOTE_A, 3, 231),
    JHYS(NOTE_FS, 4, 231),
    JHYS(NOTE_A, 3, 231),
    JHYS(NOTE_D, 4, 231),
    JHYS(NOTE_A, 3, 231),
    /* Events 289-304 */
    JHYS(NOTE_D, 3, 231),
    JHYS(NOTE_A, 3, 231),
    JHYS(NOTE_D, 4, 231),
    JHYS(NOTE_A, 3, 231),
    JHYS(NOTE_FS, 4, 231),
    JHYS(NOTE_A, 3, 231),
    JHYS(NOTE_D, 4, 231),
    JHYS(NOTE_A, 3, 231),
    JHYS(NOTE_D, 6, 116),
    JHYS(NOTE_D, 3, 115),
    JHYS(NOTE_A, 3, 231),
    JHYS(NOTE_D, 3, 231),
    JHYS(NOTE_FS, 3, 231),
    JHYS(NOTE_A, 3, 231),
    JHYS(NOTE_D, 4, 231),
    JHYS(NOTE_FS, 4, 231),
    /* Events 305-320 */
    JHYS(NOTE_D, 4, 231),
    JHYS(NOTE_D, 3, 231),
    JHYS(NOTE_A, 3, 231),
    JHYS(NOTE_D, 4, 231),
    JHYS(NOTE_A, 3, 231),
    JHYS(NOTE_FS, 4, 231),
    JHYS(NOTE_A, 3, 231),
    JHYS(NOTE_D, 4, 231),
    JHYS(NOTE_A, 3, 231),
    JHYS(NOTE_A, 5, 116),
    JHYS(NOTE_D, 3, 115),
    JHYS(NOTE_A, 3, 231),
    JHYS(NOTE_D, 3, 231),
    JHYS(NOTE_FS, 3, 231),
    JHYS(NOTE_D, 5, 116),
    JHYS(NOTE_A, 3, 115),
    /* Events 321-336 */
    JHYS(NOTE_FS, 3, 231),
    JHYS(NOTE_D, 3, 231),
    JHYS(NOTE_A, 3, 231),
    JHYS(NOTE_D, 3, 231),
    JHYS(NOTE_A, 3, 231),
    JHYS(NOTE_D, 3, 231),
    JHYS(NOTE_FS, 3, 231),
    JHYS(NOTE_A, 3, 231),
    JHYS(NOTE_A, 4, 231),
    JHYS(NOTE_D, 5, 231),
    JHYS(NOTE_A, 5, 231),
    JHYS(NOTE_GS, 5, 116),
    JHYS(NOTE_E, 3, 115),
    JHYS(NOTE_B, 3, 231),
    JHYS(NOTE_E, 3, 231),
    JHYS(NOTE_GS, 3, 231),
    /* Events 337-352 */
    JHYS(NOTE_B, 3, 231),
    JHYS(NOTE_GS, 3, 231),
    JHYS(NOTE_E, 3, 231),
    JHYS(NOTE_B, 3, 231),
    JHYS(NOTE_B, 5, 116),
    JHYS(NOTE_E, 3, 115),
    JHYS(NOTE_B, 3, 231),
    JHYS(NOTE_E, 3, 231),
    JHYS(NOTE_GS, 3, 231),
    JHYS(NOTE_B, 3, 231),
    JHYS(NOTE_GS, 3, 231),
    JHYS(NOTE_E, 3, 231),
    JHYS(NOTE_B, 3, 231),
    JHYS(NOTE_A, 5, 116),
    JHYS(NOTE_D, 3, 115),
    JHYS(NOTE_A, 3, 231),
    /* Events 353-368 */
    JHYS(NOTE_D, 3, 231),
    JHYS(NOTE_FS, 3, 231),
    JHYS(NOTE_D, 5, 116),
    JHYS(NOTE_A, 3, 115),
    JHYS(NOTE_FS, 3, 231),
    JHYS(NOTE_D, 3, 231),
    JHYS(NOTE_A, 3, 231),
    JHYS(NOTE_D, 3, 231),
    JHYS(NOTE_A, 3, 231),
    JHYS(NOTE_D, 3, 231),
    JHYS(NOTE_FS, 3, 231),
    JHYS(NOTE_A, 4, 116),
    JHYS(NOTE_A, 3, 115),
    JHYS(NOTE_FS, 3, 231),
    JHYS(NOTE_D, 3, 231),
    JHYS(NOTE_A, 3, 231),
    /* Events 369-384 */
    JHYS(NOTE_D, 5, 231),
    JHYS(NOTE_D, 3, 230),
    JHYS(NOTE_A, 3, 461),
    JHYS(NOTE_D, 4, 461),
    JHYS(NOTE_A, 3, 461),
    JHYS(NOTE_FS, 4, 923),
    JHYS(NOTE_A, 3, 923),
    JHYS(NOTE_FS, 5, 116),
    JHYS(NOTE_D, 3, 115),
    JHYS(NOTE_A, 3, 231),
    JHYS(NOTE_FS, 5, 116),
    JHYS(NOTE_D, 3, 115),
    JHYS(NOTE_FS, 3, 231),
    JHYS(NOTE_FS, 5, 116),
    JHYS(NOTE_A, 3, 115),
    JHYS(NOTE_G, 5, 231),
    /* Events 385-400 */
    JHYS(NOTE_A, 5, 231),
    JHYS(NOTE_B, 5, 462),
    JHYS(NOTE_E, 3, 231),
    JHYS(NOTE_E, 5, 116),
    JHYS(NOTE_G, 3, 115),
    JHYS(NOTE_B, 3, 231),
    JHYS(NOTE_E, 5, 116),
    JHYS(NOTE_E, 4, 115),
    JHYS(NOTE_FS, 5, 231),
    JHYS(NOTE_G, 5, 231),
    JHYS(NOTE_A, 5, 462),
    JHYS(NOTE_A, 3, 231),
    JHYS(NOTE_E, 5, 116),
    JHYS(NOTE_CS, 4, 115),
    JHYS(NOTE_A, 3, 231),
    JHYS(NOTE_E, 5, 116),
    /* Events 401-416 */
    JHYS(NOTE_E, 4, 115),
    JHYS(NOTE_FS, 5, 231),
    JHYS(NOTE_G, 5, 231),
    JHYS(NOTE_FS, 5, 462),
    JHYS(NOTE_CS, 3, 231),
    JHYS(NOTE_FS, 3, 231),
    JHYS(NOTE_AS, 3, 231),
    JHYS(NOTE_CS, 4, 461),
    JHYS(NOTE_FS, 3, 461),
    JHYS(NOTE_D, 5, 116),
    JHYS(NOTE_B, 3, 115),
    JHYS(NOTE_FS, 3, 231),
    JHYS(NOTE_D, 5, 116),
    JHYS(NOTE_B, 3, 115),
    JHYS(NOTE_FS, 3, 231),
    JHYS(NOTE_D, 5, 116),
    /* Events 417-432 */
    JHYS(NOTE_D, 4, 115),
    JHYS(NOTE_E, 5, 231),
    JHYS(NOTE_FS, 5, 693),
    JHYS(NOTE_B, 3, 231),
    JHYS(NOTE_B, 4, 116),
    JHYS(NOTE_E, 3, 115),
    JHYS(NOTE_GS, 3, 231),
    JHYS(NOTE_B, 4, 154),
    JHYS(NOTE_B, 3, 154),
    JHYS(NOTE_CS, 5, 308),
    JHYS(NOTE_D, 5, 308),
    JHYS(NOTE_E, 5, 116),
    JHYS(NOTE_E, 3, 115),
    JHYS(NOTE_G, 3, 231),
    JHYS(NOTE_B, 3, 231),
    JHYS(NOTE_G, 3, 231),
    /* Events 433-448 */
    JHYS(NOTE_E, 4, 461),
    JHYS(NOTE_G, 3, 461),
    JHYS(NOTE_A, 3, 461),
    JHYS(NOTE_FS, 5, 231),
    JHYS(NOTE_E, 3, 230),
    JHYS(NOTE_E, 5, 231),
    JHYS(NOTE_A, 3, 691),
    JHYS(NOTE_CS, 6, 116),
    JHYS(NOTE_FS, 3, 115),
    JHYS(NOTE_CS, 3, 231),
    JHYS(NOTE_CS, 6, 116),
    JHYS(NOTE_FS, 3, 115),
    JHYS(NOTE_A, 3, 231),
    JHYS(NOTE_CS, 6, 116),
    JHYS(NOTE_CS, 4, 115),
    JHYS(NOTE_B, 5, 231),
    /* Events 449-464 */
    JHYS(NOTE_A, 5, 116),
    JHYS(NOTE_FS, 3, 115),
    JHYS(NOTE_D, 6, 462),
    JHYS(NOTE_FS, 3, 231),
    JHYS(NOTE_B, 3, 231),
    JHYS(NOTE_FS, 3, 231),
    JHYS(NOTE_D, 4, 461),
    JHYS(NOTE_FS, 3, 461),
    JHYS(NOTE_CS, 6, 116),
    JHYS(NOTE_FS, 3, 115),
    JHYS(NOTE_CS, 3, 231),
    JHYS(NOTE_FS, 3, 231),
    JHYS(NOTE_CS, 6, 116),
    JHYS(NOTE_A, 3, 115),
    JHYS(NOTE_CS, 6, 116),
    JHYS(NOTE_CS, 4, 115),
    /* Events 465-480 */
    JHYS(NOTE_D, 6, 231),
    JHYS(NOTE_E, 6, 116),
    JHYS(NOTE_FS, 3, 115),
    JHYS(NOTE_D, 6, 462),
    JHYS(NOTE_FS, 3, 231),
    JHYS(NOTE_B, 3, 231),
    JHYS(NOTE_FS, 3, 231),
    JHYS(NOTE_FS, 6, 154),
    JHYS(NOTE_D, 4, 154),
    JHYS(NOTE_D, 6, 154),
    JHYS(NOTE_FS, 3, 154),
    JHYS(NOTE_CS, 6, 308),
    JHYS(NOTE_B, 5, 116),
    JHYS(NOTE_E, 3, 115),
    JHYS(NOTE_B, 3, 231),
    JHYS(NOTE_E, 3, 231),
    /* Events 481-496 */
    JHYS(NOTE_B, 5, 116),
    JHYS(NOTE_G, 3, 115),
    JHYS(NOTE_B, 5, 154),
    JHYS(NOTE_B, 3, 154),
    JHYS(NOTE_CS, 6, 308),
    JHYS(NOTE_D, 6, 424),
    JHYS(NOTE_D, 3, 115),
    JHYS(NOTE_A, 3, 231),
    JHYS(NOTE_A, 5, 116),
    JHYS(NOTE_D, 3, 115),
    JHYS(NOTE_FS, 3, 231),
    JHYS(NOTE_A, 5, 154),
    JHYS(NOTE_A, 3, 154),
    JHYS(NOTE_G, 5, 308),
    JHYS(NOTE_FS, 5, 424),
    JHYS(NOTE_C, 3, 115),
    /* Events 497-512 */
    JHYS(NOTE_G, 3, 231),
    JHYS(NOTE_C, 4, 231),
    JHYS(NOTE_G, 3, 231),
    JHYS(NOTE_G, 5, 116),
    JHYS(NOTE_E, 4, 115),
    JHYS(NOTE_G, 3, 231),
    JHYS(NOTE_C, 4, 231),
    JHYS(NOTE_G, 3, 231),
    JHYS(NOTE_D, 6, 231),
    JHYS(NOTE_C, 3, 230),
    JHYS(NOTE_G, 3, 461),
    JHYS(NOTE_C, 4, 461),
    JHYS(NOTE_E, 6, 231),
    JHYS(NOTE_E, 5, 230),
    JHYS(NOTE_E, 6, 154),
    JHYS(NOTE_E, 5, 154),
    /* Events 513-528 */
    JHYS(NOTE_A, 3, 154),
    JHYS(NOTE_E, 3, 461),
    JHYS(NOTE_A, 3, 461),
    JHYS(NOTE_E, 3, 461),
    JHYS(NOTE_CS, 4, 923),
    JHYS(NOTE_FS, 5, 231),
    JHYS(NOTE_G, 5, 231),
    JHYS(NOTE_FS, 5, 231),
    JHYS(NOTE_E, 5, 231),
    JHYS(NOTE_FS, 5, 116),
    JHYS(NOTE_G, 3, 115),
    JHYS(NOTE_D, 3, 231),
    JHYS(NOTE_G, 3, 231),
    JHYS(NOTE_B, 3, 231),
    JHYS(NOTE_B, 4, 231),
    JHYS(NOTE_D, 4, 230),
    /* Events 529-544 */
    JHYS(NOTE_G, 3, 461),
    JHYS(NOTE_E, 5, 116),
    JHYS(NOTE_A, 3, 115),
    JHYS(NOTE_E, 3, 231),
    JHYS(NOTE_A, 3, 231),
    JHYS(NOTE_CS, 4, 231),
    JHYS(NOTE_A, 4, 231),
    JHYS(NOTE_E, 4, 230),
    JHYS(NOTE_A, 3, 461),
    JHYS(NOTE_E, 5, 116),
    JHYS(NOTE_FS, 3, 115),
    JHYS(NOTE_CS, 3, 231),
    JHYS(NOTE_FS, 3, 231),
    JHYS(NOTE_A, 3, 231),
    JHYS(NOTE_A, 4, 231),
    JHYS(NOTE_CS, 4, 230),
    /* Events 545-560 */
    JHYS(NOTE_FS, 3, 461),
    JHYS(NOTE_D, 5, 116),
    JHYS(NOTE_B, 3, 115),
    JHYS(NOTE_FS, 3, 231),
    JHYS(NOTE_B, 3, 231),
    JHYS(NOTE_FS, 3, 231),
    JHYS(NOTE_FS, 5, 116),
    JHYS(NOTE_D, 4, 115),
    JHYS(NOTE_G, 5, 231),
    JHYS(NOTE_FS, 5, 116),
    JHYS(NOTE_FS, 3, 115),
    JHYS(NOTE_E, 5, 231),
    JHYS(NOTE_FS, 5, 116),
    JHYS(NOTE_E, 3, 115),
    JHYS(NOTE_B, 3, 231),
    JHYS(NOTE_E, 3, 231),
    /* Events 561-576 */
    JHYS(NOTE_G, 3, 231),
    JHYS(NOTE_B, 4, 231),
    JHYS(NOTE_B, 3, 230),
    JHYS(NOTE_E, 3, 461),
    JHYS(NOTE_G, 5, 116),
    JHYS(NOTE_A, 3, 115),
    JHYS(NOTE_E, 3, 231),
    JHYS(NOTE_FS, 5, 116),
    JHYS(NOTE_A, 3, 115),
    JHYS(NOTE_E, 5, 116),
    JHYS(NOTE_CS, 4, 115),
    JHYS(NOTE_E, 4, 231),
    JHYS(NOTE_D, 5, 231),
    JHYS(NOTE_A, 3, 461),
    JHYS(NOTE_FS, 5, 231),
    JHYS(NOTE_A, 3, 230),
    /* Events 577-592 */
    JHYS(NOTE_E, 3, 461),
    JHYS(NOTE_C, 4, 461),
    JHYS(NOTE_E, 3, 461),
    JHYS(NOTE_D, 3, 461),
    JHYS(NOTE_A, 3, 461),
    JHYS(NOTE_FS, 5, 116),
    JHYS(NOTE_D, 4, 115),
    JHYS(NOTE_E, 5, 231),
    JHYS(NOTE_D, 5, 231),
    JHYS(NOTE_E, 5, 231),
    JHYS(NOTE_FS, 5, 116),
    JHYS(NOTE_G, 3, 115),
    JHYS(NOTE_D, 3, 231),
    JHYS(NOTE_G, 3, 231),
    JHYS(NOTE_D, 3, 231),
    JHYS(NOTE_B, 5, 231),
    /* Events 593-608 */
    JHYS(NOTE_B, 3, 230),
    JHYS(NOTE_D, 3, 461),
    JHYS(NOTE_E, 5, 116),
    JHYS(NOTE_A, 3, 115),
    JHYS(NOTE_E, 3, 231),
    JHYS(NOTE_A, 3, 231),
    JHYS(NOTE_CS, 4, 231),
    JHYS(NOTE_FS, 5, 231),
    JHYS(NOTE_E, 4, 230),
    JHYS(NOTE_A, 3, 461),
    JHYS(NOTE_A, 5, 116),
    JHYS(NOTE_FS, 3, 115),
    JHYS(NOTE_CS, 3, 231),
    JHYS(NOTE_A, 5, 116),
    JHYS(NOTE_FS, 3, 115),
    JHYS(NOTE_FS, 5, 116),
    /* Events 609-624 */
    JHYS(NOTE_A, 3, 115),
    JHYS(NOTE_B, 5, 231),
    JHYS(NOTE_CS, 4, 230),
    JHYS(NOTE_D, 5, 116),
    JHYS(NOTE_FS, 3, 115),
    JHYS(NOTE_D, 5, 462),
    JHYS(NOTE_FS, 3, 231),
    JHYS(NOTE_B, 3, 231),
    JHYS(NOTE_FS, 3, 231),
    JHYS(NOTE_D, 4, 231),
    JHYS(NOTE_B, 4, 347),
    JHYS(NOTE_FS, 3, 115),
    JHYS(NOTE_CS, 5, 231),
    JHYS(NOTE_D, 5, 116),
    JHYS(NOTE_E, 3, 115),
    JHYS(NOTE_B, 3, 231),
    /* Events 625-640 */
    JHYS(NOTE_E, 3, 231),
    JHYS(NOTE_B, 3, 231),
    JHYS(NOTE_G, 5, 231),
    JHYS(NOTE_G, 3, 230),
    JHYS(NOTE_B, 3, 461),
    JHYS(NOTE_CS, 5, 116),
    JHYS(NOTE_A, 3, 115),
    JHYS(NOTE_E, 3, 231),
    JHYS(NOTE_A, 3, 231),
    JHYS(NOTE_E, 3, 231),
    JHYS(NOTE_CS, 4, 461),
    JHYS(NOTE_E, 5, 231),
    JHYS(NOTE_E, 3, 230),
    JHYS(NOTE_E, 5, 231),
    JHYS(NOTE_A, 3, 231),
    JHYS(NOTE_D, 5, 116),
    /* Events 641-656 */
    JHYS(NOTE_D, 3, 115),
    JHYS(NOTE_FS, 3, 231),
    JHYS(NOTE_A, 3, 461),
    JHYS(NOTE_FS, 3, 461),
    JHYS(NOTE_D, 5, 461),
    JHYS(NOTE_A, 3, 461),
    JHYS(NOTE_FS, 3, 461),
    JHYS(NOTE_B, 4, 116),
    JHYS(NOTE_D, 3, 115),
    JHYS(NOTE_A, 4, 231),
    JHYS(NOTE_B, 4, 231),
    JHYS(NOTE_G, 3, 230),
    JHYS(NOTE_B, 4, 116),
    JHYS(NOTE_D, 3, 115),
    JHYS(NOTE_A, 4, 231),
    JHYS(NOTE_B, 4, 231),
    /* Events 657-672 */
    JHYS(NOTE_G, 3, 230),
    JHYS(NOTE_B, 4, 116),
    JHYS(NOTE_B, 3, 115),
    JHYS(NOTE_A, 4, 231),
    JHYS(NOTE_B, 4, 154),
    JHYS(NOTE_D, 4, 154),
    JHYS(NOTE_CS, 5, 308),
    JHYS(NOTE_D, 5, 308),
    JHYS(NOTE_E, 5, 231),
    JHYS(NOTE_G, 3, 230),
    JHYS(NOTE_D, 5, 1385),
    JHYS(NOTE_FS, 3, 461),
    JHYS(NOTE_D, 3, 461),
    JHYS(NOTE_FS, 3, 461),
    JHYS(NOTE_D, 3, 461),
    JHYS(NOTE_B, 3, 461),
    /* Events 673-688 */
    JHYS(NOTE_B, 4, 116),
    JHYS(NOTE_FS, 3, 115),
    JHYS(NOTE_CS, 5, 231),
    JHYS(NOTE_B, 3, 923),
    JHYS(NOTE_D, 5, 231),
    JHYS(NOTE_E, 3, 230),
    JHYS(NOTE_D, 5, 116),
    JHYS(NOTE_B, 3, 115),
    JHYS(NOTE_CS, 5, 231),
    JHYS(NOTE_D, 5, 231),
    JHYS(NOTE_E, 3, 230),
    JHYS(NOTE_D, 5, 116),
    JHYS(NOTE_G, 3, 115),
    JHYS(NOTE_CS, 5, 231),
    JHYS(NOTE_D, 5, 346),
    JHYS(NOTE_B, 3, 346),
    /* Events 689-704 */
    JHYS(NOTE_D, 5, 231),
    JHYS(NOTE_E, 5, 231),
    JHYS(NOTE_E, 3, 230),
    JHYS(NOTE_D, 5, 231),
    JHYS(NOTE_B, 4, 231),
    JHYS(NOTE_A, 4, 231),
    JHYS(NOTE_D, 3, 230),
    JHYS(NOTE_A, 3, 461),
    JHYS(NOTE_D, 4, 923),
    JHYS(NOTE_E, 3, 461),
    JHYS(NOTE_B, 4, 231),
    JHYS(NOTE_B, 3, 230),
    JHYS(NOTE_D, 5, 461),
    JHYS(NOTE_E, 4, 461),
    JHYS(NOTE_FS, 3, 461),
    JHYS(NOTE_B, 4, 116),
    /* Events 705-720 */
    JHYS(NOTE_D, 3, 115),
    JHYS(NOTE_A, 4, 231),
    JHYS(NOTE_B, 4, 231),
    JHYS(NOTE_FS, 3, 230),
    JHYS(NOTE_B, 4, 231),
    JHYS(NOTE_A, 4, 231),
    JHYS(NOTE_B, 4, 231),
    JHYS(NOTE_G, 3, 230),
    JHYS(NOTE_B, 4, 116),
    JHYS(NOTE_D, 3, 115),
    JHYS(NOTE_A, 4, 231),
    JHYS(NOTE_B, 4, 154),
    JHYS(NOTE_G, 3, 154),
    JHYS(NOTE_CS, 5, 308),
    JHYS(NOTE_D, 5, 308),
    JHYS(NOTE_E, 5, 231),
    /* Events 721-736 */
    JHYS(NOTE_A, 3, 230),
    JHYS(NOTE_D, 5, 116),
    JHYS(NOTE_E, 3, 115),
    JHYS(NOTE_FS, 5, 231),
    JHYS(NOTE_A, 3, 923),
    JHYS(NOTE_B, 3, 461),
    JHYS(NOTE_G, 5, 231),
    JHYS(NOTE_FS, 3, 230),
    JHYS(NOTE_FS, 5, 116),
    JHYS(NOTE_B, 3, 115),
    JHYS(NOTE_E, 5, 461),
    JHYS(NOTE_D, 5, 231),
    JHYS(NOTE_E, 5, 116),
    JHYS(NOTE_E, 3, 115),
    JHYS(NOTE_D, 5, 231),
    JHYS(NOTE_B, 3, 461),
    /* Events 737-752 */
    JHYS(NOTE_D, 5, 461),
    JHYS(NOTE_GS, 3, 461),
    JHYS(NOTE_B, 3, 461),
    JHYS(NOTE_G, 5, 461),
    JHYS(NOTE_FS, 5, 116),
    JHYS(NOTE_E, 3, 115),
    JHYS(NOTE_E, 5, 461),
    JHYS(NOTE_D, 5, 231),
    JHYS(NOTE_E, 5, 231),
    JHYS(NOTE_G, 3, 230),
    JHYS(NOTE_D, 3, 461),
    JHYS(NOTE_AS, 3, 461),
    JHYS(NOTE_D, 3, 461),
    JHYS(NOTE_A, 3, 461),
    JHYS(NOTE_E, 3, 461),
    JHYS(NOTE_FS, 5, 116),
    /* Events 753-768 */
    JHYS(NOTE_CS, 4, 115),
    JHYS(NOTE_G, 5, 231),
    JHYS(NOTE_FS, 5, 231),
    JHYS(NOTE_E, 5, 231),
    JHYS(NOTE_FS, 5, 461),
    JHYS(NOTE_G, 3, 461),
    JHYS(NOTE_B, 4, 923),
    JHYS(NOTE_E, 5, 461),
    JHYS(NOTE_A, 3, 461),
    JHYS(NOTE_A, 4, 923),
    JHYS(NOTE_E, 5, 461),
    JHYS(NOTE_FS, 3, 461),
    JHYS(NOTE_A, 4, 923),
    JHYS(NOTE_D, 5, 461),
    JHYS(NOTE_B, 3, 461),
    JHYS(NOTE_FS, 5, 231),
    /* Events 769-784 */
    JHYS(NOTE_G, 5, 231),
    JHYS(NOTE_FS, 5, 231),
    JHYS(NOTE_E, 5, 231),
    JHYS(NOTE_FS, 5, 231),
    JHYS(NOTE_E, 3, 230),
    JHYS(NOTE_B, 3, 461),
    JHYS(NOTE_B, 4, 231),
    JHYS(NOTE_E, 3, 230),
    JHYS(NOTE_B, 3, 461),
    JHYS(NOTE_G, 5, 231),
    JHYS(NOTE_A, 3, 230),
    JHYS(NOTE_FS, 5, 116),
    JHYS(NOTE_E, 3, 115),
    JHYS(NOTE_E, 5, 231),
    JHYS(NOTE_A, 3, 231),
    JHYS(NOTE_D, 5, 231),
    /* Events 785-800 */
    JHYS(NOTE_E, 3, 461),
    JHYS(NOTE_A, 5, 231),
    JHYS(NOTE_D, 3, 230),
    JHYS(NOTE_A, 3, 461),
    JHYS(NOTE_D, 3, 461),
    JHYS(NOTE_FS, 3, 461),
    JHYS(NOTE_A, 3, 461),
    JHYS(NOTE_FS, 3, 461),
    JHYS(NOTE_FS, 5, 116),
    JHYS(NOTE_A, 3, 115),
    JHYS(NOTE_E, 5, 231),
    JHYS(NOTE_D, 5, 116),
    JHYS(NOTE_D, 4, 115),
    JHYS(NOTE_E, 5, 231),
    JHYS(NOTE_FS, 5, 231),
    JHYS(NOTE_G, 3, 230),
    /* Events 801-816 */
    JHYS(NOTE_D, 3, 461),
    JHYS(NOTE_B, 5, 231),
    JHYS(NOTE_B, 3, 230),
    JHYS(NOTE_D, 3, 461),
    JHYS(NOTE_E, 5, 231),
    JHYS(NOTE_A, 3, 230),
    JHYS(NOTE_E, 3, 461),
    JHYS(NOTE_FS, 5, 231),
    JHYS(NOTE_A, 3, 230),
    JHYS(NOTE_E, 3, 461),
    JHYS(NOTE_A, 5, 231),
    JHYS(NOTE_FS, 3, 230),
    JHYS(NOTE_A, 5, 116),
    JHYS(NOTE_CS, 3, 115),
    JHYS(NOTE_FS, 5, 231),
    JHYS(NOTE_B, 5, 231),
    /* Events 817-832 */
    JHYS(NOTE_FS, 3, 230),
    JHYS(NOTE_CS, 3, 231),
    JHYS(NOTE_D, 5, 231),
    JHYS(NOTE_E, 5, 116),
    JHYS(NOTE_B, 3, 115),
    JHYS(NOTE_D, 5, 231),
    JHYS(NOTE_FS, 3, 461),
    JHYS(NOTE_B, 3, 231),
    JHYS(NOTE_B, 4, 462),
    JHYS(NOTE_CS, 5, 231),
    JHYS(NOTE_D, 5, 231),
    JHYS(NOTE_E, 3, 230),
    JHYS(NOTE_B, 3, 461),
    JHYS(NOTE_G, 5, 231),
    JHYS(NOTE_G, 3, 230),
    JHYS(NOTE_B, 3, 461),
    /* Events 833-848 */
    JHYS(NOTE_CS, 5, 231),
    JHYS(NOTE_A, 3, 230),
    JHYS(NOTE_E, 3, 461),
    JHYS(NOTE_A, 3, 461),
    JHYS(NOTE_A, 4, 231),
    JHYS(NOTE_E, 3, 230),
    JHYS(NOTE_B, 3, 231),
    JHYS(NOTE_E, 5, 231),
    JHYS(NOTE_D, 5, 231),
    JHYS(NOTE_FS, 3, 230),
    JHYS(NOTE_B, 3, 461),
    JHYS(NOTE_FS, 3, 461),
    JHYS(NOTE_B, 4, 116),
    JHYS(NOTE_E, 3, 115),
    JHYS(NOTE_A, 4, 692),
    JHYS(NOTE_B, 3, 461),
    /* Events 849-864 */
    JHYS(NOTE_B, 4, 231),
    JHYS(NOTE_CS, 5, 231),
    JHYS(NOTE_D, 5, 231),
    JHYS(NOTE_E, 3, 230),
    JHYS(NOTE_B, 3, 461),
    JHYS(NOTE_FS, 5, 461),
    JHYS(NOTE_E, 4, 461),
    JHYS(NOTE_CS, 5, 616),
    JHYS(NOTE_E, 3, 615),
    JHYS(NOTE_A, 3, 615),
    JHYS(NOTE_E, 5, 461),
    JHYS(NOTE_D, 5, 3230),
    JHYS(NOTE_FS, 5, 231),
    JHYS(NOTE_D, 3, 230),
    JHYS(NOTE_A, 3, 461),
    JHYS(NOTE_D, 4, 461),
    /* Events 865-880 */
    JHYS(NOTE_A, 3, 461),
    JHYS(NOTE_D, 4, 923),
    JHYS(NOTE_FS, 5, 231),
    JHYS(NOTE_G, 5, 231),
    JHYS(NOTE_A, 5, 461),
    JHYS(NOTE_G, 5, 231),
    JHYS(NOTE_A, 3, 230),
    JHYS(NOTE_E, 3, 461),
    JHYS(NOTE_A, 3, 461),
    JHYS(NOTE_E, 3, 461),
    JHYS(NOTE_FS, 5, 924),
    JHYS(NOTE_C, 4, 923),
    JHYS(NOTE_E, 5, 231),
    JHYS(NOTE_C, 3, 230),
    JHYS(NOTE_G, 3, 461),
    JHYS(NOTE_C, 4, 461),
    /* Events 881-896 */
    JHYS(NOTE_G, 3, 461),
    JHYS(NOTE_E, 5, 231),
    JHYS(NOTE_E, 4, 230),
    JHYS(NOTE_FS, 5, 461),
    JHYS(NOTE_G, 5, 231),
    JHYS(NOTE_G, 3, 230),
    JHYS(NOTE_A, 5, 461),
    JHYS(NOTE_D, 5, 231),
    JHYS(NOTE_B, 3, 230),
    JHYS(NOTE_G, 3, 461),
    JHYS(NOTE_B, 3, 461),
    JHYS(NOTE_G, 3, 461),
    JHYS(NOTE_D, 4, 2770),
    JHYS(NOTE_FS, 3, 923),
    JHYS(NOTE_A, 3, 923),
    JHYS(NOTE_D, 3, 923)
};

#undef JHYS_R
#undef JHYS
