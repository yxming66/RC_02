/* 林俊杰《愿与愁》完整蜂鸣器版。
 * 来源：本地 piastudy 钢琴谱 PDF，共 4 页，覆盖第 1-65 小节。
 * 单声道改编规则：同一时刻优先取右手旋律；低于 C3 的低音按八度上移，
 * 以便小型无源蜂鸣器能更稳定地发声。 */
const Tone_t YUAN_YU_CHOU[] = {
    /* ~measure 1 */
    {NOTE_B, 5, 198}, {NOTE_C, 6, 198}, {NOTE_B, 5, 198}, 
    {NOTE_G, 5, 198}, {NOTE_E, 5, 198}, {NOTE_G, 5, 198}, 
    {NOTE_B, 5, 198}, {NOTE_C, 6, 198}, {NOTE_FS, 5, 198}, 
    {NOTE_FS, 4, 198}, {NOTE_A, 4, 198}, {NOTE_FS, 4, 198}, 
    {NOTE_FS, 5, 198}, {NOTE_G, 5, 198}, {NOTE_FS, 5, 198}, 
    {NOTE_FS, 4, 198}, {NOTE_D, 5, 198}, {NOTE_E, 5, 198}, 
    {NOTE_B, 4, 198}, {NOTE_D, 5, 198}, {NOTE_B, 4, 198}, 
    {NOTE_G, 4, 198}, {NOTE_B, 4, 198}, {NOTE_G, 4, 198}, 
    {NOTE_E, 4, 198}, {NOTE_G, 4, 198}, {NOTE_B, 4, 198}, 
    {NOTE_G, 4, 198}, {NOTE_B, 4, 198}, {NOTE_G, 4, 198}, 
    {NOTE_B, 4, 198}, {NOTE_G, 4, 198}, {NOTE_B, 5, 198}, 
    {NOTE_C, 6, 198}, {NOTE_B, 5, 198}, {NOTE_G, 5, 198}, 
    {NOTE_E, 5, 198}, {NOTE_G, 5, 198}, {NOTE_B, 5, 198}, 
    {NOTE_C, 6, 198}, {NOTE_FS, 5, 198}, {NOTE_FS, 4, 198}, 
    {NOTE_A, 4, 198}, {NOTE_FS, 4, 198}, {NOTE_FS, 5, 198}, 
    {NOTE_G, 5, 198}, {NOTE_FS, 5, 198}, {NOTE_FS, 4, 198}, 
    {NOTE_D, 5, 198}, {NOTE_E, 5, 198}, {NOTE_D, 5, 198}, 
    {NOTE_E, 5, 198}, {NOTE_B, 4, 198}, {NOTE_G, 4, 198}, 
    {NOTE_B, 4, 198}, {NOTE_G, 4, 198}, {NOTE_E, 4, 198}, 
    {NOTE_G, 4, 198}, {NOTE_B, 4, 198}, {NOTE_D, 5, 198}, 
    {NOTE_D, 5, 198}, {NOTE_B, 4, 198}, {NOTE_A, 4, 198}, 
    {NOTE_G, 4, 198}, {NOTE_A, 4, 198}, {NOTE_B, 4, 198}, 
    {NOTE_E, 4, 198}, {NOTE_G, 4, 198}, {NOTE_C, 4, 198}, 
    {NOTE_G, 3, 198}, {NOTE_C, 4, 198}, {NOTE_G, 3, 198}, 
    {NOTE_D, 3, 198}, {NOTE_FS, 3, 198}, {NOTE_A, 3, 198}, 
    {NOTE_FS, 3, 198}, {NOTE_A, 3, 198}, {NOTE_G, 4, 198}, 
    {NOTE_FS, 4, 198}, {NOTE_D, 4, 198}, {NOTE_D, 4, 198}, 
    {NOTE_E, 4, 198}, {NOTE_B, 3, 198}, {NOTE_G, 4, 198}, 
    {NOTE_B, 3, 198}, {NOTE_G, 3, 198}, {NOTE_B, 3, 198}, 
    {NOTE_G, 3, 198}, {NOTE_E, 3, 198}, {NOTE_G, 3, 198}, 
    {NOTE_B, 3, 198}, {NOTE_G, 3, 198}, {NOTE_D, 5, 198}, 
    {NOTE_B, 4, 198}, {NOTE_A, 4, 198}, {NOTE_G, 4, 198}, 
    {NOTE_A, 4, 198}, {NOTE_B, 4, 198}, {NOTE_E, 4, 198}, 
    {NOTE_G, 4, 198}, {NOTE_C, 4, 198}, {NOTE_G, 3, 198}, 
    {NOTE_C, 4, 198}, {NOTE_G, 3, 198}, {NOTE_D, 3, 198}, 
    {NOTE_FS, 3, 198}, {NOTE_A, 3, 198}, {NOTE_A, 4, 198}, 
    {NOTE_A, 4, 198}, {NOTE_G, 4, 198}, {NOTE_A, 4, 198}, 
    {NOTE_B, 4, 198}, {NOTE_E, 3, 198}, {NOTE_G, 3, 198}, 
    {NOTE_B, 3, 198}, {NOTE_G, 4, 198}, {NOTE_B, 3, 198}, 
    {NOTE_G, 3, 198}, {NOTE_B, 3, 198}, {NOTE_FS, 5, 198}, 
    {NOTE_E, 5, 198}, {NOTE_G, 3, 198}, {NOTE_B, 3, 198}, 
    {NOTE_G, 3, 198}, {NOTE_B, 3, 198}, {NOTE_G, 3, 198}, 
    {NOTE_B, 3, 198}, {NOTE_G, 3, 198},
    /* ~measure 9 */
    {NOTE_B, 4, 198}, {NOTE_C, 5, 198}, {NOTE_B, 4, 198}, 
    {NOTE_G, 4, 198}, {NOTE_E, 4, 198}, {NOTE_G, 4, 198}, 
    {NOTE_B, 4, 198}, {NOTE_C, 5, 198}, {NOTE_FS, 4, 198}, 
    {NOTE_FS, 3, 198}, {NOTE_A, 3, 198}, {NOTE_FS, 3, 198}, 
    {NOTE_A, 3, 198}, {NOTE_G, 4, 198}, {NOTE_FS, 4, 198}, 
    {NOTE_D, 4, 198}, {NOTE_D, 4, 198}, {NOTE_E, 4, 198}, 
    {NOTE_B, 3, 198}, {NOTE_G, 4, 198}, {NOTE_B, 3, 198}, 
    {NOTE_G, 3, 198}, {NOTE_B, 3, 198}, {NOTE_G, 3, 198}, 
    {NOTE_E, 3, 198}, {NOTE_G, 3, 198}, {NOTE_B, 3, 198}, 
    {NOTE_G, 3, 198}, {NOTE_D, 5, 198}, {NOTE_B, 4, 198}, 
    {NOTE_A, 4, 198}, {NOTE_G, 4, 198}, {NOTE_A, 4, 198}, 
    {NOTE_B, 4, 198}, {NOTE_C, 5, 198}, {NOTE_D, 5, 198}, 
    {NOTE_C, 5, 198}, {NOTE_G, 3, 198}, {NOTE_C, 5, 198}, 
    {NOTE_A, 4, 198}, {NOTE_D, 3, 198}, {NOTE_FS, 3, 198}, 
    {NOTE_A, 3, 198}, {NOTE_FS, 3, 198}, {NOTE_B, 4, 198}, 
    {NOTE_FS, 3, 198}, {NOTE_E, 4, 198}, {NOTE_A, 4, 198}, 
    {NOTE_E, 3, 198}, {NOTE_G, 4, 198}, {NOTE_B, 3, 198}, 
    {NOTE_G, 3, 198}, {NOTE_B, 3, 198}, {NOTE_G, 3, 198}, 
    {NOTE_B, 3, 198}, {NOTE_G, 3, 198}, {NOTE_E, 3, 198}, 
    {NOTE_G, 3, 198}, {NOTE_B, 3, 198}, {NOTE_G, 5, 198}, 
    {NOTE_G, 5, 198}, {NOTE_FS, 5, 198}, {NOTE_E, 5, 198}, 
    {NOTE_D, 5, 198}, {NOTE_D, 5, 198}, {NOTE_E, 5, 198}, 
    {NOTE_B, 4, 198}, {NOTE_D, 5, 395}, {NOTE_E, 5, 198}, 
    {NOTE_B, 4, 198}, {NOTE_D, 5, 198}, {NOTE_D, 3, 198}, 
    {NOTE_E, 5, 198}, {NOTE_B, 4, 198}, {NOTE_D, 5, 395}, 
    {NOTE_E, 5, 198}, {NOTE_B, 4, 198}, {NOTE_D, 5, 198}, 
    {NOTE_E, 3, 198}, {NOTE_C, 5, 198}, {NOTE_B, 4, 1776}, 
    {NOTE_G, 5, 198}, {NOTE_G, 5, 198}, {NOTE_FS, 5, 198}, 
    {NOTE_E, 5, 198}, {NOTE_D, 5, 198}, {NOTE_D, 5, 198}, 
    {NOTE_E, 5, 198}, {NOTE_B, 4, 198}, {NOTE_D, 5, 395}, 
    {NOTE_E, 5, 198}, {NOTE_B, 4, 198}, {NOTE_D, 5, 198}, 
    {NOTE_D, 3, 198}, {NOTE_E, 5, 198}, {NOTE_B, 4, 198}, 
    {NOTE_D, 5, 395}, {NOTE_E, 5, 198}, {NOTE_B, 4, 395}, 
    {NOTE_E, 5, 1579}, {NOTE_E, 5, 198}, {NOTE_G, 3, 198}, 
    {NOTE_B, 3, 198}, {NOTE_G, 5, 198}, {NOTE_G, 5, 198}, 
    {NOTE_FS, 5, 198}, {NOTE_E, 5, 198}, {NOTE_D, 5, 198},
    /* ~measure 17 */
    {NOTE_D, 5, 198}, {NOTE_E, 5, 198}, {NOTE_B, 4, 198}, 
    {NOTE_D, 5, 395}, {NOTE_E, 5, 198}, {NOTE_B, 4, 198}, 
    {NOTE_D, 5, 198}, {NOTE_D, 3, 198}, {NOTE_E, 5, 198}, 
    {NOTE_B, 4, 198}, {NOTE_D, 5, 987}, {NOTE_B, 4, 395}, 
    {NOTE_B, 4, 198}, {NOTE_D, 5, 198}, {NOTE_FS, 3, 395}, 
    {NOTE_B, 4, 198}, {NOTE_A, 4, 198}, {NOTE_E, 3, 395}, 
    {NOTE_G, 4, 198}, {NOTE_FS, 4, 198}, {NOTE_D, 4, 395}, 
    {NOTE_G, 4, 198}, {NOTE_FS, 4, 198}, {NOTE_C, 3, 198}, 
    {NOTE_E, 4, 198}, {NOTE_C, 3, 198}, {NOTE_D, 3, 395}, 
    {NOTE_E, 4, 198}, {NOTE_B, 4, 198}, {NOTE_A, 4, 198}, 
    {NOTE_D, 3, 395}, {NOTE_G, 4, 198}, {NOTE_FS, 4, 395}, 
    {NOTE_B, 3, 198}, {NOTE_D, 4, 198}, {NOTE_G, 3, 198}, 
    {NOTE_E, 4, 1185}, {NOTE_B, 4, 198}, {NOTE_A, 4, 592}, 
    {NOTE_G, 4, 198}, {NOTE_FS, 4, 592}, {NOTE_G, 4, 198}, 
    {NOTE_FS, 4, 198}, {NOTE_E, 4, 1776}, {NOTE_E, 4, 198}, 
    {NOTE_B, 4, 198}, {NOTE_A, 4, 198}, {NOTE_D, 3, 395}, 
    {NOTE_G, 4, 198}, {NOTE_FS, 4, 198}, {NOTE_E, 4, 789}, 
    {NOTE_D, 4, 395}, {NOTE_E, 4, 789}, {NOTE_FS, 3, 198}, 
    {NOTE_G, 3, 198}, {NOTE_D, 4, 789}, {NOTE_B, 5, 198}, 
    {NOTE_C, 6, 198}, {NOTE_B, 5, 198}, {NOTE_G, 5, 198}, 
    {NOTE_E, 5, 198}, {NOTE_G, 5, 198}, {NOTE_B, 5, 198}, 
    {NOTE_C, 6, 198}, {NOTE_FS, 5, 198}, {NOTE_FS, 4, 198}, 
    {NOTE_A, 4, 198}, {NOTE_FS, 4, 198}, {NOTE_FS, 5, 198}, 
    {NOTE_G, 5, 198}, {NOTE_FS, 5, 198}, {NOTE_FS, 4, 198}, 
    {NOTE_D, 5, 198}, {NOTE_E, 5, 198}, {NOTE_B, 4, 198}, 
    {NOTE_D, 5, 198}, {NOTE_B, 4, 198}, {NOTE_G, 4, 198}, 
    {NOTE_B, 4, 198}, {NOTE_G, 4, 198}, {NOTE_E, 4, 198}, 
    {NOTE_G, 4, 198}, {NOTE_B, 4, 198}, {NOTE_G, 4, 198}, 
    {NOTE_B, 4, 198}, {NOTE_G, 4, 198}, {NOTE_B, 4, 198}, 
    {NOTE_G, 4, 198},
    /* ~measure 25 */
    {NOTE_B, 5, 198}, {NOTE_C, 6, 198}, {NOTE_B, 5, 198}, 
    {NOTE_G, 5, 198}, {NOTE_E, 5, 198}, {NOTE_G, 5, 198}, 
    {NOTE_B, 5, 198}, {NOTE_C, 6, 198}, {NOTE_FS, 5, 198}, 
    {NOTE_FS, 4, 198}, {NOTE_A, 4, 198}, {NOTE_FS, 4, 198}, 
    {NOTE_FS, 5, 198}, {NOTE_G, 5, 198}, {NOTE_FS, 5, 198}, 
    {NOTE_FS, 4, 198}, {NOTE_D, 5, 198}, {NOTE_E, 5, 198}, 
    {NOTE_D, 5, 198}, {NOTE_E, 5, 198}, {NOTE_B, 4, 198}, 
    {NOTE_G, 4, 198}, {NOTE_B, 4, 198}, {NOTE_G, 4, 198}, 
    {NOTE_E, 4, 198}, {NOTE_G, 4, 198}, {NOTE_B, 4, 198}, 
    {NOTE_D, 5, 198}, {NOTE_D, 5, 198}, {NOTE_B, 4, 198}, 
    {NOTE_A, 4, 198}, {NOTE_G, 4, 198}, {NOTE_A, 4, 198}, 
    {NOTE_B, 4, 198}, {NOTE_E, 4, 198}, {NOTE_G, 4, 395}, 
    {NOTE_G, 3, 198}, {NOTE_D, 3, 198}, {NOTE_E, 3, 198}, 
    {NOTE_D, 3, 198}, {NOTE_A, 3, 198}, {NOTE_G, 4, 198}, 
    {NOTE_FS, 4, 198}, {NOTE_G, 4, 198}, {NOTE_D, 3, 198}, 
    {NOTE_A, 4, 198}, {NOTE_FS, 4, 198}, {NOTE_E, 3, 198}, 
    {NOTE_E, 4, 198}, {NOTE_E, 3, 198}, {NOTE_E, 3, 395}, 
    {NOTE_B, 3, 198}, {NOTE_E, 3, 198}, {NOTE_B, 3, 198}, 
    {NOTE_E, 3, 198}, {NOTE_B, 3, 198}, {NOTE_E, 3, 198}, 
    {NOTE_D, 5, 198}, {NOTE_D, 5, 198}, {NOTE_B, 4, 198}, 
    {NOTE_A, 4, 198}, {NOTE_G, 4, 198}, {NOTE_A, 4, 198}, 
    {NOTE_B, 4, 198}, {NOTE_E, 4, 198}, {NOTE_G, 4, 395}, 
    {NOTE_G, 3, 198}, {NOTE_D, 3, 198}, {NOTE_A, 4, 198}, 
    {NOTE_D, 3, 198}, {NOTE_A, 3, 198}, {NOTE_A, 4, 198}, 
    {NOTE_A, 4, 198}, {NOTE_A, 4, 198}, {NOTE_G, 4, 198}, 
    {NOTE_A, 4, 198}, {NOTE_C, 5, 198}, {NOTE_E, 3, 198}, 
    {NOTE_B, 4, 198}, {NOTE_E, 3, 198}, {NOTE_E, 3, 395}, 
    {NOTE_B, 3, 198}, {NOTE_E, 3, 198}, {NOTE_B, 3, 198}, 
    {NOTE_E, 3, 198}, {NOTE_B, 3, 198}, {NOTE_E, 3, 198}, 
    {NOTE_E, 3, 395}, {NOTE_G, 3, 198}, {NOTE_E, 3, 198}, 
    {NOTE_E, 3, 198}, {NOTE_B, 4, 198}, {NOTE_C, 5, 198}, 
    {NOTE_B, 4, 198}, {NOTE_G, 4, 198}, {NOTE_E, 4, 198}, 
    {NOTE_G, 4, 198}, {NOTE_B, 4, 198}, {NOTE_C, 5, 198}, 
    {NOTE_FS, 4, 198}, {NOTE_A, 3, 198}, {NOTE_D, 3, 198}, 
    {NOTE_D, 3, 395}, {NOTE_G, 4, 198}, {NOTE_FS, 4, 198}, 
    {NOTE_D, 4, 198}, {NOTE_D, 4, 198}, {NOTE_E, 4, 198}, 
    {NOTE_G, 4, 198}, {NOTE_E, 3, 395}, {NOTE_B, 3, 198}, 
    {NOTE_E, 3, 198}, {NOTE_B, 3, 198}, {NOTE_B, 4, 198}, 
    {NOTE_B, 3, 198}, {NOTE_E, 3, 198}, {NOTE_E, 3, 395}, 
    {NOTE_G, 3, 198}, {NOTE_E, 3, 198}, {NOTE_E, 3, 198},
    /* ~measure 33 */
    {NOTE_B, 4, 198}, {NOTE_C, 5, 198}, {NOTE_B, 4, 198}, 
    {NOTE_G, 4, 198}, {NOTE_E, 4, 198}, {NOTE_G, 4, 198}, 
    {NOTE_B, 4, 198}, {NOTE_C, 5, 198}, {NOTE_FS, 4, 198}, 
    {NOTE_A, 3, 198}, {NOTE_D, 3, 198}, {NOTE_D, 3, 395}, 
    {NOTE_D, 3, 198}, {NOTE_A, 3, 198}, {NOTE_D, 3, 198}, 
    {NOTE_B, 4, 198}, {NOTE_B, 3, 198}, {NOTE_D, 5, 198}, 
    {NOTE_E, 5, 395}, {NOTE_B, 3, 198}, {NOTE_E, 3, 198}, 
    {NOTE_B, 3, 198}, {NOTE_E, 3, 789}, {NOTE_G, 5, 198}, 
    {NOTE_FS, 5, 198}, {NOTE_E, 5, 198}, {NOTE_D, 5, 198}, 
    {NOTE_D, 5, 198}, {NOTE_E, 5, 198}, {NOTE_B, 4, 198}, 
    {NOTE_D, 5, 198}, {NOTE_E, 3, 198}, {NOTE_E, 5, 198}, 
    {NOTE_B, 4, 198}, {NOTE_D, 5, 198}, {NOTE_D, 3, 198}, 
    {NOTE_E, 5, 198}, {NOTE_B, 4, 198}, {NOTE_D, 5, 198}, 
    {NOTE_FS, 3, 198}, {NOTE_E, 5, 198}, {NOTE_B, 4, 198}, 
    {NOTE_D, 5, 198}, {NOTE_E, 3, 198}, {NOTE_C, 5, 198}, 
    {NOTE_B, 4, 395}, {NOTE_G, 3, 395}, {NOTE_B, 3, 395}, 
    {NOTE_FS, 3, 395}, {NOTE_B, 3, 198}, {NOTE_G, 5, 198}, 
    {NOTE_G, 5, 198}, {NOTE_FS, 5, 198}, {NOTE_E, 5, 198}, 
    {NOTE_D, 5, 198}, {NOTE_D, 5, 198}, {NOTE_E, 5, 198}, 
    {NOTE_B, 4, 198}, {NOTE_D, 5, 198}, {NOTE_E, 3, 198}, 
    {NOTE_E, 5, 198}, {NOTE_B, 4, 198}, {NOTE_D, 5, 198}, 
    {NOTE_D, 3, 198}, {NOTE_E, 5, 198}, {NOTE_B, 4, 198}, 
    {NOTE_D, 5, 198}, {NOTE_FS, 3, 198}, {NOTE_E, 5, 198}, 
    {NOTE_A, 3, 395}, {NOTE_B, 4, 395}, {NOTE_E, 5, 395}, 
    {NOTE_G, 3, 395}, {NOTE_B, 3, 395}, {NOTE_FS, 3, 592}, 
    {NOTE_G, 5, 198}, {NOTE_G, 5, 198}, {NOTE_FS, 5, 198}, 
    {NOTE_E, 5, 198}, {NOTE_D, 5, 198}, {NOTE_D, 5, 198}, 
    {NOTE_E, 5, 198}, {NOTE_B, 4, 198}, {NOTE_D, 5, 198}, 
    {NOTE_E, 3, 198}, {NOTE_E, 5, 198}, {NOTE_B, 4, 198}, 
    {NOTE_D, 5, 198}, {NOTE_D, 3, 198}, {NOTE_E, 5, 198}, 
    {NOTE_B, 4, 198}, {NOTE_D, 5, 198}, {NOTE_FS, 3, 395}, 
    {NOTE_D, 3, 198}, {NOTE_D, 3, 198}, {NOTE_D, 5, 395}, 
    {NOTE_B, 4, 198}, {NOTE_D, 5, 198}, {NOTE_FS, 3, 395}, 
    {NOTE_FS, 5, 198}, {NOTE_G, 5, 198}, {NOTE_E, 3, 395}, 
    {NOTE_D, 5, 198}, {NOTE_C, 5, 395}, {NOTE_B, 4, 395}, 
    {NOTE_A, 4, 198},
    /* ~measure 41 */
    {NOTE_C, 3, 198}, {NOTE_G, 4, 198}, {NOTE_G, 3, 395}, 
    {NOTE_E, 3, 198}, {NOTE_E, 4, 198}, {NOTE_B, 4, 198}, 
    {NOTE_A, 4, 198}, {NOTE_A, 4, 395}, {NOTE_G, 4, 198}, 
    {NOTE_FS, 4, 198}, {NOTE_FS, 3, 198}, {NOTE_A, 3, 198}, 
    {NOTE_D, 4, 198}, {NOTE_E, 4, 198}, {NOTE_E, 3, 395}, 
    {NOTE_B, 3, 198}, {NOTE_E, 3, 198}, {NOTE_G, 3, 395}, 
    {NOTE_B, 4, 198}, {NOTE_A, 4, 198}, {NOTE_B, 3, 395}, 
    {NOTE_G, 4, 198}, {NOTE_FS, 4, 198}, {NOTE_FS, 3, 198}, 
    {NOTE_B, 3, 198}, {NOTE_G, 4, 198}, {NOTE_FS, 4, 198}, 
    {NOTE_E, 4, 592}, {NOTE_G, 3, 198}, {NOTE_E, 3, 198}, 
    {NOTE_E, 4, 198}, {NOTE_B, 4, 198}, {NOTE_A, 4, 198}, 
    {NOTE_A, 4, 395}, {NOTE_G, 4, 198}, {NOTE_FS, 4, 198}, 
    {NOTE_FS, 3, 198}, {NOTE_A, 3, 198}, {NOTE_D, 4, 198}, 
    {NOTE_E, 4, 198}, {NOTE_E, 3, 395}, {NOTE_B, 3, 395}, 
    {NOTE_G, 3, 198}, {NOTE_FS, 3, 198}, {NOTE_E, 3, 198}, 
    {NOTE_E, 3, 987}, {NOTE_G, 5, 198}, {NOTE_FS, 5, 198}, 
    {NOTE_E, 5, 198}, {NOTE_D, 5, 198}, {NOTE_D, 5, 198}, 
    {NOTE_E, 5, 198}, {NOTE_B, 4, 198}, {NOTE_D, 5, 395}, 
    {NOTE_E, 5, 198}, {NOTE_B, 4, 198}, {NOTE_D, 5, 198}, 
    {NOTE_A, 4, 198}, {NOTE_E, 5, 198}, {NOTE_B, 4, 198}, 
    {NOTE_D, 5, 395}, {NOTE_E, 5, 198}, {NOTE_B, 4, 198}, 
    {NOTE_D, 5, 198}, {NOTE_G, 4, 198}, {NOTE_C, 5, 198}, 
    {NOTE_B, 4, 1974}, {NOTE_G, 5, 198}, {NOTE_FS, 5, 198}, 
    {NOTE_E, 5, 198}, {NOTE_D, 5, 198}, {NOTE_D, 5, 198}, 
    {NOTE_E, 5, 198}, {NOTE_B, 4, 198}, {NOTE_D, 5, 395}, 
    {NOTE_E, 5, 198}, {NOTE_B, 4, 198}, {NOTE_D, 5, 198}, 
    {NOTE_A, 4, 198}, {NOTE_E, 5, 198}, {NOTE_B, 4, 198}, 
    {NOTE_D, 5, 395}, {NOTE_E, 5, 198}, {NOTE_B, 4, 198}, 
    {NOTE_E, 5, 198}, {NOTE_G, 4, 395}, {NOTE_B, 3, 395}, 
    {NOTE_D, 4, 395}, {NOTE_G, 3, 395}, {NOTE_B, 3, 395}, 
    {NOTE_E, 3, 395}, {NOTE_G, 5, 198}, {NOTE_FS, 5, 198}, 
    {NOTE_E, 5, 198}, {NOTE_D, 5, 198},
    /* ~measure 49 */
    {NOTE_D, 5, 198}, {NOTE_E, 5, 198}, {NOTE_B, 4, 198}, 
    {NOTE_D, 5, 198}, {NOTE_E, 3, 198}, {NOTE_E, 5, 198}, 
    {NOTE_B, 4, 198}, {NOTE_D, 5, 198}, {NOTE_D, 3, 198}, 
    {NOTE_C, 5, 198}, {NOTE_B, 4, 198}, {NOTE_A, 3, 198}, 
    {NOTE_FS, 3, 198}, {NOTE_A, 3, 198}, {NOTE_D, 3, 198}, 
    {NOTE_D, 3, 198}, {NOTE_B, 4, 198}, {NOTE_D, 3, 198}, 
    {NOTE_B, 4, 198}, {NOTE_D, 5, 198}, {NOTE_FS, 3, 198}, 
    {NOTE_D, 3, 198}, {NOTE_FS, 5, 198}, {NOTE_G, 5, 198}, 
    {NOTE_G, 5, 198}, {NOTE_B, 3, 198}, {NOTE_A, 5, 198}, 
    {NOTE_B, 5, 198}, {NOTE_B, 5, 198}, {NOTE_B, 3, 198}, 
    {NOTE_G, 5, 198}, {NOTE_G, 5, 198}, {NOTE_E, 5, 198}, 
    {NOTE_G, 3, 198}, {NOTE_D, 3, 198}, {NOTE_G, 3, 198}, 
    {NOTE_E, 3, 198}, {NOTE_E, 5, 198}, {NOTE_B, 5, 198}, 
    {NOTE_A, 5, 198}, {NOTE_A, 5, 198}, {NOTE_A, 3, 198}, 
    {NOTE_G, 5, 198}, {NOTE_FS, 5, 198}, {NOTE_FS, 3, 198}, 
    {NOTE_A, 3, 198}, {NOTE_D, 5, 198}, {NOTE_E, 5, 198}, 
    {NOTE_E, 5, 198}, {NOTE_B, 3, 198}, {NOTE_FS, 3, 198}, 
    {NOTE_B, 3, 198}, {NOTE_G, 3, 198}, {NOTE_B, 3, 198}, 
    {NOTE_B, 5, 198}, {NOTE_A, 5, 198}, {NOTE_B, 3, 198}, 
    {NOTE_FS, 3, 198}, {NOTE_G, 5, 198}, {NOTE_FS, 5, 198}, 
    {NOTE_FS, 3, 198}, {NOTE_D, 3, 198}, {NOTE_G, 5, 198}, 
    {NOTE_FS, 5, 198}, {NOTE_E, 5, 198}, {NOTE_G, 3, 198}, 
    {NOTE_D, 3, 198}, {NOTE_G, 3, 198}, {NOTE_E, 3, 198}, 
    {NOTE_E, 5, 198}, {NOTE_B, 5, 198}, {NOTE_A, 5, 198}, 
    {NOTE_A, 5, 198}, {NOTE_A, 3, 198}, {NOTE_G, 5, 198}, 
    {NOTE_FS, 5, 198}, {NOTE_FS, 3, 198}, {NOTE_A, 3, 198}, 
    {NOTE_D, 5, 198}, {NOTE_E, 5, 198}, {NOTE_E, 5, 198}, 
    {NOTE_B, 3, 198}, {NOTE_FS, 3, 198}, {NOTE_B, 3, 198}, 
    {NOTE_G, 3, 198}, {NOTE_B, 3, 198}, {NOTE_E, 3, 198}, 
    {NOTE_B, 3, 198}, {NOTE_E, 3, 198}, {NOTE_B, 3, 198}, 
    {NOTE_E, 3, 198}, {NOTE_B, 3, 198}, {NOTE_G, 5, 198}, 
    {NOTE_FS, 5, 198}, {NOTE_E, 5, 198}, {NOTE_D, 5, 198}, 
    {NOTE_D, 5, 198}, {NOTE_E, 5, 198}, {NOTE_B, 4, 198}, 
    {NOTE_D, 5, 198}, {NOTE_E, 3, 198}, {NOTE_E, 5, 198}, 
    {NOTE_B, 4, 198}, {NOTE_D, 5, 198}, {NOTE_D, 3, 198}, 
    {NOTE_E, 5, 198}, {NOTE_B, 4, 198}, {NOTE_D, 5, 198}, 
    {NOTE_C, 5, 198}, {NOTE_B, 4, 198}, {NOTE_FS, 3, 198}, 
    {NOTE_D, 3, 198}, {NOTE_B, 4, 198}, {NOTE_D, 3, 198}, 
    {NOTE_B, 4, 198}, {NOTE_D, 5, 198}, {NOTE_FS, 3, 198}, 
    {NOTE_D, 3, 198}, {NOTE_FS, 5, 198}, {NOTE_G, 5, 198}, 
    {NOTE_G, 5, 198}, {NOTE_B, 3, 198}, {NOTE_A, 5, 198}, 
    {NOTE_B, 5, 198}, {NOTE_B, 5, 198}, {NOTE_B, 3, 198}, 
    {NOTE_G, 5, 198}, {NOTE_G, 5, 198},
    /* ~measure 57 */
    {NOTE_G, 5, 198}, {NOTE_E, 3, 198}, {NOTE_A, 3, 198}, 
    {NOTE_B, 3, 198}, {NOTE_C, 3, 198}, {NOTE_E, 5, 198}, 
    {NOTE_B, 5, 198}, {NOTE_A, 5, 198}, {NOTE_A, 5, 198}, 
    {NOTE_FS, 3, 198}, {NOTE_G, 5, 198}, {NOTE_FS, 5, 198}, 
    {NOTE_FS, 3, 198}, {NOTE_D, 3, 198}, {NOTE_D, 5, 198}, 
    {NOTE_E, 5, 198}, {NOTE_E, 5, 198}, {NOTE_B, 3, 198}, 
    {NOTE_E, 3, 198}, {NOTE_FS, 3, 198}, {NOTE_G, 3, 198}, 
    {NOTE_FS, 3, 198}, {NOTE_B, 4, 198}, {NOTE_D, 5, 198}, 
    {NOTE_D, 5, 198}, {NOTE_FS, 3, 198}, {NOTE_B, 4, 198}, 
    {NOTE_D, 5, 198}, {NOTE_FS, 3, 198}, {NOTE_D, 3, 198}, 
    {NOTE_E, 5, 198}, {NOTE_E, 5, 198}, {NOTE_D, 5, 198}, 
    {NOTE_C, 5, 198}, {NOTE_D, 3, 198}, {NOTE_G, 3, 198}, 
    {NOTE_E, 3, 198}, {NOTE_E, 4, 198}, {NOTE_B, 4, 198}, 
    {NOTE_A, 4, 198}, {NOTE_A, 4, 198}, {NOTE_A, 3, 198}, 
    {NOTE_G, 4, 198}, {NOTE_FS, 4, 198}, {NOTE_FS, 3, 198}, 
    {NOTE_A, 3, 198}, {NOTE_D, 3, 198}, {NOTE_A, 3, 198}, 
    {NOTE_D, 3, 2368}, {NOTE_G, 4, 395}, {NOTE_G, 4, 395}, 
    {NOTE_B, 5, 198}, {NOTE_C, 6, 198}, {NOTE_B, 5, 198}, 
    {NOTE_G, 5, 198}, {NOTE_E, 5, 198}, {NOTE_G, 5, 198}, 
    {NOTE_B, 5, 198}, {NOTE_C, 6, 198}, {NOTE_FS, 5, 198}, 
    {NOTE_FS, 4, 198}, {NOTE_A, 4, 198}, {NOTE_FS, 4, 198}, 
    {NOTE_FS, 5, 198}, {NOTE_G, 5, 198}, {NOTE_FS, 5, 198}, 
    {NOTE_D, 5, 198}, {NOTE_D, 5, 198}, {NOTE_E, 5, 198}, 
    {NOTE_B, 4, 198}, {NOTE_E, 5, 198}, {NOTE_B, 4, 198}, 
    {NOTE_G, 4, 198}, {NOTE_B, 4, 198}, {NOTE_G, 4, 198}, 
    {NOTE_D, 5, 198}, {NOTE_B, 4, 198}, {NOTE_E, 5, 198}, 
    {NOTE_B, 3, 198}, {NOTE_D, 5, 198}, {NOTE_B, 3, 198}, 
    {NOTE_A, 4, 198}, {NOTE_B, 3, 198}, {NOTE_B, 4, 198}, 
    {NOTE_C, 5, 198}, {NOTE_B, 4, 198}, {NOTE_G, 4, 198}, 
    {NOTE_E, 4, 198}, {NOTE_G, 4, 198}, {NOTE_B, 4, 198}, 
    {NOTE_G, 4, 198}, {NOTE_FS, 4, 198}, {NOTE_FS, 3, 198}, 
    {NOTE_A, 3, 198}, {NOTE_FS, 3, 198}, {NOTE_A, 3, 198}, 
    {NOTE_G, 4, 198}, {NOTE_FS, 4, 198}, {NOTE_D, 4, 198}, 
    {NOTE_G, 4, 198}, {NOTE_FS, 4, 198}, {NOTE_D, 4, 198}, 
    {NOTE_G, 4, 198}, {NOTE_FS, 4, 198}, {NOTE_D, 4, 198}, 
    {NOTE_D, 5, 198}, {NOTE_C, 5, 198}, {NOTE_G, 5, 198}, 
    {NOTE_FS, 5, 198}, {NOTE_D, 5, 198}, {NOTE_G, 4, 198}, 
    {NOTE_FS, 4, 198}, {NOTE_D, 4, 198}, {NOTE_G, 3, 198}, 
    {NOTE_FS, 3, 198},
    /* ~measure 65 */
    {NOTE_D, 4, 3158}, {NOTE_B, 3, 3158}
};

/* 全曲 890 个蜂鸣器事件，按原谱 quarter = 76 BPM 约 209 秒。 */
