/*
 * Lia - Tori no Uta / 鸟之诗.
 * Single-line PWM buzzer reduction generated from local 6-page PDF / PiaStudy HenrimPd MIDI.
 * The right-hand line is preferred at simultaneous onsets; bass notes
 * are folded by octaves into the practical buzzer range.
 * 1133 events, about 193 seconds.
 */
#define FD(note, octave, ms) {note, octave, (uint16_t)(ms)}
#define FD_R(ms) {NOTE_REST, 0, (uint16_t)(ms)}

const Tone_t TORI_NO_UTA[] = {
    /* Events 1-16 */
    FD_R(250),
    FD(NOTE_A, 5, 250),
    FD(NOTE_B, 5, 250),
    FD(NOTE_D, 6, 250),
    FD(NOTE_CS, 5, 25),
    FD(NOTE_E, 5, 25),
    FD(NOTE_CS, 6, 1200),
    FD(NOTE_A, 5, 250),
    FD(NOTE_B, 5, 250),
    FD(NOTE_D, 6, 250),
    FD(NOTE_E, 5, 25),
    FD(NOTE_A, 5, 25),
    FD(NOTE_B, 5, 29),
    FD(NOTE_E, 6, 1171),
    FD(NOTE_A, 5, 250),
    FD(NOTE_B, 5, 250),
    /* Events 17-32 */
    FD(NOTE_D, 6, 250),
    FD(NOTE_B, 3, 25),
    FD(NOTE_FS, 4, 25),
    FD(NOTE_D, 5, 29),
    FD(NOTE_A, 5, 25),
    FD(NOTE_D, 6, 29),
    FD(NOTE_A, 6, 867),
    FD(NOTE_B, 3, 250),
    FD(NOTE_B, 4, 250),
    FD(NOTE_A, 6, 250),
    FD(NOTE_G, 6, 250),
    FD(NOTE_FS, 6, 750),
    FD(NOTE_FS, 5, 500),
    FD(NOTE_A, 4, 250),
    FD(NOTE_B, 4, 250),
    FD(NOTE_D, 5, 250),
    /* Events 33-48 */
    FD(NOTE_CS, 5, 750),
    FD(NOTE_D, 3, 250),
    FD(NOTE_CS, 5, 250),
    FD(NOTE_A, 4, 250),
    FD(NOTE_B, 4, 250),
    FD(NOTE_D, 5, 250),
    FD(NOTE_E, 5, 750),
    FD(NOTE_E, 3, 250),
    FD(NOTE_E, 5, 250),
    FD(NOTE_FS, 4, 250),
    FD(NOTE_A, 4, 250),
    FD(NOTE_CS, 5, 250),
    FD(NOTE_B, 4, 500),
    FD(NOTE_FS, 3, 250),
    FD(NOTE_B, 3, 750),
    FD(NOTE_FS, 3, 250),
    /* Events 49-64 */
    FD(NOTE_B, 3, 250),
    FD(NOTE_B, 4, 1000),
    FD(NOTE_D, 5, 250),
    FD(NOTE_B, 4, 250),
    FD(NOTE_B, 3, 500),
    FD_R(750),
    FD(NOTE_B, 3, 500),
    FD(NOTE_CS, 4, 250),
    FD(NOTE_D, 4, 250),
    FD(NOTE_A, 4, 250),
    FD(NOTE_B, 3, 25),
    FD(NOTE_D, 4, 25),
    FD(NOTE_FS, 4, 700),
    FD(NOTE_E, 4, 125),
    FD(NOTE_FS, 4, 375),
    FD(NOTE_B, 5, 50),
    /* Events 65-80 */
    FD(NOTE_A, 5, 50),
    FD(NOTE_FS, 5, 50),
    FD(NOTE_E, 5, 50),
    FD(NOTE_D, 5, 50),
    FD(NOTE_E, 5, 250),
    FD(NOTE_B, 3, 250),
    FD(NOTE_CS, 4, 500),
    FD(NOTE_E, 4, 250),
    FD(NOTE_FS, 4, 250),
    FD(NOTE_A, 4, 250),
    FD(NOTE_FS, 4, 250),
    FD(NOTE_CS, 4, 250),
    FD(NOTE_D, 4, 250),
    FD(NOTE_CS, 4, 750),
    FD(NOTE_B, 3, 125),
    FD(NOTE_FS, 3, 375),
    /* Events 81-96 */
    FD(NOTE_B, 4, 125),
    FD(NOTE_D, 5, 125),
    FD(NOTE_E, 5, 125),
    FD(NOTE_FS, 5, 125),
    FD(NOTE_E, 5, 500),
    FD(NOTE_FS, 5, 250),
    FD(NOTE_B, 3, 500),
    FD(NOTE_FS, 3, 250),
    FD(NOTE_CS, 4, 250),
    FD(NOTE_D, 4, 250),
    FD(NOTE_A, 4, 250),
    FD(NOTE_FS, 4, 750),
    FD(NOTE_E, 4, 125),
    FD(NOTE_FS, 4, 375),
    FD(NOTE_D, 3, 250),
    FD(NOTE_B, 5, 50),
    /* Events 97-112 */
    FD(NOTE_A, 5, 50),
    FD(NOTE_FS, 5, 50),
    FD(NOTE_E, 5, 50),
    FD(NOTE_D, 5, 50),
    FD(NOTE_B, 3, 250),
    FD(NOTE_E, 5, 500),
    FD(NOTE_E, 4, 250),
    FD(NOTE_FS, 4, 250),
    FD(NOTE_A, 4, 250),
    FD(NOTE_FS, 4, 250),
    FD(NOTE_A, 4, 250),
    FD(NOTE_D, 5, 250),
    FD(NOTE_CS, 5, 375),
    FD(NOTE_B, 4, 375),
    FD(NOTE_FS, 4, 500),
    FD(NOTE_CS, 4, 250),
    /* Events 113-128 */
    FD(NOTE_B, 3, 250),
    FD(NOTE_E, 4, 250),
    FD(NOTE_FS, 4, 250),
    FD(NOTE_FS, 3, 250),
    FD(NOTE_A, 4, 250),
    FD(NOTE_A, 3, 250),
    FD(NOTE_B, 4, 250),
    FD(NOTE_B, 3, 250),
    FD(NOTE_CS, 5, 250),
    FD(NOTE_CS, 4, 250),
    FD(NOTE_A, 4, 25),
    FD(NOTE_B, 4, 25),
    FD(NOTE_D, 5, 29),
    FD(NOTE_FS, 5, 171),
    FD(NOTE_D, 3, 250),
    FD(NOTE_FS, 5, 250),
    /* Events 129-144 */
    FD(NOTE_E, 5, 125),
    FD(NOTE_FS, 5, 375),
    FD(NOTE_D, 4, 246),
    FD(NOTE_G, 4, 4),
    FD(NOTE_B, 5, 50),
    FD(NOTE_A, 5, 50),
    FD(NOTE_FS, 5, 50),
    FD(NOTE_E, 5, 50),
    FD(NOTE_D, 5, 46),
    FD(NOTE_B, 4, 250),
    FD(NOTE_E, 5, 250),
    FD(NOTE_CS, 5, 250),
    FD(NOTE_E, 5, 250),
    FD(NOTE_FS, 5, 250),
    FD(NOTE_A, 5, 250),
    FD(NOTE_FS, 5, 250),
    /* Events 145-160 */
    FD(NOTE_CS, 5, 250),
    FD(NOTE_D, 5, 250),
    FD(NOTE_CS, 5, 250),
    FD(NOTE_FS, 3, 250),
    FD(NOTE_CS, 5, 250),
    FD(NOTE_B, 4, 125),
    FD(NOTE_FS, 4, 375),
    FD(NOTE_B, 3, 125),
    FD(NOTE_FS, 3, 125),
    FD(NOTE_B, 5, 50),
    FD(NOTE_A, 5, 50),
    FD(NOTE_FS, 5, 25),
    FD(NOTE_E, 4, 25),
    FD(NOTE_E, 5, 50),
    FD(NOTE_D, 5, 50),
    FD(NOTE_D, 4, 125),
    /* Events 161-176 */
    FD(NOTE_CS, 4, 125),
    FD(NOTE_CS, 5, 250),
    FD(NOTE_CS, 4, 250),
    FD(NOTE_B, 3, 250),
    FD(NOTE_B, 4, 250),
    FD(NOTE_FS, 3, 250),
    FD(NOTE_CS, 5, 250),
    FD(NOTE_D, 5, 250),
    FD(NOTE_A, 5, 250),
    FD(NOTE_FS, 5, 250),
    FD(NOTE_D, 3, 250),
    FD(NOTE_FS, 5, 250),
    FD(NOTE_E, 5, 125),
    FD(NOTE_FS, 5, 375),
    FD(NOTE_D, 4, 250),
    FD(NOTE_G, 4, 250),
    /* Events 177-192 */
    FD(NOTE_B, 4, 250),
    FD(NOTE_CS, 5, 500),
    FD(NOTE_E, 5, 250),
    FD(NOTE_FS, 5, 250),
    FD(NOTE_A, 5, 250),
    FD(NOTE_FS, 5, 250),
    FD(NOTE_A, 5, 250),
    FD(NOTE_D, 6, 250),
    FD(NOTE_CS, 6, 125),
    FD(NOTE_FS, 5, 125),
    FD(NOTE_E, 5, 125),
    FD(NOTE_CS, 6, 125),
    FD(NOTE_FS, 5, 125),
    FD(NOTE_E, 5, 125),
    FD(NOTE_CS, 6, 125),
    FD(NOTE_FS, 5, 125),
    /* Events 193-208 */
    FD(NOTE_E, 5, 125),
    FD(NOTE_CS, 6, 125),
    FD(NOTE_FS, 5, 125),
    FD(NOTE_E, 5, 125),
    FD(NOTE_CS, 6, 125),
    FD(NOTE_FS, 5, 125),
    FD(NOTE_E, 5, 125),
    FD(NOTE_FS, 5, 125),
    FD(NOTE_B, 5, 125),
    FD(NOTE_FS, 5, 125),
    FD(NOTE_E, 5, 125),
    FD(NOTE_B, 5, 125),
    FD(NOTE_FS, 5, 125),
    FD(NOTE_E, 5, 125),
    FD(NOTE_B, 5, 125),
    FD(NOTE_FS, 5, 125),
    /* Events 209-224 */
    FD(NOTE_E, 5, 125),
    FD(NOTE_B, 5, 125),
    FD(NOTE_FS, 5, 125),
    FD(NOTE_E, 5, 125),
    FD(NOTE_B, 5, 125),
    FD(NOTE_FS, 5, 125),
    FD(NOTE_E, 5, 125),
    FD(NOTE_FS, 5, 125),
    FD(NOTE_CS, 6, 125),
    FD(NOTE_FS, 5, 125),
    FD(NOTE_E, 5, 125),
    FD(NOTE_CS, 6, 125),
    FD(NOTE_FS, 5, 125),
    FD(NOTE_E, 5, 125),
    FD(NOTE_CS, 6, 125),
    FD(NOTE_FS, 5, 125),
    /* Events 225-240 */
    FD(NOTE_E, 5, 125),
    FD(NOTE_CS, 6, 125),
    FD(NOTE_FS, 5, 125),
    FD(NOTE_E, 5, 125),
    FD(NOTE_CS, 6, 125),
    FD(NOTE_FS, 5, 125),
    FD(NOTE_E, 5, 125),
    FD(NOTE_FS, 5, 125),
    FD(NOTE_B, 5, 125),
    FD(NOTE_FS, 5, 125),
    FD(NOTE_E, 5, 125),
    FD(NOTE_B, 5, 125),
    FD(NOTE_FS, 5, 125),
    FD(NOTE_E, 5, 125),
    FD(NOTE_B, 5, 125),
    FD(NOTE_FS, 3, 125),
    /* Events 241-256 */
    FD(NOTE_B, 3, 125),
    FD(NOTE_E, 4, 125),
    FD(NOTE_FS, 4, 125),
    FD(NOTE_A, 4, 125),
    FD(NOTE_B, 4, 125),
    FD(NOTE_D, 5, 125),
    FD(NOTE_E, 5, 125),
    FD(NOTE_FS, 5, 125),
    FD(NOTE_GS, 5, 25),
    FD(NOTE_DS, 6, 25),
    FD(NOTE_GS, 6, 75),
    FD(NOTE_B, 3, 125),
    FD(NOTE_E, 4, 125),
    FD(NOTE_FS, 4, 125),
    FD(NOTE_E, 4, 125),
    FD(NOTE_FS, 4, 125),
    /* Events 257-272 */
    FD(NOTE_GS, 6, 125),
    FD(NOTE_B, 4, 125),
    FD(NOTE_GS, 6, 125),
    FD(NOTE_FS, 4, 125),
    FD(NOTE_GS, 4, 125),
    FD(NOTE_GS, 6, 250),
    FD(NOTE_FS, 4, 125),
    FD(NOTE_GS, 6, 125),
    FD(NOTE_B, 4, 125),
    FD(NOTE_AS, 6, 125),
    FD(NOTE_CS, 4, 125),
    FD(NOTE_FS, 4, 125),
    FD(NOTE_FS, 6, 250),
    FD(NOTE_FS, 4, 125),
    FD(NOTE_FS, 6, 125),
    FD(NOTE_AS, 4, 125),
    /* Events 273-288 */
    FD(NOTE_FS, 6, 125),
    FD(NOTE_FS, 4, 125),
    FD(NOTE_GS, 6, 125),
    FD(NOTE_AS, 4, 125),
    FD(NOTE_CS, 4, 125),
    FD(NOTE_FS, 4, 125),
    FD(NOTE_AS, 6, 125),
    FD(NOTE_AS, 4, 125),
    FD(NOTE_B, 6, 125),
    FD(NOTE_DS, 4, 125),
    FD(NOTE_GS, 4, 125),
    FD(NOTE_AS, 6, 250),
    FD(NOTE_GS, 4, 125),
    FD(NOTE_GS, 6, 125),
    FD(NOTE_B, 4, 125),
    FD(NOTE_GS, 6, 125),
    /* Events 289-304 */
    FD(NOTE_GS, 4, 125),
    FD(NOTE_DS, 6, 125),
    FD(NOTE_B, 4, 125),
    FD(NOTE_DS, 6, 125),
    FD(NOTE_GS, 4, 125),
    FD(NOTE_AS, 4, 125),
    FD(NOTE_B, 4, 125),
    FD(NOTE_DS, 6, 125),
    FD(NOTE_DS, 4, 125),
    FD(NOTE_GS, 4, 125),
    FD(NOTE_AS, 4, 125),
    FD(NOTE_DS, 6, 125),
    FD(NOTE_AS, 4, 125),
    FD(NOTE_GS, 4, 125),
    FD(NOTE_AS, 4, 125),
    FD(NOTE_CS, 6, 125),
    /* Events 305-320 */
    FD(NOTE_FS, 4, 125),
    FD(NOTE_DS, 4, 125),
    FD(NOTE_FS, 4, 125),
    FD(NOTE_B, 5, 125),
    FD(NOTE_CS, 4, 125),
    FD(NOTE_B, 3, 125),
    FD(NOTE_AS, 3, 125),
    FD(NOTE_GS, 5, 25),
    FD(NOTE_DS, 6, 25),
    FD(NOTE_GS, 6, 75),
    FD(NOTE_B, 3, 125),
    FD(NOTE_E, 4, 125),
    FD(NOTE_FS, 4, 125),
    FD(NOTE_E, 4, 125),
    FD(NOTE_FS, 4, 125),
    FD(NOTE_GS, 6, 125),
    /* Events 321-336 */
    FD(NOTE_B, 4, 125),
    FD(NOTE_GS, 6, 125),
    FD(NOTE_FS, 4, 125),
    FD(NOTE_GS, 4, 125),
    FD(NOTE_GS, 6, 250),
    FD(NOTE_FS, 4, 125),
    FD(NOTE_GS, 6, 125),
    FD(NOTE_B, 4, 125),
    FD(NOTE_AS, 6, 125),
    FD(NOTE_CS, 4, 125),
    FD(NOTE_FS, 4, 125),
    FD(NOTE_FS, 6, 250),
    FD(NOTE_FS, 4, 125),
    FD(NOTE_FS, 6, 125),
    FD(NOTE_AS, 4, 125),
    FD(NOTE_FS, 6, 125),
    /* Events 337-352 */
    FD(NOTE_FS, 4, 125),
    FD(NOTE_DS, 6, 125),
    FD(NOTE_AS, 4, 125),
    FD(NOTE_CS, 4, 125),
    FD(NOTE_FS, 4, 125),
    FD(NOTE_FS, 6, 125),
    FD(NOTE_AS, 4, 125),
    FD(NOTE_GS, 6, 125),
    FD(NOTE_DS, 4, 125),
    FD(NOTE_GS, 4, 125),
    FD(NOTE_AS, 6, 250),
    FD(NOTE_GS, 4, 125),
    FD(NOTE_B, 6, 125),
    FD(NOTE_B, 4, 125),
    FD(NOTE_B, 6, 125),
    FD(NOTE_GS, 4, 125),
    /* Events 353-368 */
    FD(NOTE_DS, 5, 125),
    FD(NOTE_B, 4, 125),
    FD(NOTE_FS, 5, 125),
    FD(NOTE_GS, 4, 125),
    FD(NOTE_GS, 5, 125),
    FD(NOTE_B, 4, 250),
    FD(NOTE_DS, 4, 125),
    FD(NOTE_AS, 4, 125),
    FD(NOTE_B, 4, 125),
    FD(NOTE_CS, 5, 125),
    FD(NOTE_DS, 4, 125),
    FD(NOTE_B, 4, 125),
    FD(NOTE_CS, 5, 125),
    FD(NOTE_DS, 5, 125),
    FD(NOTE_DS, 4, 125),
    FD(NOTE_CS, 5, 125),
    /* Events 369-384 */
    FD(NOTE_DS, 5, 125),
    FD(NOTE_E, 5, 125),
    FD(NOTE_CS, 5, 125),
    FD(NOTE_DS, 5, 125),
    FD(NOTE_FS, 5, 125),
    FD(NOTE_GS, 5, 125),
    FD(NOTE_B, 3, 125),
    FD(NOTE_E, 3, 125),
    FD(NOTE_GS, 3, 125),
    FD(NOTE_FS, 3, 125),
    FD(NOTE_GS, 3, 125),
    FD(NOTE_GS, 5, 125),
    FD(NOTE_E, 4, 125),
    FD(NOTE_GS, 5, 125),
    FD(NOTE_E, 4, 125),
    FD(NOTE_FS, 4, 125),
    /* Events 385-400 */
    FD(NOTE_GS, 5, 250),
    FD(NOTE_E, 4, 125),
    FD(NOTE_GS, 5, 125),
    FD(NOTE_GS, 4, 125),
    FD(NOTE_GS, 5, 125),
    FD(NOTE_CS, 3, 125),
    FD(NOTE_FS, 3, 125),
    FD(NOTE_FS, 5, 250),
    FD(NOTE_AS, 3, 125),
    FD(NOTE_FS, 5, 125),
    FD(NOTE_FS, 4, 125),
    FD(NOTE_FS, 5, 125),
    FD(NOTE_FS, 4, 125),
    FD(NOTE_GS, 5, 125),
    FD(NOTE_AS, 4, 125),
    FD(NOTE_CS, 4, 125),
    /* Events 401-416 */
    FD(NOTE_FS, 4, 125),
    FD(NOTE_AS, 5, 125),
    FD(NOTE_AS, 4, 125),
    FD(NOTE_B, 5, 125),
    FD(NOTE_DS, 3, 125),
    FD(NOTE_GS, 3, 125),
    FD(NOTE_AS, 5, 250),
    FD(NOTE_B, 3, 125),
    FD(NOTE_GS, 5, 125),
    FD(NOTE_GS, 4, 125),
    FD(NOTE_GS, 5, 125),
    FD(NOTE_GS, 4, 125),
    FD(NOTE_DS, 5, 125),
    FD(NOTE_B, 4, 125),
    FD(NOTE_DS, 5, 125),
    FD(NOTE_GS, 4, 125),
    /* Events 417-432 */
    FD(NOTE_AS, 4, 125),
    FD(NOTE_B, 4, 125),
    FD(NOTE_DS, 5, 125),
    FD(NOTE_DS, 3, 125),
    FD(NOTE_GS, 3, 125),
    FD(NOTE_AS, 3, 125),
    FD(NOTE_DS, 6, 125),
    FD(NOTE_DS, 4, 125),
    FD(NOTE_GS, 4, 125),
    FD(NOTE_AS, 4, 125),
    FD(NOTE_CS, 6, 125),
    FD(NOTE_AS, 4, 125),
    FD(NOTE_GS, 4, 125),
    FD(NOTE_DS, 4, 125),
    FD(NOTE_B, 5, 125),
    FD(NOTE_AS, 3, 125),
    /* Events 433-448 */
    FD(NOTE_GS, 3, 125),
    FD(NOTE_DS, 3, 125),
    FD(NOTE_E, 3, 125),
    FD(NOTE_B, 3, 125),
    FD(NOTE_E, 3, 125),
    FD(NOTE_GS, 3, 125),
    FD(NOTE_FS, 3, 125),
    FD(NOTE_GS, 3, 125),
    FD(NOTE_DS, 5, 125),
    FD(NOTE_E, 4, 125),
    FD(NOTE_DS, 5, 125),
    FD(NOTE_E, 4, 125),
    FD(NOTE_FS, 4, 125),
    FD(NOTE_DS, 5, 250),
    FD(NOTE_E, 4, 125),
    FD(NOTE_DS, 5, 125),
    /* Events 449-464 */
    FD(NOTE_GS, 4, 125),
    FD(NOTE_CS, 5, 125),
    FD(NOTE_CS, 3, 125),
    FD(NOTE_FS, 3, 125),
    FD(NOTE_CS, 5, 250),
    FD(NOTE_AS, 3, 125),
    FD(NOTE_FS, 5, 125),
    FD(NOTE_FS, 4, 125),
    FD(NOTE_FS, 5, 125),
    FD(NOTE_FS, 4, 125),
    FD(NOTE_DS, 5, 125),
    FD(NOTE_AS, 4, 125),
    FD(NOTE_CS, 4, 125),
    FD(NOTE_FS, 4, 125),
    FD(NOTE_FS, 5, 125),
    FD(NOTE_AS, 4, 125),
    /* Events 465-480 */
    FD(NOTE_GS, 5, 125),
    FD(NOTE_DS, 3, 125),
    FD(NOTE_DS, 5, 125),
    FD(NOTE_AS, 3, 125),
    FD(NOTE_B, 4, 125),
    FD(NOTE_B, 3, 125),
    FD(NOTE_DS, 5, 125),
    FD(NOTE_GS, 4, 125),
    FD(NOTE_B, 5, 125),
    FD(NOTE_GS, 4, 125),
    FD(NOTE_AS, 4, 125),
    FD(NOTE_B, 4, 125),
    FD(NOTE_AS, 5, 125),
    FD(NOTE_GS, 4, 125),
    FD(NOTE_GS, 5, 125),
    FD(NOTE_B, 4, 125),
    /* Events 481-496 */
    FD(NOTE_GS, 5, 125),
    FD(NOTE_DS, 4, 125),
    FD(NOTE_GS, 4, 125),
    FD(NOTE_AS, 4, 125),
    FD(NOTE_B, 4, 125),
    FD(NOTE_DS, 5, 125),
    FD(NOTE_GS, 5, 125),
    FD(NOTE_DS, 6, 125),
    FD(NOTE_GS, 6, 500),
    FD(NOTE_FS, 5, 83),
    FD(NOTE_CS, 3, 83),
    FD(NOTE_AS, 3, 83),
    FD(NOTE_FS, 3, 250),
    FD(NOTE_F, 5, 375),
    FD_R(125),
    FD(NOTE_F, 5, 250),
    /* Events 497-512 */
    FD(NOTE_DS, 5, 125),
    FD(NOTE_F, 5, 375),
    FD(NOTE_C, 5, 83),
    FD(NOTE_CS, 5, 42),
    FD(NOTE_F, 4, 42),
    FD(NOTE_DS, 5, 83),
    FD(NOTE_F, 5, 42),
    FD(NOTE_DS, 5, 42),
    FD(NOTE_F, 5, 42),
    FD(NOTE_FS, 5, 42),
    FD(NOTE_GS, 5, 42),
    FD(NOTE_AS, 5, 42),
    FD(NOTE_FS, 3, 250),
    FD(NOTE_C, 6, 250),
    FD(NOTE_FS, 3, 125),
    FD(NOTE_CS, 4, 125),
    /* Events 513-528 */
    FD(NOTE_F, 5, 125),
    FD(NOTE_FS, 3, 125),
    FD(NOTE_CS, 4, 125),
    FD(NOTE_FS, 3, 125),
    FD(NOTE_FS, 5, 250),
    FD(NOTE_FS, 3, 125),
    FD(NOTE_F, 4, 125),
    FD(NOTE_GS, 5, 250),
    FD(NOTE_FS, 3, 250),
    FD(NOTE_DS, 5, 250),
    FD(NOTE_F, 3, 125),
    FD(NOTE_C, 4, 250),
    FD(NOTE_F, 3, 125),
    FD(NOTE_C, 5, 125),
    FD(NOTE_F, 3, 125),
    FD(NOTE_C, 5, 250),
    /* Events 529-544 */
    FD(NOTE_DS, 6, 83),
    FD(NOTE_CS, 6, 42),
    FD(NOTE_DS, 4, 42),
    FD(NOTE_C, 6, 83),
    FD(NOTE_AS, 5, 42),
    FD(NOTE_GS, 5, 42),
    FD(NOTE_FS, 5, 42),
    FD(NOTE_F, 5, 42),
    FD(NOTE_DS, 5, 42),
    FD(NOTE_CS, 5, 42),
    FD(NOTE_F, 3, 250),
    FD(NOTE_C, 5, 250),
    FD(NOTE_F, 3, 125),
    FD(NOTE_C, 4, 250),
    FD(NOTE_F, 3, 125),
    FD(NOTE_C, 5, 250),
    /* Events 545-560 */
    FD(NOTE_CS, 5, 250),
    FD(NOTE_DS, 5, 250),
    FD(NOTE_B, 3, 250),
    FD(NOTE_E, 3, 250),
    FD(NOTE_F, 5, 375),
    FD_R(125),
    FD(NOTE_F, 5, 250),
    FD(NOTE_AS, 4, 125),
    FD(NOTE_F, 5, 375),
    FD(NOTE_C, 5, 83),
    FD(NOTE_CS, 5, 42),
    FD(NOTE_F, 4, 42),
    FD(NOTE_DS, 5, 83),
    FD(NOTE_F, 5, 42),
    FD(NOTE_FS, 5, 42),
    FD(NOTE_GS, 5, 42),
    /* Events 561-576 */
    FD(NOTE_AS, 5, 42),
    FD(NOTE_C, 6, 42),
    FD(NOTE_CS, 6, 42),
    FD(NOTE_FS, 3, 250),
    FD(NOTE_F, 6, 63),
    FD(NOTE_DS, 6, 63),
    FD(NOTE_CS, 6, 63),
    FD(NOTE_C, 6, 63),
    FD(NOTE_AS, 5, 63),
    FD(NOTE_GS, 5, 63),
    FD(NOTE_FS, 5, 63),
    FD(NOTE_F, 5, 63),
    FD(NOTE_DS, 5, 42),
    FD(NOTE_CS, 5, 42),
    FD(NOTE_C, 5, 42),
    FD(NOTE_AS, 4, 42),
    /* Events 577-592 */
    FD(NOTE_GS, 4, 42),
    FD(NOTE_FS, 4, 42),
    FD(NOTE_F, 4, 125),
    FD(NOTE_FS, 3, 125),
    FD(NOTE_DS, 4, 250),
    FD(NOTE_DS, 5, 125),
    FD(NOTE_F, 4, 125),
    FD(NOTE_CS, 5, 250),
    FD(NOTE_FS, 3, 250),
    FD(NOTE_DS, 5, 250),
    FD(NOTE_F, 3, 125),
    FD(NOTE_C, 4, 125),
    FD(NOTE_DS, 5, 125),
    FD(NOTE_F, 3, 125),
    FD(NOTE_CS, 5, 125),
    FD(NOTE_F, 3, 125),
    /* Events 593-608 */
    FD(NOTE_DS, 5, 250),
    FD(NOTE_F, 3, 125),
    FD(NOTE_GS, 5, 125),
    FD(NOTE_DS, 4, 250),
    FD(NOTE_F, 5, 500),
    FD(NOTE_GS, 4, 121),
    FD(NOTE_AS, 3, 4),
    FD(NOTE_AS, 4, 125),
    FD(NOTE_CS, 5, 250),
    FD(NOTE_AS, 4, 121),
    FD(NOTE_GS, 3, 4),
    FD(NOTE_CS, 5, 125),
    FD(NOTE_DS, 5, 250),
    FD(NOTE_C, 5, 83),
    FD(NOTE_CS, 5, 38),
    FD(NOTE_CS, 3, 46),
    /* Events 609-624 */
    FD(NOTE_DS, 5, 83),
    FD(NOTE_F, 5, 33),
    FD(NOTE_FS, 5, 38),
    FD(NOTE_GS, 5, 33),
    FD(NOTE_AS, 5, 38),
    FD(NOTE_C, 6, 33),
    FD(NOTE_CS, 6, 38),
    FD(NOTE_DS, 6, 38),
    FD_R(121),
    FD(NOTE_DS, 3, 500),
    FD(NOTE_F, 6, 375),
    FD_R(125),
    FD(NOTE_F, 6, 250),
    FD(NOTE_DS, 6, 125),
    FD(NOTE_F, 6, 375),
    FD(NOTE_C, 5, 83),
    /* Events 625-640 */
    FD(NOTE_CS, 5, 42),
    FD(NOTE_F, 4, 42),
    FD(NOTE_DS, 5, 83),
    FD(NOTE_F, 5, 42),
    FD(NOTE_DS, 5, 42),
    FD(NOTE_F, 5, 42),
    FD(NOTE_FS, 5, 42),
    FD(NOTE_GS, 5, 42),
    FD(NOTE_AS, 5, 42),
    FD(NOTE_FS, 3, 250),
    FD(NOTE_C, 6, 250),
    FD(NOTE_FS, 3, 125),
    FD(NOTE_CS, 4, 125),
    FD(NOTE_F, 6, 125),
    FD(NOTE_FS, 3, 125),
    FD(NOTE_CS, 4, 125),
    /* Events 641-656 */
    FD(NOTE_FS, 3, 125),
    FD(NOTE_FS, 6, 250),
    FD(NOTE_FS, 3, 125),
    FD(NOTE_F, 4, 125),
    FD(NOTE_GS, 6, 250),
    FD(NOTE_FS, 3, 250),
    FD(NOTE_DS, 6, 250),
    FD(NOTE_F, 3, 125),
    FD(NOTE_C, 4, 250),
    FD(NOTE_F, 3, 125),
    FD(NOTE_C, 6, 125),
    FD(NOTE_F, 3, 125),
    FD(NOTE_C, 6, 250),
    FD(NOTE_DS, 6, 83),
    FD(NOTE_CS, 6, 42),
    FD(NOTE_DS, 4, 42),
    /* Events 657-672 */
    FD(NOTE_C, 6, 83),
    FD(NOTE_AS, 5, 42),
    FD(NOTE_GS, 5, 42),
    FD(NOTE_FS, 5, 42),
    FD(NOTE_F, 5, 42),
    FD(NOTE_DS, 5, 42),
    FD(NOTE_CS, 5, 42),
    FD(NOTE_F, 3, 250),
    FD(NOTE_C, 5, 250),
    FD(NOTE_F, 3, 125),
    FD(NOTE_C, 4, 250),
    FD(NOTE_F, 3, 125),
    FD(NOTE_C, 6, 250),
    FD(NOTE_CS, 6, 250),
    FD(NOTE_DS, 6, 250),
    FD(NOTE_B, 3, 250),
    /* Events 673-688 */
    FD(NOTE_E, 3, 250),
    FD(NOTE_GS, 6, 375),
    FD_R(125),
    FD(NOTE_GS, 6, 250),
    FD(NOTE_FS, 6, 125),
    FD(NOTE_GS, 6, 375),
    FD(NOTE_DS, 5, 83),
    FD(NOTE_E, 5, 42),
    FD(NOTE_GS, 4, 42),
    FD(NOTE_FS, 5, 83),
    FD(NOTE_GS, 5, 42),
    FD(NOTE_FS, 5, 42),
    FD(NOTE_GS, 5, 42),
    FD(NOTE_A, 5, 42),
    FD(NOTE_B, 5, 42),
    FD(NOTE_CS, 6, 42),
    /* Events 689-704 */
    FD(NOTE_A, 3, 250),
    FD(NOTE_E, 6, 42),
    FD(NOTE_CS, 6, 42),
    FD(NOTE_DS, 6, 42),
    FD(NOTE_E, 6, 42),
    FD(NOTE_FS, 6, 42),
    FD(NOTE_GS, 6, 42),
    FD(NOTE_A, 6, 42),
    FD(NOTE_GS, 6, 42),
    FD(NOTE_A, 6, 42),
    FD(NOTE_B, 6, 42),
    FD(NOTE_CS, 6, 42),
    FD(NOTE_DS, 6, 42),
    FD(NOTE_E, 6, 125),
    FD(NOTE_A, 3, 125),
    FD(NOTE_E, 4, 125),
    /* Events 705-720 */
    FD(NOTE_A, 3, 125),
    FD(NOTE_FS, 6, 250),
    FD(NOTE_E, 6, 125),
    FD(NOTE_GS, 4, 375),
    FD(NOTE_A, 3, 250),
    FD(NOTE_FS, 6, 250),
    FD(NOTE_B, 3, 125),
    FD(NOTE_FS, 4, 125),
    FD(NOTE_FS, 6, 125),
    FD(NOTE_B, 3, 125),
    FD(NOTE_E, 6, 125),
    FD(NOTE_B, 3, 125),
    FD(NOTE_FS, 6, 250),
    FD(NOTE_B, 3, 125),
    FD(NOTE_GS, 6, 625),
    FD(NOTE_C, 4, 500),
    /* Events 721-736 */
    FD(NOTE_GS, 3, 250),
    FD(NOTE_B, 4, 500),
    FD(NOTE_CS, 5, 250),
    FD(NOTE_D, 5, 250),
    FD(NOTE_A, 5, 250),
    FD(NOTE_FS, 5, 250),
    FD(NOTE_G, 3, 125),
    FD(NOTE_D, 3, 125),
    FD(NOTE_FS, 5, 125),
    FD(NOTE_A, 3, 125),
    FD(NOTE_E, 5, 125),
    FD(NOTE_FS, 5, 125),
    FD(NOTE_FS, 4, 125),
    FD(NOTE_A, 4, 125),
    FD(NOTE_B, 4, 125),
    FD(NOTE_CS, 5, 125),
    /* Events 737-752 */
    FD(NOTE_D, 5, 125),
    FD(NOTE_E, 5, 125),
    FD(NOTE_FS, 5, 125),
    FD(NOTE_A, 5, 125),
    FD(NOTE_CS, 6, 125),
    FD(NOTE_A, 5, 125),
    FD(NOTE_E, 5, 125),
    FD(NOTE_D, 5, 125),
    FD(NOTE_E, 5, 250),
    FD(NOTE_FS, 5, 250),
    FD(NOTE_A, 5, 125),
    FD(NOTE_A, 3, 125),
    FD(NOTE_FS, 5, 125),
    FD(NOTE_D, 3, 125),
    FD(NOTE_CS, 5, 125),
    FD(NOTE_A, 4, 125),
    /* Events 753-768 */
    FD(NOTE_D, 5, 125),
    FD(NOTE_D, 4, 125),
    FD(NOTE_CS, 5, 250),
    FD(NOTE_B, 3, 125),
    FD(NOTE_FS, 3, 125),
    FD(NOTE_CS, 5, 125),
    FD(NOTE_CS, 4, 125),
    FD(NOTE_B, 4, 125),
    FD(NOTE_FS, 4, 125),
    FD(NOTE_B, 4, 125),
    FD(NOTE_CS, 5, 125),
    FD(NOTE_D, 5, 125),
    FD(NOTE_FS, 5, 125),
    FD(NOTE_B, 5, 125),
    FD(NOTE_E, 6, 125),
    FD(NOTE_D, 6, 125),
    /* Events 769-784 */
    FD(NOTE_CS, 6, 125),
    FD(NOTE_D, 6, 250),
    FD(NOTE_CS, 6, 250),
    FD(NOTE_B, 5, 250),
    FD(NOTE_B, 4, 250),
    FD(NOTE_B, 5, 125),
    FD(NOTE_FS, 5, 125),
    FD(NOTE_D, 5, 125),
    FD(NOTE_CS, 5, 125),
    FD(NOTE_D, 5, 125),
    FD(NOTE_FS, 4, 125),
    FD(NOTE_A, 5, 125),
    FD(NOTE_CS, 4, 125),
    FD(NOTE_FS, 5, 250),
    FD(NOTE_G, 3, 125),
    FD(NOTE_D, 3, 125),
    /* Events 785-800 */
    FD(NOTE_FS, 5, 125),
    FD(NOTE_A, 3, 125),
    FD(NOTE_E, 5, 125),
    FD(NOTE_FS, 5, 125),
    FD(NOTE_FS, 4, 125),
    FD(NOTE_A, 4, 125),
    FD(NOTE_B, 4, 125),
    FD(NOTE_CS, 5, 125),
    FD(NOTE_D, 5, 125),
    FD(NOTE_E, 5, 125),
    FD(NOTE_FS, 5, 125),
    FD(NOTE_A, 5, 125),
    FD(NOTE_CS, 6, 125),
    FD(NOTE_A, 5, 125),
    FD(NOTE_E, 5, 125),
    FD(NOTE_D, 5, 125),
    /* Events 801-816 */
    FD(NOTE_E, 5, 250),
    FD(NOTE_FS, 5, 250),
    FD(NOTE_A, 5, 125),
    FD(NOTE_A, 3, 125),
    FD(NOTE_FS, 5, 125),
    FD(NOTE_D, 3, 125),
    FD(NOTE_A, 5, 125),
    FD(NOTE_A, 4, 125),
    FD(NOTE_D, 6, 125),
    FD(NOTE_D, 4, 125),
    FD(NOTE_CS, 6, 250),
    FD(NOTE_B, 3, 125),
    FD(NOTE_B, 5, 125),
    FD(NOTE_B, 3, 125),
    FD(NOTE_CS, 4, 125),
    FD(NOTE_FS, 5, 125),
    /* Events 817-832 */
    FD(NOTE_FS, 4, 125),
    FD(NOTE_FS, 5, 125),
    FD(NOTE_FS, 4, 125),
    FD(NOTE_D, 4, 125),
    FD(NOTE_CS, 4, 125),
    FD(NOTE_B, 3, 125),
    FD(NOTE_FS, 3, 125),
    FD(NOTE_E, 5, 125),
    FD(NOTE_FS, 3, 125),
    FD(NOTE_FS, 5, 125),
    FD(NOTE_FS, 3, 125),
    FD(NOTE_B, 3, 125),
    FD(NOTE_FS, 3, 125),
    FD(NOTE_A, 5, 125),
    FD(NOTE_FS, 3, 125),
    FD(NOTE_B, 3, 125),
    /* Events 833-848 */
    FD(NOTE_FS, 3, 125),
    FD(NOTE_B, 5, 125),
    FD(NOTE_FS, 3, 125),
    FD(NOTE_B, 3, 125),
    FD(NOTE_FS, 3, 125),
    FD(NOTE_CS, 6, 125),
    FD(NOTE_FS, 3, 125),
    FD(NOTE_B, 3, 125),
    FD(NOTE_FS, 3, 125),
    FD(NOTE_FS, 6, 125),
    FD(NOTE_D, 4, 125),
    FD(NOTE_FS, 6, 125),
    FD(NOTE_B, 4, 125),
    FD(NOTE_FS, 6, 125),
    FD(NOTE_B, 4, 125),
    FD(NOTE_E, 6, 125),
    /* Events 849-864 */
    FD(NOTE_FS, 6, 250),
    FD(NOTE_B, 4, 125),
    FD(NOTE_B, 5, 125),
    FD(NOTE_A, 5, 125),
    FD(NOTE_FS, 5, 125),
    FD(NOTE_E, 5, 125),
    FD(NOTE_D, 5, 125),
    FD(NOTE_CS, 5, 125),
    FD(NOTE_B, 4, 125),
    FD(NOTE_CS, 5, 125),
    FD(NOTE_D, 5, 125),
    FD(NOTE_FS, 5, 125),
    FD(NOTE_E, 6, 125),
    FD(NOTE_CS, 5, 125),
    FD(NOTE_FS, 6, 125),
    FD(NOTE_FS, 5, 125),
    /* Events 865-880 */
    FD(NOTE_A, 6, 125),
    FD(NOTE_CS, 5, 125),
    FD(NOTE_FS, 6, 125),
    FD(NOTE_FS, 5, 125),
    FD(NOTE_CS, 6, 125),
    FD(NOTE_CS, 5, 125),
    FD(NOTE_D, 6, 125),
    FD(NOTE_FS, 5, 125),
    FD(NOTE_CS, 6, 125),
    FD(NOTE_FS, 4, 125),
    FD(NOTE_B, 4, 125),
    FD(NOTE_CS, 5, 125),
    FD(NOTE_CS, 6, 125),
    FD(NOTE_B, 4, 125),
    FD(NOTE_B, 5, 125),
    FD(NOTE_FS, 5, 125),
    /* Events 881-896 */
    FD(NOTE_FS, 4, 125),
    FD(NOTE_B, 4, 125),
    FD(NOTE_B, 5, 125),
    FD(NOTE_A, 5, 125),
    FD(NOTE_FS, 5, 125),
    FD(NOTE_E, 5, 125),
    FD(NOTE_D, 5, 125),
    FD(NOTE_CS, 5, 125),
    FD(NOTE_B, 5, 125),
    FD(NOTE_A, 5, 125),
    FD(NOTE_FS, 5, 125),
    FD(NOTE_E, 5, 125),
    FD(NOTE_D, 5, 125),
    FD(NOTE_CS, 5, 125),
    FD(NOTE_B, 5, 125),
    FD(NOTE_A, 4, 125),
    /* Events 897-912 */
    FD(NOTE_FS, 4, 125),
    FD(NOTE_E, 4, 125),
    FD(NOTE_CS, 6, 125),
    FD(NOTE_CS, 4, 125),
    FD(NOTE_D, 6, 125),
    FD(NOTE_CS, 4, 125),
    FD(NOTE_A, 6, 125),
    FD(NOTE_FS, 4, 125),
    FD(NOTE_FS, 6, 125),
    FD(NOTE_D, 4, 125),
    FD(NOTE_G, 4, 125),
    FD(NOTE_B, 4, 125),
    FD(NOTE_FS, 6, 125),
    FD(NOTE_B, 4, 125),
    FD(NOTE_E, 6, 125),
    FD(NOTE_FS, 6, 250),
    /* Events 913-928 */
    FD(NOTE_B, 4, 125),
    FD(NOTE_FS, 6, 125),
    FD(NOTE_D, 6, 125),
    FD(NOTE_B, 5, 125),
    FD(NOTE_D, 5, 125),
    FD(NOTE_FS, 5, 125),
    FD(NOTE_B, 5, 125),
    FD(NOTE_D, 6, 125),
    FD(NOTE_FS, 6, 125),
    FD(NOTE_G, 6, 125),
    FD(NOTE_FS, 6, 125),
    FD(NOTE_E, 6, 125),
    FD(NOTE_CS, 5, 125),
    FD(NOTE_FS, 6, 125),
    FD(NOTE_FS, 5, 125),
    FD(NOTE_A, 6, 125),
    /* Events 929-944 */
    FD(NOTE_CS, 5, 125),
    FD(NOTE_FS, 6, 125),
    FD(NOTE_FS, 5, 125),
    FD(NOTE_A, 6, 125),
    FD(NOTE_CS, 5, 125),
    FD(NOTE_D, 6, 125),
    FD(NOTE_FS, 5, 125),
    FD(NOTE_CS, 6, 125),
    FD(NOTE_FS, 6, 125),
    FD(NOTE_E, 6, 125),
    FD(NOTE_CS, 6, 125),
    FD(NOTE_FS, 6, 125),
    FD(NOTE_E, 6, 125),
    FD(NOTE_CS, 6, 125),
    FD(NOTE_FS, 6, 125),
    FD(NOTE_E, 6, 125),
    /* Events 945-960 */
    FD(NOTE_CS, 6, 125),
    FD(NOTE_FS, 6, 125),
    FD(NOTE_E, 6, 125),
    FD(NOTE_CS, 6, 125),
    FD(NOTE_FS, 6, 125),
    FD(NOTE_E, 6, 125),
    FD(NOTE_FS, 6, 125),
    FD(NOTE_B, 6, 125),
    FD(NOTE_D, 6, 125),
    FD(NOTE_E, 6, 125),
    FD(NOTE_B, 6, 125),
    FD(NOTE_FS, 6, 125),
    FD(NOTE_E, 6, 125),
    FD(NOTE_B, 6, 125),
    FD(NOTE_FS, 6, 125),
    FD(NOTE_E, 6, 125),
    /* Events 961-976 */
    FD(NOTE_B, 6, 125),
    FD(NOTE_FS, 6, 125),
    FD(NOTE_E, 6, 125),
    FD(NOTE_B, 6, 125),
    FD(NOTE_FS, 6, 125),
    FD(NOTE_E, 6, 125),
    FD(NOTE_FS, 6, 125),
    FD(NOTE_CS, 6, 125),
    FD(NOTE_D, 6, 125),
    FD(NOTE_E, 6, 125),
    FD(NOTE_CS, 6, 125),
    FD(NOTE_FS, 6, 125),
    FD(NOTE_E, 6, 125),
    FD(NOTE_CS, 6, 125),
    FD(NOTE_FS, 6, 125),
    FD(NOTE_E, 6, 125),
    /* Events 977-992 */
    FD(NOTE_CS, 6, 125),
    FD(NOTE_FS, 6, 125),
    FD(NOTE_E, 6, 125),
    FD(NOTE_CS, 6, 125),
    FD(NOTE_FS, 6, 125),
    FD(NOTE_E, 6, 125),
    FD(NOTE_FS, 6, 125),
    FD(NOTE_D, 6, 125),
    FD(NOTE_FS, 6, 125),
    FD(NOTE_E, 6, 125),
    FD(NOTE_D, 6, 125),
    FD(NOTE_FS, 6, 125),
    FD(NOTE_E, 6, 125),
    FD(NOTE_D, 6, 125),
    FD(NOTE_G, 4, 125),
    FD(NOTE_A, 4, 125),
    /* Events 993-1008 */
    FD(NOTE_B, 4, 125),
    FD(NOTE_CS, 5, 125),
    FD(NOTE_D, 5, 125),
    FD(NOTE_E, 5, 125),
    FD(NOTE_FS, 5, 125),
    FD(NOTE_G, 5, 125),
    FD(NOTE_A, 5, 125),
    FD(NOTE_B, 5, 250),
    FD(NOTE_CS, 5, 250),
    FD(NOTE_B, 4, 250),
    FD(NOTE_E, 5, 500),
    FD(NOTE_D, 5, 500),
    FD(NOTE_CS, 5, 250),
    FD(NOTE_D, 5, 250),
    FD(NOTE_CS, 5, 250),
    FD(NOTE_B, 4, 250),
    /* Events 1009-1024 */
    FD(NOTE_E, 5, 250),
    FD(NOTE_E, 4, 250),
    FD(NOTE_D, 5, 500),
    FD(NOTE_CS, 5, 250),
    FD(NOTE_D, 5, 250),
    FD(NOTE_CS, 5, 250),
    FD(NOTE_B, 4, 250),
    FD(NOTE_E, 5, 500),
    FD(NOTE_D, 5, 500),
    FD(NOTE_CS, 5, 250),
    FD(NOTE_D, 5, 250),
    FD(NOTE_CS, 5, 250),
    FD(NOTE_B, 4, 250),
    FD(NOTE_E, 5, 250),
    FD(NOTE_FS, 4, 250),
    FD(NOTE_D, 5, 250),
    /* Events 1025-1040 */
    FD(NOTE_D, 4, 250),
    FD(NOTE_CS, 5, 250),
    FD(NOTE_D, 5, 250),
    FD(NOTE_CS, 5, 250),
    FD(NOTE_B, 4, 250),
    FD(NOTE_E, 5, 250),
    FD(NOTE_FS, 3, 250),
    FD(NOTE_D, 5, 250),
    FD(NOTE_B, 3, 250),
    FD(NOTE_CS, 5, 250),
    FD(NOTE_D, 5, 250),
    FD(NOTE_CS, 5, 250),
    FD(NOTE_B, 4, 250),
    FD(NOTE_E, 5, 250),
    FD(NOTE_E, 4, 250),
    FD(NOTE_D, 5, 500),
    /* Events 1041-1056 */
    FD(NOTE_CS, 5, 250),
    FD(NOTE_D, 5, 250),
    FD(NOTE_CS, 5, 250),
    FD(NOTE_B, 4, 250),
    FD(NOTE_E, 5, 250),
    FD(NOTE_FS, 4, 250),
    FD(NOTE_D, 5, 250),
    FD(NOTE_B, 3, 250),
    FD(NOTE_CS, 5, 250),
    FD(NOTE_D, 5, 250),
    FD(NOTE_CS, 5, 250),
    FD(NOTE_B, 4, 250),
    FD(NOTE_E, 5, 500),
    FD(NOTE_A, 5, 250),
    FD(NOTE_B, 5, 250),
    FD(NOTE_D, 6, 250),
    /* Events 1057-1072 */
    FD(NOTE_CS, 6, 250),
    FD(NOTE_CS, 5, 250),
    FD(NOTE_B, 4, 250),
    FD(NOTE_E, 5, 250),
    FD(NOTE_B, 4, 250),
    FD(NOTE_A, 5, 250),
    FD(NOTE_B, 5, 250),
    FD(NOTE_D, 6, 250),
    FD(NOTE_E, 6, 250),
    FD(NOTE_CS, 5, 250),
    FD(NOTE_B, 4, 250),
    FD(NOTE_E, 5, 250),
    FD(NOTE_B, 4, 250),
    FD(NOTE_A, 5, 250),
    FD(NOTE_B, 5, 250),
    FD(NOTE_D, 6, 250),
    /* Events 1073-1088 */
    FD(NOTE_A, 6, 250),
    FD(NOTE_CS, 5, 250),
    FD(NOTE_B, 4, 250),
    FD(NOTE_E, 5, 250),
    FD(NOTE_A, 6, 250),
    FD(NOTE_D, 5, 250),
    FD(NOTE_B, 3, 250),
    FD(NOTE_G, 6, 250),
    FD(NOTE_FS, 6, 250),
    FD(NOTE_CS, 5, 250),
    FD(NOTE_FS, 6, 250),
    FD(NOTE_E, 5, 500),
    FD(NOTE_A, 5, 250),
    FD(NOTE_B, 5, 250),
    FD(NOTE_D, 6, 250),
    FD(NOTE_CS, 6, 250),
    /* Events 1089-1104 */
    FD(NOTE_CS, 5, 250),
    FD(NOTE_B, 4, 250),
    FD(NOTE_E, 5, 250),
    FD(NOTE_B, 4, 250),
    FD(NOTE_A, 5, 250),
    FD(NOTE_B, 5, 250),
    FD(NOTE_D, 6, 250),
    FD(NOTE_E, 6, 250),
    FD(NOTE_CS, 5, 250),
    FD(NOTE_B, 4, 250),
    FD(NOTE_E, 5, 250),
    FD(NOTE_B, 4, 250),
    FD(NOTE_FS, 5, 250),
    FD(NOTE_A, 5, 250),
    FD(NOTE_CS, 6, 250),
    FD(NOTE_B, 5, 250),
    /* Events 1105-1120 */
    FD(NOTE_CS, 5, 250),
    FD(NOTE_B, 4, 250),
    FD(NOTE_E, 5, 250),
    FD(NOTE_B, 3, 250),
    FD(NOTE_D, 5, 250),
    FD(NOTE_FS, 4, 250),
    FD(NOTE_CS, 5, 250),
    FD(NOTE_D, 5, 250),
    FD(NOTE_CS, 5, 250),
    FD(NOTE_B, 4, 250),
    FD(NOTE_E, 5, 500),
    FD(NOTE_D, 5, 250),
    FD(NOTE_B, 4, 250),
    FD(NOTE_CS, 5, 250),
    FD(NOTE_FS, 5, 250),
    FD(NOTE_E, 5, 250),
    /* Events 1121-1133 */
    FD(NOTE_D, 5, 250),
    FD(NOTE_E, 5, 500),
    FD(NOTE_D, 5, 250),
    FD(NOTE_B, 4, 250),
    FD(NOTE_CS, 5, 250),
    FD(NOTE_D, 6, 250),
    FD(NOTE_CS, 6, 250),
    FD(NOTE_B, 5, 250),
    FD(NOTE_E, 6, 500),
    FD(NOTE_D, 6, 250),
    FD(NOTE_B, 4, 250),
    FD(NOTE_CS, 6, 250),
    FD(NOTE_B, 6, 2000)
};

#undef FD_R
#undef FD
