/*
 * Zu Hai - Hao Yun Lai.
 * Single-line PWM buzzer reduction generated from local PDF / PiaStudy HemKQqtp MIDI.
 * The right-hand line is preferred at simultaneous onsets; bass notes
 * are folded by octaves into the practical buzzer range.
 * 599 events, about 145 seconds.
 */
#define FD(note, octave, ms) {note, octave, (uint16_t)(ms)}
#define FD_R(ms) {NOTE_REST, 0, (uint16_t)(ms)}

const Tone_t HAO_YUN_LAI[] = {
    /* Events 1-16 */
    FD(NOTE_FS, 6, 97),
    FD(NOTE_D, 6, 97),
    FD(NOTE_E, 6, 97),
    FD(NOTE_CS, 6, 97),
    FD(NOTE_D, 6, 97),
    FD(NOTE_B, 5, 97),
    FD(NOTE_CS, 6, 97),
    FD(NOTE_FS, 5, 97),
    FD(NOTE_A, 5, 97),
    FD(NOTE_FS, 5, 97),
    FD(NOTE_G, 5, 97),
    FD(NOTE_E, 5, 97),
    FD(NOTE_FS, 5, 97),
    FD(NOTE_D, 5, 97),
    FD(NOTE_E, 5, 97),
    FD(NOTE_CS, 5, 97),
    /* Events 17-32 */
    FD(NOTE_FS, 3, 97),
    FD(NOTE_G, 3, 97),
    FD(NOTE_A, 3, 97),
    FD(NOTE_B, 3, 97),
    FD(NOTE_CS, 4, 97),
    FD(NOTE_D, 4, 97),
    FD(NOTE_E, 4, 97),
    FD(NOTE_FS, 4, 97),
    FD(NOTE_E, 4, 97),
    FD(NOTE_FS, 4, 97),
    FD(NOTE_G, 4, 97),
    FD(NOTE_A, 4, 97),
    FD(NOTE_B, 5, 97),
    FD(NOTE_CS, 6, 97),
    FD(NOTE_D, 6, 97),
    FD(NOTE_E, 6, 97),
    /* Events 33-48 */
    FD(NOTE_FS, 5, 390),
    FD_R(390),
    FD(NOTE_FS, 6, 292),
    FD_R(97),
    FD(NOTE_FS, 6, 195),
    FD_R(195),
    FD(NOTE_B, 5, 390),
    FD(NOTE_FS, 6, 195),
    FD(NOTE_B, 3, 195),
    FD(NOTE_E, 6, 195),
    FD(NOTE_B, 3, 195),
    FD(NOTE_D, 6, 195),
    FD(NOTE_B, 5, 195),
    FD(NOTE_A, 5, 390),
    FD(NOTE_D, 6, 195),
    FD(NOTE_A, 3, 195),
    /* Events 49-64 */
    FD(NOTE_B, 5, 195),
    FD(NOTE_A, 3, 585),
    FD(NOTE_B, 5, 390),
    FD(NOTE_E, 6, 195),
    FD(NOTE_E, 3, 195),
    FD(NOTE_D, 6, 195),
    FD(NOTE_E, 3, 195),
    FD(NOTE_B, 5, 195),
    FD(NOTE_A, 5, 195),
    FD(NOTE_E, 5, 390),
    FD(NOTE_A, 5, 195),
    FD(NOTE_B, 5, 195),
    FD(NOTE_A, 5, 195),
    FD(NOTE_FS, 5, 195),
    FD(NOTE_A, 3, 292),
    FD(NOTE_FS, 3, 97),
    /* Events 65-80 */
    FD(NOTE_FS, 5, 390),
    FD(NOTE_B, 5, 195),
    FD(NOTE_A, 5, 195),
    FD(NOTE_B, 5, 195),
    FD(NOTE_B, 3, 195),
    FD(NOTE_B, 5, 195),
    FD(NOTE_A, 5, 195),
    FD(NOTE_B, 5, 390),
    FD(NOTE_E, 6, 195),
    FD(NOTE_D, 6, 195),
    FD(NOTE_E, 6, 195),
    FD(NOTE_E, 3, 195),
    FD(NOTE_E, 4, 195),
    FD(NOTE_E, 3, 195),
    FD(NOTE_D, 6, 584),
    FD(NOTE_E, 6, 195),
    /* Events 81-96 */
    FD(NOTE_FS, 6, 390),
    FD(NOTE_E, 6, 195),
    FD(NOTE_D, 6, 97),
    FD(NOTE_B, 3, 97),
    FD(NOTE_A, 5, 195),
    FD_R(195),
    FD(NOTE_D, 6, 195),
    FD(NOTE_B, 5, 585),
    FD_R(390),
    FD(NOTE_FS, 6, 97),
    FD(NOTE_D, 6, 97),
    FD(NOTE_E, 6, 97),
    FD(NOTE_CS, 6, 97),
    FD(NOTE_D, 6, 97),
    FD(NOTE_B, 5, 97),
    FD(NOTE_CS, 6, 97),
    /* Events 97-112 */
    FD(NOTE_FS, 5, 97),
    FD(NOTE_A, 5, 97),
    FD(NOTE_FS, 5, 97),
    FD(NOTE_G, 5, 97),
    FD(NOTE_E, 5, 97),
    FD(NOTE_A, 4, 195),
    FD(NOTE_B, 4, 195),
    FD_R(390),
    FD(NOTE_B, 4, 194),
    FD_R(195),
    FD(NOTE_B, 6, 195),
    FD_R(584),
    FD(NOTE_B, 5, 389),
    FD(NOTE_D, 6, 390),
    FD(NOTE_B, 5, 390),
    FD_R(195),
    /* Events 113-128 */
    FD(NOTE_B, 5, 195),
    FD(NOTE_A, 5, 195),
    FD(NOTE_FS, 5, 195),
    FD(NOTE_A, 5, 195),
    FD(NOTE_D, 6, 195),
    FD(NOTE_B, 5, 390),
    FD(NOTE_FS, 3, 390),
    FD(NOTE_B, 4, 195),
    FD(NOTE_D, 5, 974),
    FD(NOTE_A, 4, 195),
    FD(NOTE_FS, 3, 195),
    FD(NOTE_B, 4, 195),
    FD(NOTE_A, 4, 195),
    FD(NOTE_E, 4, 195),
    FD(NOTE_A, 4, 390),
    FD(NOTE_FS, 4, 195),
    /* Events 129-144 */
    FD(NOTE_A, 3, 195),
    FD(NOTE_E, 4, 195),
    FD(NOTE_FS, 4, 195),
    FD(NOTE_E, 4, 195),
    FD(NOTE_D, 4, 195),
    FD(NOTE_FS, 4, 195),
    FD(NOTE_E, 4, 390),
    FD(NOTE_B, 3, 195),
    FD(NOTE_FS, 4, 195),
    FD(NOTE_B, 4, 195),
    FD(NOTE_A, 4, 195),
    FD(NOTE_FS, 4, 195),
    FD(NOTE_B, 4, 390),
    FD(NOTE_A, 4, 390),
    FD(NOTE_A, 3, 195),
    FD(NOTE_B, 4, 195),
    /* Events 145-160 */
    FD(NOTE_D, 5, 487),
    FD(NOTE_B, 4, 97),
    FD(NOTE_E, 5, 585),
    FD(NOTE_D, 5, 195),
    FD(NOTE_B, 4, 390),
    FD(NOTE_A, 4, 195),
    FD(NOTE_D, 5, 195),
    FD(NOTE_B, 4, 390),
    FD(NOTE_FS, 4, 195),
    FD(NOTE_FS, 3, 195),
    FD(NOTE_B, 5, 389),
    FD(NOTE_D, 6, 390),
    FD(NOTE_B, 5, 390),
    FD(NOTE_B, 3, 195),
    FD(NOTE_B, 5, 195),
    FD(NOTE_A, 5, 195),
    /* Events 161-176 */
    FD(NOTE_FS, 5, 195),
    FD(NOTE_A, 5, 195),
    FD(NOTE_D, 6, 195),
    FD(NOTE_B, 5, 390),
    FD(NOTE_FS, 3, 390),
    FD(NOTE_B, 4, 195),
    FD(NOTE_D, 5, 779),
    FD(NOTE_A, 3, 195),
    FD(NOTE_A, 4, 195),
    FD(NOTE_FS, 3, 195),
    FD(NOTE_B, 4, 195),
    FD(NOTE_A, 4, 195),
    FD(NOTE_E, 4, 195),
    FD(NOTE_A, 4, 390),
    FD(NOTE_FS, 4, 195),
    FD(NOTE_D, 3, 195),
    /* Events 177-192 */
    FD(NOTE_E, 4, 195),
    FD(NOTE_FS, 4, 195),
    FD(NOTE_E, 4, 195),
    FD(NOTE_D, 4, 195),
    FD(NOTE_FS, 4, 195),
    FD(NOTE_E, 4, 390),
    FD(NOTE_B, 3, 195),
    FD(NOTE_FS, 4, 195),
    FD(NOTE_A, 4, 390),
    FD(NOTE_FS, 4, 195),
    FD(NOTE_B, 4, 390),
    FD(NOTE_A, 4, 390),
    FD(NOTE_A, 3, 195),
    FD(NOTE_B, 4, 195),
    FD(NOTE_D, 5, 487),
    FD(NOTE_B, 4, 97),
    /* Events 193-208 */
    FD(NOTE_E, 5, 585),
    FD(NOTE_D, 5, 195),
    FD(NOTE_B, 4, 390),
    FD(NOTE_A, 4, 195),
    FD(NOTE_D, 5, 195),
    FD(NOTE_B, 4, 195),
    FD(NOTE_FS, 3, 195),
    FD(NOTE_B, 3, 390),
    FD(NOTE_B, 5, 390),
    FD(NOTE_FS, 6, 195),
    FD(NOTE_B, 3, 195),
    FD(NOTE_E, 6, 195),
    FD(NOTE_B, 3, 195),
    FD(NOTE_D, 6, 195),
    FD(NOTE_B, 5, 195),
    FD(NOTE_A, 5, 390),
    /* Events 209-224 */
    FD(NOTE_D, 6, 195),
    FD(NOTE_A, 3, 195),
    FD(NOTE_B, 5, 195),
    FD(NOTE_A, 3, 585),
    FD(NOTE_B, 5, 390),
    FD(NOTE_E, 6, 195),
    FD(NOTE_E, 3, 195),
    FD(NOTE_D, 6, 195),
    FD(NOTE_E, 3, 195),
    FD(NOTE_B, 5, 195),
    FD(NOTE_A, 5, 195),
    FD(NOTE_E, 5, 390),
    FD(NOTE_A, 5, 195),
    FD(NOTE_B, 5, 195),
    FD(NOTE_A, 5, 195),
    FD(NOTE_FS, 5, 195),
    /* Events 225-240 */
    FD(NOTE_A, 3, 292),
    FD(NOTE_FS, 3, 97),
    FD(NOTE_FS, 5, 390),
    FD(NOTE_B, 5, 195),
    FD(NOTE_A, 5, 195),
    FD(NOTE_B, 5, 195),
    FD(NOTE_B, 3, 195),
    FD(NOTE_B, 5, 195),
    FD(NOTE_A, 5, 195),
    FD(NOTE_B, 5, 390),
    FD(NOTE_E, 6, 195),
    FD(NOTE_D, 6, 195),
    FD(NOTE_E, 6, 195),
    FD(NOTE_E, 3, 195),
    FD(NOTE_E, 4, 195),
    FD(NOTE_E, 3, 195),
    /* Events 241-256 */
    FD(NOTE_D, 6, 584),
    FD(NOTE_E, 6, 195),
    FD(NOTE_FS, 6, 390),
    FD(NOTE_E, 6, 195),
    FD(NOTE_D, 6, 97),
    FD(NOTE_B, 3, 97),
    FD(NOTE_A, 5, 195),
    FD_R(195),
    FD(NOTE_D, 6, 195),
    FD(NOTE_B, 5, 390),
    FD(NOTE_B, 3, 1364),
    FD_R(195),
    FD(NOTE_A, 5, 195),
    FD(NOTE_B, 5, 195),
    FD_R(195),
    FD(NOTE_B, 3, 779),
    /* Events 257-272 */
    FD_R(195),
    FD(NOTE_B, 5, 97),
    FD(NOTE_A, 5, 97),
    FD(NOTE_FS, 5, 390),
    FD(NOTE_E, 4, 487),
    FD(NOTE_D, 4, 97),
    FD(NOTE_E, 4, 97),
    FD(NOTE_FS, 4, 97),
    FD(NOTE_A, 4, 487),
    FD(NOTE_E, 4, 97),
    FD(NOTE_FS, 4, 97),
    FD(NOTE_A, 4, 97),
    FD(NOTE_B, 4, 487),
    FD(NOTE_FS, 4, 97),
    FD(NOTE_A, 4, 97),
    FD(NOTE_B, 4, 97),
    /* Events 273-288 */
    FD(NOTE_D, 5, 487),
    FD(NOTE_B, 4, 97),
    FD(NOTE_D, 5, 97),
    FD(NOTE_E, 5, 97),
    FD(NOTE_FS, 5, 390),
    FD_R(390),
    FD(NOTE_FS, 5, 292),
    FD_R(97),
    FD(NOTE_FS, 6, 195),
    FD_R(195),
    FD(NOTE_B, 5, 389),
    FD(NOTE_D, 6, 390),
    FD(NOTE_B, 5, 195),
    FD(NOTE_B, 3, 390),
    FD(NOTE_B, 5, 195),
    FD(NOTE_A, 5, 195),
    /* Events 289-304 */
    FD(NOTE_FS, 5, 195),
    FD(NOTE_A, 5, 195),
    FD(NOTE_D, 6, 195),
    FD(NOTE_B, 5, 195),
    FD(NOTE_FS, 3, 585),
    FD(NOTE_B, 4, 195),
    FD(NOTE_D, 5, 390),
    FD(NOTE_G, 3, 97),
    FD(NOTE_D, 5, 292),
    FD(NOTE_G, 3, 195),
    FD(NOTE_A, 4, 195),
    FD(NOTE_G, 3, 195),
    FD(NOTE_B, 4, 195),
    FD(NOTE_A, 4, 195),
    FD(NOTE_E, 4, 195),
    FD(NOTE_A, 4, 390),
    /* Events 305-320 */
    FD(NOTE_FS, 4, 195),
    FD(NOTE_D, 4, 195),
    FD(NOTE_E, 4, 195),
    FD(NOTE_FS, 4, 195),
    FD(NOTE_E, 4, 195),
    FD(NOTE_D, 4, 195),
    FD(NOTE_FS, 4, 195),
    FD(NOTE_E, 4, 195),
    FD(NOTE_B, 3, 390),
    FD(NOTE_FS, 4, 195),
    FD(NOTE_B, 4, 195),
    FD(NOTE_A, 4, 195),
    FD(NOTE_FS, 4, 195),
    FD(NOTE_B, 4, 390),
    FD(NOTE_A, 4, 195),
    FD(NOTE_D, 4, 195),
    /* Events 321-336 */
    FD(NOTE_D, 3, 195),
    FD(NOTE_B, 4, 195),
    FD(NOTE_D, 5, 390),
    FD(NOTE_D, 3, 97),
    FD(NOTE_B, 4, 97),
    FD(NOTE_E, 5, 585),
    FD(NOTE_D, 5, 195),
    FD(NOTE_B, 4, 390),
    FD(NOTE_A, 4, 195),
    FD(NOTE_D, 5, 195),
    FD(NOTE_B, 4, 195),
    FD(NOTE_B, 3, 585),
    FD(NOTE_B, 5, 389),
    FD(NOTE_D, 6, 390),
    FD(NOTE_B, 5, 195),
    FD(NOTE_B, 3, 390),
    /* Events 337-352 */
    FD(NOTE_B, 5, 195),
    FD(NOTE_A, 5, 195),
    FD(NOTE_FS, 5, 195),
    FD(NOTE_A, 5, 195),
    FD(NOTE_D, 6, 195),
    FD(NOTE_B, 5, 195),
    FD(NOTE_FS, 3, 585),
    FD(NOTE_B, 4, 195),
    FD(NOTE_D, 5, 390),
    FD(NOTE_G, 3, 97),
    FD(NOTE_D, 5, 292),
    FD(NOTE_G, 3, 195),
    FD(NOTE_A, 4, 195),
    FD(NOTE_G, 3, 195),
    FD(NOTE_B, 4, 195),
    FD(NOTE_A, 4, 195),
    /* Events 353-368 */
    FD(NOTE_E, 4, 195),
    FD(NOTE_A, 4, 390),
    FD(NOTE_FS, 4, 195),
    FD(NOTE_D, 4, 195),
    FD(NOTE_E, 4, 195),
    FD(NOTE_FS, 4, 195),
    FD(NOTE_E, 4, 195),
    FD(NOTE_D, 4, 195),
    FD(NOTE_FS, 4, 195),
    FD(NOTE_E, 4, 195),
    FD(NOTE_B, 3, 390),
    FD(NOTE_FS, 4, 195),
    FD(NOTE_A, 4, 390),
    FD(NOTE_FS, 4, 195),
    FD(NOTE_B, 4, 390),
    FD(NOTE_A, 4, 195),
    /* Events 369-384 */
    FD(NOTE_D, 4, 195),
    FD(NOTE_D, 3, 195),
    FD(NOTE_B, 4, 195),
    FD(NOTE_D, 5, 390),
    FD(NOTE_D, 3, 97),
    FD(NOTE_B, 4, 97),
    FD(NOTE_E, 5, 585),
    FD(NOTE_D, 5, 195),
    FD(NOTE_B, 4, 390),
    FD(NOTE_A, 4, 195),
    FD(NOTE_D, 5, 195),
    FD(NOTE_B, 4, 195),
    FD(NOTE_FS, 3, 195),
    FD(NOTE_B, 3, 390),
    FD(NOTE_B, 5, 390),
    FD(NOTE_FS, 6, 195),
    /* Events 385-400 */
    FD(NOTE_B, 3, 195),
    FD(NOTE_E, 6, 195),
    FD(NOTE_B, 3, 195),
    FD(NOTE_D, 6, 195),
    FD(NOTE_B, 5, 195),
    FD(NOTE_A, 5, 390),
    FD(NOTE_D, 6, 195),
    FD(NOTE_A, 3, 195),
    FD(NOTE_B, 5, 195),
    FD(NOTE_A, 3, 585),
    FD(NOTE_B, 5, 390),
    FD(NOTE_E, 6, 195),
    FD(NOTE_E, 3, 195),
    FD(NOTE_D, 6, 195),
    FD(NOTE_E, 3, 195),
    FD(NOTE_B, 5, 195),
    /* Events 401-416 */
    FD(NOTE_A, 5, 195),
    FD(NOTE_E, 5, 390),
    FD(NOTE_A, 5, 195),
    FD(NOTE_B, 5, 195),
    FD(NOTE_A, 5, 195),
    FD(NOTE_FS, 5, 195),
    FD(NOTE_A, 3, 292),
    FD(NOTE_FS, 3, 97),
    FD(NOTE_FS, 5, 390),
    FD(NOTE_B, 5, 195),
    FD(NOTE_A, 5, 195),
    FD(NOTE_B, 5, 195),
    FD(NOTE_B, 3, 195),
    FD(NOTE_B, 5, 195),
    FD(NOTE_A, 5, 195),
    FD(NOTE_B, 5, 390),
    /* Events 417-432 */
    FD(NOTE_E, 6, 195),
    FD(NOTE_D, 6, 195),
    FD(NOTE_E, 6, 195),
    FD(NOTE_E, 3, 195),
    FD(NOTE_E, 4, 195),
    FD(NOTE_E, 3, 195),
    FD(NOTE_D, 6, 584),
    FD(NOTE_E, 6, 195),
    FD(NOTE_FS, 6, 390),
    FD(NOTE_E, 6, 195),
    FD(NOTE_D, 6, 97),
    FD(NOTE_B, 3, 97),
    FD(NOTE_A, 5, 195),
    FD_R(195),
    FD(NOTE_D, 6, 195),
    FD(NOTE_B, 5, 390),
    /* Events 433-448 */
    FD(NOTE_B, 3, 585),
    FD(NOTE_B, 5, 390),
    FD(NOTE_FS, 6, 195),
    FD(NOTE_B, 3, 195),
    FD(NOTE_E, 6, 195),
    FD(NOTE_B, 3, 195),
    FD(NOTE_D, 6, 195),
    FD(NOTE_B, 5, 195),
    FD(NOTE_A, 5, 390),
    FD(NOTE_D, 6, 195),
    FD(NOTE_A, 3, 195),
    FD(NOTE_B, 5, 195),
    FD(NOTE_A, 3, 585),
    FD(NOTE_B, 5, 390),
    FD(NOTE_E, 6, 195),
    FD(NOTE_E, 3, 195),
    /* Events 449-464 */
    FD(NOTE_D, 6, 195),
    FD(NOTE_E, 3, 195),
    FD(NOTE_B, 5, 195),
    FD(NOTE_A, 5, 195),
    FD(NOTE_E, 5, 390),
    FD(NOTE_A, 5, 195),
    FD(NOTE_B, 5, 195),
    FD(NOTE_A, 5, 195),
    FD(NOTE_FS, 5, 195),
    FD(NOTE_A, 3, 292),
    FD(NOTE_FS, 3, 97),
    FD(NOTE_FS, 5, 390),
    FD(NOTE_B, 5, 195),
    FD(NOTE_A, 5, 195),
    FD(NOTE_B, 5, 195),
    FD(NOTE_B, 3, 195),
    /* Events 465-480 */
    FD(NOTE_B, 5, 195),
    FD(NOTE_A, 5, 195),
    FD(NOTE_B, 5, 390),
    FD(NOTE_E, 6, 195),
    FD(NOTE_D, 6, 195),
    FD(NOTE_E, 6, 195),
    FD(NOTE_E, 3, 195),
    FD(NOTE_E, 4, 195),
    FD(NOTE_E, 3, 195),
    FD(NOTE_D, 6, 584),
    FD(NOTE_E, 6, 195),
    FD(NOTE_FS, 6, 390),
    FD(NOTE_E, 6, 195),
    FD(NOTE_D, 6, 97),
    FD(NOTE_B, 3, 97),
    FD(NOTE_A, 5, 195),
    /* Events 481-496 */
    FD_R(195),
    FD(NOTE_D, 6, 195),
    FD(NOTE_B, 5, 390),
    FD(NOTE_B, 3, 1364),
    FD_R(584),
    FD(NOTE_D, 4, 97),
    FD(NOTE_E, 4, 97),
    FD(NOTE_FS, 4, 195),
    FD(NOTE_E, 4, 97),
    FD(NOTE_D, 4, 97),
    FD(NOTE_E, 4, 195),
    FD(NOTE_D, 4, 97),
    FD(NOTE_B, 3, 97),
    FD(NOTE_D, 4, 195),
    FD(NOTE_B, 3, 97),
    FD(NOTE_A, 3, 97),
    /* Events 497-512 */
    FD(NOTE_B, 3, 1169),
    FD_R(584),
    FD(NOTE_D, 4, 97),
    FD(NOTE_E, 4, 97),
    FD(NOTE_FS, 4, 194),
    FD(NOTE_E, 4, 97),
    FD(NOTE_D, 4, 97),
    FD(NOTE_E, 4, 194),
    FD(NOTE_D, 4, 97),
    FD(NOTE_B, 3, 97),
    FD(NOTE_D, 4, 195),
    FD(NOTE_E, 4, 97),
    FD(NOTE_FS, 4, 97),
    FD(NOTE_A, 3, 195),
    FD(NOTE_B, 3, 390),
    FD(NOTE_A, 3, 97),
    /* Events 513-528 */
    FD(NOTE_B, 3, 97),
    FD(NOTE_D, 4, 195),
    FD(NOTE_B, 3, 97),
    FD(NOTE_D, 4, 97),
    FD(NOTE_E, 4, 195),
    FD(NOTE_D, 4, 97),
    FD(NOTE_E, 4, 97),
    FD(NOTE_FS, 4, 195),
    FD(NOTE_E, 4, 97),
    FD(NOTE_FS, 4, 97),
    FD(NOTE_A, 4, 195),
    FD(NOTE_FS, 4, 97),
    FD(NOTE_A, 4, 97),
    FD(NOTE_B, 4, 195),
    FD(NOTE_A, 4, 97),
    FD(NOTE_B, 4, 97),
    /* Events 529-544 */
    FD(NOTE_D, 5, 195),
    FD(NOTE_B, 4, 97),
    FD(NOTE_D, 5, 97),
    FD(NOTE_E, 5, 194),
    FD(NOTE_D, 5, 97),
    FD(NOTE_E, 5, 97),
    FD(NOTE_FS, 5, 390),
    FD_R(390),
    FD(NOTE_FS, 5, 292),
    FD_R(97),
    FD(NOTE_FS, 6, 195),
    FD_R(195),
    FD(NOTE_B, 5, 390),
    FD(NOTE_FS, 6, 195),
    FD(NOTE_B, 3, 195),
    FD(NOTE_E, 6, 195),
    /* Events 545-560 */
    FD(NOTE_B, 3, 195),
    FD(NOTE_D, 6, 195),
    FD(NOTE_B, 5, 195),
    FD(NOTE_A, 5, 390),
    FD(NOTE_D, 6, 195),
    FD(NOTE_A, 3, 195),
    FD(NOTE_B, 5, 195),
    FD(NOTE_A, 3, 585),
    FD(NOTE_B, 5, 390),
    FD(NOTE_E, 6, 195),
    FD(NOTE_E, 3, 195),
    FD(NOTE_D, 6, 195),
    FD(NOTE_E, 3, 195),
    FD(NOTE_B, 5, 195),
    FD(NOTE_A, 5, 195),
    FD(NOTE_E, 5, 390),
    /* Events 561-576 */
    FD(NOTE_A, 5, 195),
    FD(NOTE_B, 5, 195),
    FD(NOTE_A, 5, 195),
    FD(NOTE_FS, 5, 195),
    FD(NOTE_A, 3, 292),
    FD(NOTE_FS, 3, 97),
    FD(NOTE_FS, 5, 390),
    FD(NOTE_B, 5, 195),
    FD(NOTE_A, 5, 195),
    FD(NOTE_B, 5, 195),
    FD(NOTE_B, 3, 195),
    FD(NOTE_B, 5, 195),
    FD(NOTE_A, 5, 195),
    FD(NOTE_B, 5, 390),
    FD(NOTE_E, 6, 195),
    FD(NOTE_D, 6, 195),
    /* Events 577-592 */
    FD(NOTE_E, 6, 195),
    FD(NOTE_E, 3, 195),
    FD(NOTE_E, 4, 195),
    FD(NOTE_E, 3, 195),
    FD(NOTE_D, 6, 584),
    FD(NOTE_E, 6, 195),
    FD(NOTE_FS, 6, 390),
    FD(NOTE_E, 6, 195),
    FD(NOTE_D, 6, 97),
    FD(NOTE_B, 3, 97),
    FD(NOTE_A, 5, 195),
    FD_R(195),
    FD(NOTE_D, 6, 195),
    FD(NOTE_B, 5, 487),
    FD(NOTE_B, 3, 487),
    FD(NOTE_E, 5, 1558),
    /* Events 593-599 */
    FD(NOTE_FS, 5, 1169),
    FD(NOTE_FS, 3, 388),
    FD(NOTE_B, 4, 1558),
    FD(NOTE_B, 3, 779),
    FD_R(390),
    FD(NOTE_A, 4, 390),
    FD(NOTE_B, 4, 195)
};

#undef FD_R
#undef FD
