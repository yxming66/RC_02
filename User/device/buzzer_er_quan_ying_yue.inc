/*
 * Abing - Er Quan Ying Yue / 二泉映月.
 * Manual single-line PWM buzzer reduction from the two numbered-score
 * images provided in chat, 1=G. Bowing marks and dynamics are omitted;
 * ornamental groups are folded into short buzzer notes.
 * 464 events, about 140 seconds.
 */
#define EQY(note, octave, ms) {note, octave, (uint16_t)(ms)}
#define EQY_R(ms) {NOTE_REST, 0, (uint16_t)(ms)}

const Tone_t ER_QUAN_YING_YUE[] = {
    /* Events 1-16 */
    EQY_R(780),
    EQY(NOTE_E, 5, 520),
    EQY(NOTE_D, 5, 175),
    EQY(NOTE_E, 5, 175),
    EQY(NOTE_C, 5, 175),
    EQY(NOTE_B, 4, 175),
    EQY(NOTE_A, 4, 1430),
    EQY(NOTE_B, 4, 260),
    EQY(NOTE_G, 4, 780),
    EQY(NOTE_A, 4, 260),
    EQY(NOTE_B, 4, 780),
    EQY(NOTE_D, 5, 520),
    EQY(NOTE_E, 5, 260),
    EQY(NOTE_D, 5, 260),
    EQY(NOTE_E, 5, 175),
    EQY(NOTE_D, 5, 175),
    /* Events 17-32 */
    EQY(NOTE_E, 5, 175),
    EQY(NOTE_G, 4, 175),
    EQY(NOTE_D, 5, 390),
    EQY(NOTE_B, 4, 260),
    EQY(NOTE_D, 5, 780),
    EQY(NOTE_B, 4, 260),
    EQY(NOTE_A, 4, 260),
    EQY(NOTE_E, 5, 260),
    EQY(NOTE_D, 5, 175),
    EQY(NOTE_E, 5, 175),
    EQY(NOTE_G, 4, 175),
    EQY(NOTE_A, 4, 175),
    EQY_R(160),
    EQY(NOTE_B, 4, 390),
    EQY(NOTE_D, 5, 260),
    EQY(NOTE_A, 4, 263),
    /* Events 33-48 */
    EQY(NOTE_B, 4, 175),
    EQY(NOTE_D, 5, 175),
    EQY(NOTE_G, 4, 175),
    EQY(NOTE_E, 5, 175),
    EQY(NOTE_A, 4, 175),
    EQY(NOTE_B, 4, 175),
    EQY(NOTE_D, 5, 175),
    EQY(NOTE_G, 4, 1300),
    EQY(NOTE_E, 5, 260),
    EQY(NOTE_G, 4, 260),
    EQY(NOTE_B, 4, 520),
    EQY(NOTE_A, 4, 260),
    EQY(NOTE_G, 4, 390),
    EQY(NOTE_E, 5, 260),
    EQY(NOTE_G, 4, 263),
    EQY(NOTE_A, 4, 175),
    /* Events 49-64 */
    EQY(NOTE_B, 4, 350),
    EQY(NOTE_A, 4, 520),
    EQY(NOTE_G, 4, 650),
    EQY(NOTE_E, 5, 175),
    EQY(NOTE_G, 4, 175),
    EQY(NOTE_A, 4, 175),
    EQY(NOTE_B, 4, 175),
    EQY_R(160),
    EQY(NOTE_D, 5, 1215),
    EQY_R(175),
    EQY(NOTE_B, 4, 175),
    EQY(NOTE_D, 5, 175),
    EQY(NOTE_E, 5, 175),
    EQY(NOTE_D, 5, 175),
    EQY(NOTE_E, 5, 175),
    EQY(NOTE_G, 4, 175),
    /* Events 65-80 */
    EQY(NOTE_D, 5, 390),
    EQY(NOTE_B, 4, 260),
    EQY(NOTE_D, 5, 520),
    EQY(NOTE_G, 4, 520),
    EQY(NOTE_E, 5, 520),
    EQY(NOTE_D, 5, 175),
    EQY(NOTE_E, 5, 175),
    EQY(NOTE_D, 5, 350),
    EQY(NOTE_B, 4, 390),
    EQY(NOTE_D, 5, 260),
    EQY(NOTE_B, 4, 175),
    EQY(NOTE_CS, 5, 175),
    EQY(NOTE_B, 4, 175),
    EQY(NOTE_D, 5, 175),
    EQY(NOTE_A, 4, 263),
    EQY(NOTE_B, 4, 175),
    /* Events 81-96 */
    EQY(NOTE_A, 4, 175),
    EQY(NOTE_G, 4, 175),
    EQY(NOTE_E, 5, 260),
    EQY(NOTE_G, 4, 260),
    EQY(NOTE_E, 5, 260),
    EQY_R(160),
    EQY(NOTE_G, 4, 390),
    EQY(NOTE_E, 5, 260),
    EQY(NOTE_G, 4, 390),
    EQY(NOTE_A, 4, 260),
    EQY(NOTE_B, 4, 260),
    EQY(NOTE_D, 5, 260),
    EQY(NOTE_G, 4, 260),
    EQY(NOTE_A, 4, 263),
    EQY(NOTE_D, 5, 175),
    EQY(NOTE_B, 4, 175),
    /* Events 97-112 */
    EQY(NOTE_E, 5, 175),
    EQY(NOTE_D, 5, 1215),
    EQY_R(175),
    EQY(NOTE_G, 4, 175),
    EQY_R(175),
    EQY(NOTE_E, 5, 175),
    EQY(NOTE_D, 5, 175),
    EQY(NOTE_E, 5, 175),
    EQY(NOTE_G, 4, 175),
    EQY(NOTE_D, 5, 390),
    EQY(NOTE_B, 4, 260),
    EQY(NOTE_D, 5, 520),
    EQY(NOTE_B, 4, 260),
    EQY(NOTE_A, 4, 263),
    EQY(NOTE_B, 4, 175),
    EQY(NOTE_D, 5, 175),
    /* Events 113-128 */
    EQY(NOTE_G, 4, 175),
    EQY(NOTE_E, 5, 175),
    EQY(NOTE_A, 4, 175),
    EQY(NOTE_B, 4, 175),
    EQY(NOTE_D, 5, 175),
    EQY_R(160),
    EQY(NOTE_G, 4, 1040),
    EQY(NOTE_D, 5, 520),
    EQY(NOTE_G, 4, 520),
    EQY(NOTE_A, 4, 260),
    EQY(NOTE_B, 4, 1300),
    EQY(NOTE_D, 5, 260),
    EQY(NOTE_E, 5, 175),
    EQY(NOTE_D, 5, 175),
    EQY(NOTE_G, 4, 175),
    EQY(NOTE_E, 5, 175),
    /* Events 129-144 */
    EQY(NOTE_D, 5, 390),
    EQY(NOTE_B, 4, 260),
    EQY(NOTE_D, 5, 520),
    EQY(NOTE_B, 4, 260),
    EQY(NOTE_A, 4, 260),
    EQY(NOTE_E, 5, 260),
    EQY(NOTE_D, 5, 175),
    EQY(NOTE_E, 5, 175),
    EQY(NOTE_G, 4, 175),
    EQY(NOTE_A, 4, 175),
    EQY(NOTE_B, 4, 390),
    EQY(NOTE_A, 4, 260),
    EQY(NOTE_B, 4, 390),
    EQY(NOTE_D, 5, 260),
    EQY(NOTE_E, 5, 260),
    EQY(NOTE_A, 4, 260),
    /* Events 145-160 */
    EQY(NOTE_B, 4, 260),
    EQY(NOTE_D, 5, 175),
    EQY(NOTE_A, 4, 175),
    EQY(NOTE_B, 4, 175),
    EQY(NOTE_D, 5, 175),
    EQY_R(160),
    EQY(NOTE_G, 4, 1300),
    EQY(NOTE_E, 5, 260),
    EQY(NOTE_G, 4, 260),
    EQY(NOTE_B, 4, 520),
    EQY(NOTE_A, 4, 260),
    EQY(NOTE_G, 4, 390),
    EQY(NOTE_E, 5, 260),
    EQY(NOTE_G, 4, 263),
    EQY(NOTE_A, 4, 175),
    EQY(NOTE_B, 4, 350),
    /* Events 161-176 */
    EQY(NOTE_A, 4, 520),
    EQY(NOTE_G, 4, 650),
    EQY(NOTE_E, 5, 175),
    EQY(NOTE_G, 4, 175),
    EQY(NOTE_A, 4, 175),
    EQY(NOTE_B, 4, 175),
    EQY(NOTE_D, 5, 1215),
    EQY_R(175),
    EQY(NOTE_B, 4, 175),
    EQY(NOTE_D, 5, 175),
    EQY(NOTE_E, 5, 175),
    EQY(NOTE_D, 5, 175),
    EQY(NOTE_E, 5, 175),
    EQY(NOTE_G, 4, 175),
    EQY(NOTE_D, 5, 390),
    EQY(NOTE_B, 4, 260),
    /* Events 177-192 */
    EQY(NOTE_D, 5, 520),
    EQY(NOTE_G, 4, 520),
    EQY(NOTE_E, 5, 520),
    EQY(NOTE_D, 5, 175),
    EQY(NOTE_E, 5, 175),
    EQY(NOTE_D, 5, 175),
    EQY(NOTE_A, 4, 175),
    EQY_R(160),
    EQY(NOTE_B, 4, 390),
    EQY(NOTE_D, 5, 260),
    EQY(NOTE_B, 4, 175),
    EQY(NOTE_CS, 5, 175),
    EQY(NOTE_B, 4, 175),
    EQY(NOTE_D, 5, 175),
    EQY(NOTE_A, 4, 263),
    EQY(NOTE_B, 4, 175),
    /* Events 193-208 */
    EQY(NOTE_A, 4, 175),
    EQY(NOTE_G, 4, 175),
    EQY(NOTE_E, 5, 260),
    EQY(NOTE_G, 4, 260),
    EQY(NOTE_E, 5, 260),
    EQY(NOTE_G, 4, 390),
    EQY(NOTE_E, 5, 260),
    EQY(NOTE_G, 4, 390),
    EQY(NOTE_A, 4, 260),
    EQY(NOTE_B, 4, 260),
    EQY(NOTE_D, 5, 260),
    EQY(NOTE_G, 4, 260),
    EQY(NOTE_A, 4, 263),
    EQY(NOTE_D, 5, 175),
    EQY(NOTE_B, 4, 175),
    EQY(NOTE_E, 5, 175),
    /* Events 209-224 */
    EQY(NOTE_D, 5, 390),
    EQY(NOTE_E, 5, 260),
    EQY(NOTE_C, 5, 260),
    EQY(NOTE_D, 5, 260),
    EQY(NOTE_B, 4, 175),
    EQY(NOTE_D, 5, 175),
    EQY(NOTE_E, 5, 175),
    EQY(NOTE_G, 4, 175),
    EQY(NOTE_D, 5, 390),
    EQY(NOTE_E, 5, 260),
    EQY(NOTE_C, 5, 260),
    EQY(NOTE_D, 5, 260),
    EQY(NOTE_B, 4, 438),
    EQY(NOTE_D, 5, 175),
    EQY(NOTE_E, 5, 175),
    EQY_R(160),
    /* Events 225-240 */
    EQY(NOTE_D, 5, 390),
    EQY(NOTE_B, 4, 260),
    EQY(NOTE_D, 5, 520),
    EQY(NOTE_E, 5, 260),
    EQY(NOTE_D, 5, 175),
    EQY(NOTE_B, 4, 350),
    EQY(NOTE_D, 5, 175),
    EQY(NOTE_E, 5, 780),
    EQY(NOTE_G, 4, 520),
    EQY(NOTE_B, 4, 175),
    EQY(NOTE_D, 5, 175),
    EQY(NOTE_E, 5, 175),
    EQY(NOTE_G, 4, 175),
    EQY(NOTE_A, 4, 175),
    EQY(NOTE_D, 5, 175),
    EQY(NOTE_B, 4, 175),
    /* Events 241-256 */
    EQY(NOTE_E, 5, 175),
    EQY(NOTE_D, 5, 390),
    EQY(NOTE_E, 5, 260),
    EQY(NOTE_C, 5, 260),
    EQY(NOTE_D, 5, 260),
    EQY(NOTE_B, 4, 613),
    EQY(NOTE_D, 5, 175),
    EQY(NOTE_A, 4, 260),
    EQY(NOTE_G, 4, 260),
    EQY(NOTE_E, 5, 260),
    EQY(NOTE_G, 4, 1300),
    EQY(NOTE_E, 5, 260),
    EQY(NOTE_D, 5, 175),
    EQY(NOTE_E, 5, 175),
    EQY(NOTE_G, 4, 175),
    EQY(NOTE_A, 4, 175),
    /* Events 257-272 */
    EQY_R(160),
    EQY(NOTE_B, 4, 390),
    EQY(NOTE_A, 4, 260),
    EQY(NOTE_D, 5, 520),
    EQY(NOTE_B, 4, 260),
    EQY(NOTE_E, 5, 260),
    EQY(NOTE_D, 5, 175),
    EQY(NOTE_B, 4, 350),
    EQY(NOTE_D, 5, 175),
    EQY(NOTE_E, 5, 390),
    EQY(NOTE_D, 5, 260),
    EQY(NOTE_G, 4, 520),
    EQY(NOTE_D, 5, 260),
    EQY(NOTE_E, 5, 260),
    EQY(NOTE_D, 5, 260),
    EQY(NOTE_E, 5, 260),
    /* Events 273-288 */
    EQY(NOTE_D, 5, 175),
    EQY(NOTE_E, 5, 175),
    EQY(NOTE_D, 5, 350),
    EQY(NOTE_B, 4, 390),
    EQY(NOTE_D, 5, 260),
    EQY(NOTE_A, 4, 263),
    EQY(NOTE_B, 4, 175),
    EQY(NOTE_D, 5, 175),
    EQY(NOTE_G, 4, 175),
    EQY(NOTE_E, 5, 175),
    EQY(NOTE_A, 4, 175),
    EQY(NOTE_B, 4, 175),
    EQY(NOTE_D, 5, 175),
    EQY(NOTE_G, 4, 1300),
    EQY(NOTE_E, 5, 260),
    EQY(NOTE_G, 4, 260),
    /* Events 289-304 */
    EQY(NOTE_B, 4, 520),
    EQY(NOTE_G, 4, 260),
    EQY_R(160),
    EQY(NOTE_A, 4, 390),
    EQY(NOTE_B, 4, 260),
    EQY(NOTE_A, 4, 260),
    EQY(NOTE_G, 4, 520),
    EQY(NOTE_A, 4, 263),
    EQY(NOTE_G, 4, 175),
    EQY(NOTE_E, 5, 175),
    EQY(NOTE_G, 4, 175),
    EQY(NOTE_D, 5, 1215),
    EQY_R(175),
    EQY(NOTE_D, 5, 175),
    EQY_R(175),
    EQY(NOTE_B, 4, 520),
    /* Events 305-320 */
    EQY(NOTE_D, 5, 260),
    EQY(NOTE_E, 5, 520),
    EQY(NOTE_G, 4, 520),
    EQY(NOTE_B, 4, 175),
    EQY(NOTE_D, 5, 175),
    EQY(NOTE_E, 5, 175),
    EQY(NOTE_G, 4, 175),
    EQY(NOTE_A, 4, 520),
    EQY(NOTE_B, 4, 260),
    EQY(NOTE_D, 5, 390),
    EQY(NOTE_E, 5, 260),
    EQY(NOTE_D, 5, 260),
    EQY(NOTE_E, 5, 260),
    EQY(NOTE_D, 5, 175),
    EQY(NOTE_E, 5, 175),
    EQY(NOTE_D, 5, 175),
    /* Events 321-336 */
    EQY(NOTE_CS, 5, 175),
    EQY_R(160),
    EQY(NOTE_B, 4, 390),
    EQY(NOTE_D, 5, 260),
    EQY(NOTE_B, 4, 175),
    EQY(NOTE_CS, 5, 175),
    EQY(NOTE_B, 4, 175),
    EQY(NOTE_D, 5, 175),
    EQY(NOTE_A, 4, 263),
    EQY(NOTE_B, 4, 175),
    EQY(NOTE_A, 4, 175),
    EQY(NOTE_G, 4, 175),
    EQY(NOTE_E, 5, 260),
    EQY(NOTE_G, 4, 260),
    EQY(NOTE_E, 5, 260),
    EQY(NOTE_G, 4, 390),
    /* Events 337-352 */
    EQY(NOTE_E, 5, 260),
    EQY(NOTE_G, 4, 390),
    EQY(NOTE_A, 4, 260),
    EQY(NOTE_B, 4, 260),
    EQY(NOTE_D, 5, 260),
    EQY(NOTE_G, 4, 260),
    EQY(NOTE_A, 4, 263),
    EQY(NOTE_D, 5, 175),
    EQY(NOTE_B, 4, 175),
    EQY(NOTE_E, 5, 175),
    EQY(NOTE_D, 5, 1215),
    EQY_R(175),
    EQY(NOTE_G, 4, 175),
    EQY_R(175),
    EQY(NOTE_E, 5, 175),
    EQY(NOTE_D, 5, 175),
    /* Events 353-368 */
    EQY(NOTE_E, 5, 175),
    EQY(NOTE_G, 4, 175),
    EQY(NOTE_D, 5, 390),
    EQY(NOTE_B, 4, 260),
    EQY(NOTE_D, 5, 520),
    EQY(NOTE_B, 4, 260),
    EQY(NOTE_A, 4, 263),
    EQY(NOTE_B, 4, 175),
    EQY(NOTE_D, 5, 175),
    EQY(NOTE_G, 4, 175),
    EQY(NOTE_E, 5, 175),
    EQY(NOTE_A, 4, 175),
    EQY(NOTE_B, 4, 175),
    EQY(NOTE_D, 5, 175),
    EQY_R(160),
    EQY(NOTE_G, 4, 1040),
    /* Events 369-384 */
    EQY(NOTE_D, 5, 520),
    EQY(NOTE_G, 4, 520),
    EQY(NOTE_A, 4, 260),
    EQY(NOTE_B, 4, 1300),
    EQY(NOTE_D, 5, 260),
    EQY(NOTE_E, 5, 175),
    EQY(NOTE_D, 5, 175),
    EQY(NOTE_G, 4, 175),
    EQY(NOTE_E, 5, 175),
    EQY(NOTE_D, 5, 390),
    EQY(NOTE_B, 4, 260),
    EQY(NOTE_D, 5, 520),
    EQY(NOTE_B, 4, 260),
    EQY(NOTE_A, 4, 260),
    EQY(NOTE_E, 5, 260),
    EQY(NOTE_D, 5, 175),
    /* Events 385-400 */
    EQY(NOTE_E, 5, 175),
    EQY(NOTE_G, 4, 175),
    EQY(NOTE_A, 4, 175),
    EQY(NOTE_B, 4, 390),
    EQY(NOTE_A, 4, 260),
    EQY(NOTE_B, 4, 390),
    EQY(NOTE_D, 5, 260),
    EQY(NOTE_E, 5, 260),
    EQY(NOTE_A, 4, 260),
    EQY(NOTE_B, 4, 260),
    EQY(NOTE_D, 5, 175),
    EQY(NOTE_A, 4, 175),
    EQY(NOTE_B, 4, 175),
    EQY(NOTE_D, 5, 175),
    EQY_R(160),
    EQY(NOTE_G, 4, 1300),
    /* Events 401-416 */
    EQY(NOTE_E, 5, 260),
    EQY(NOTE_G, 4, 260),
    EQY(NOTE_B, 4, 520),
    EQY(NOTE_A, 4, 260),
    EQY(NOTE_G, 4, 390),
    EQY(NOTE_E, 5, 260),
    EQY(NOTE_G, 4, 263),
    EQY(NOTE_A, 4, 175),
    EQY(NOTE_B, 4, 350),
    EQY(NOTE_A, 4, 520),
    EQY(NOTE_G, 4, 650),
    EQY(NOTE_E, 5, 175),
    EQY(NOTE_G, 4, 175),
    EQY(NOTE_A, 4, 175),
    EQY(NOTE_B, 4, 175),
    EQY(NOTE_D, 5, 1215),
    /* Events 417-432 */
    EQY_R(175),
    EQY(NOTE_B, 4, 175),
    EQY(NOTE_D, 5, 175),
    EQY(NOTE_E, 5, 175),
    EQY(NOTE_D, 5, 175),
    EQY(NOTE_E, 5, 175),
    EQY(NOTE_G, 4, 175),
    EQY(NOTE_D, 5, 390),
    EQY(NOTE_B, 4, 260),
    EQY(NOTE_D, 5, 520),
    EQY(NOTE_G, 4, 520),
    EQY(NOTE_E, 5, 520),
    EQY(NOTE_D, 5, 175),
    EQY(NOTE_E, 5, 175),
    EQY(NOTE_D, 5, 350),
    EQY_R(160),
    /* Events 433-448 */
    EQY(NOTE_B, 4, 390),
    EQY(NOTE_D, 5, 260),
    EQY(NOTE_B, 4, 175),
    EQY(NOTE_CS, 5, 175),
    EQY(NOTE_B, 4, 175),
    EQY(NOTE_D, 5, 175),
    EQY(NOTE_A, 4, 390),
    EQY(NOTE_D, 5, 520),
    EQY(NOTE_G, 4, 260),
    EQY(NOTE_E, 5, 1040),
    EQY(NOTE_G, 4, 520),
    EQY(NOTE_A, 4, 263),
    EQY(NOTE_B, 4, 175),
    EQY(NOTE_D, 5, 175),
    EQY(NOTE_G, 4, 175),
    EQY(NOTE_E, 5, 175),
    /* Events 449-464 */
    EQY(NOTE_D, 5, 175),
    EQY(NOTE_B, 4, 175),
    EQY(NOTE_D, 5, 175),
    EQY(NOTE_G, 4, 390),
    EQY(NOTE_E, 5, 260),
    EQY(NOTE_G, 4, 390),
    EQY(NOTE_A, 4, 260),
    EQY(NOTE_B, 4, 260),
    EQY(NOTE_D, 5, 260),
    EQY(NOTE_G, 4, 260),
    EQY(NOTE_A, 4, 390),
    EQY(NOTE_B, 4, 260),
    EQY_R(260),
    EQY(NOTE_B, 4, 260),
    EQY(NOTE_D, 5, 1040),
    EQY_R(1060)
};

#undef EQY_R
#undef EQY
