/* JJ Lin - Yuan Yu Chou.
 * Reduced to one monophonic note stream for a passive PWM buzzer.
 * Bass notes below C3 are raised one octave to keep them audible. */
const Tone_t YUAN_YU_CHOU[] = {
    /* ~measure 1 */
    {NOTE_B, 5, 221}, {NOTE_C, 6, 221}, {NOTE_B, 5, 221}, 
    {NOTE_G, 5, 221}, {NOTE_E, 5, 221}, {NOTE_G, 5, 221}, 
    {NOTE_B, 5, 221}, {NOTE_C, 6, 221}, {NOTE_FS, 5, 221}, 
    {NOTE_FS, 4, 221}, {NOTE_A, 4, 221}, {NOTE_FS, 4, 221}, 
    {NOTE_FS, 5, 221}, {NOTE_G, 5, 221}, {NOTE_FS, 5, 221}, 
    {NOTE_FS, 4, 221}, {NOTE_D, 5, 221}, {NOTE_E, 5, 221}, 
    {NOTE_B, 4, 221}, {NOTE_D, 5, 221}, {NOTE_B, 4, 221}, 
    {NOTE_G, 4, 221}, {NOTE_B, 4, 221}, {NOTE_G, 4, 221}, 
    {NOTE_E, 4, 221}, {NOTE_G, 4, 221}, {NOTE_B, 4, 221}, 
    {NOTE_G, 4, 221}, {NOTE_B, 4, 221}, {NOTE_G, 4, 221}, 
    {NOTE_B, 4, 221}, {NOTE_G, 4, 221}, {NOTE_B, 5, 221}, 
    {NOTE_C, 6, 221}, {NOTE_B, 5, 221}, {NOTE_G, 5, 221}, 
    {NOTE_E, 5, 221}, {NOTE_G, 5, 221}, {NOTE_B, 5, 221}, 
    {NOTE_C, 6, 221}, {NOTE_FS, 5, 221}, {NOTE_FS, 4, 221}, 
    {NOTE_A, 4, 221}, {NOTE_FS, 4, 221}, {NOTE_FS, 5, 221}, 
    {NOTE_G, 5, 221}, {NOTE_FS, 5, 221}, {NOTE_FS, 4, 221}, 
    {NOTE_D, 5, 221}, {NOTE_E, 5, 221}, {NOTE_D, 5, 221}, 
    {NOTE_E, 5, 221}, {NOTE_B, 4, 221}, {NOTE_G, 4, 221}, 
    {NOTE_B, 4, 221}, {NOTE_G, 4, 221}, {NOTE_E, 4, 221}, 
    {NOTE_G, 4, 221}, {NOTE_B, 4, 221}, {NOTE_D, 5, 221}, 
    {NOTE_D, 5, 221}, {NOTE_B, 4, 221}, {NOTE_A, 4, 221}, 
    {NOTE_G, 4, 221}, {NOTE_A, 4, 221}, {NOTE_B, 4, 221}, 
    {NOTE_E, 4, 221}, {NOTE_G, 4, 221}, {NOTE_C, 4, 221}, 
    {NOTE_G, 3, 221}, {NOTE_C, 4, 221}, {NOTE_G, 3, 221}, 
    {NOTE_D, 3, 221}, {NOTE_FS, 3, 221}, {NOTE_A, 3, 221}, 
    {NOTE_FS, 3, 221}, {NOTE_A, 3, 221}, {NOTE_G, 4, 221}, 
    {NOTE_FS, 4, 221}, {NOTE_D, 4, 221}, {NOTE_D, 4, 221}, 
    {NOTE_E, 4, 221}, {NOTE_B, 3, 221}, {NOTE_G, 4, 221}, 
    {NOTE_B, 3, 221}, {NOTE_G, 3, 221}, {NOTE_B, 3, 221}, 
    {NOTE_G, 3, 221}, {NOTE_E, 3, 221}, {NOTE_G, 3, 221}, 
    {NOTE_B, 3, 221}, {NOTE_G, 3, 221}, {NOTE_D, 5, 221}, 
    {NOTE_B, 4, 221}, {NOTE_A, 4, 221}, {NOTE_G, 4, 221}, 
    {NOTE_A, 4, 221}, {NOTE_B, 4, 221}, {NOTE_E, 4, 221}, 
    {NOTE_G, 4, 221}, {NOTE_C, 4, 221}, {NOTE_G, 3, 221}, 
    {NOTE_C, 4, 221}, {NOTE_G, 3, 221}, {NOTE_D, 3, 221}, 
    {NOTE_FS, 3, 221}, {NOTE_A, 3, 221}, {NOTE_A, 4, 221}, 
    {NOTE_A, 4, 221}, {NOTE_G, 4, 221}, {NOTE_A, 4, 221}, 
    {NOTE_B, 4, 221}, {NOTE_E, 3, 221}, {NOTE_G, 3, 221}, 
    {NOTE_B, 3, 221}, {NOTE_G, 4, 221}, {NOTE_B, 3, 221}, 
    {NOTE_G, 3, 221}, {NOTE_B, 3, 221}, {NOTE_FS, 5, 221}, 
    {NOTE_E, 5, 221}, {NOTE_G, 3, 221}, {NOTE_B, 3, 221}, 
    {NOTE_G, 3, 221}, {NOTE_B, 3, 221}, {NOTE_G, 3, 221}, 
    {NOTE_B, 3, 221}, {NOTE_G, 3, 221},
    /* ~measure 9 */
    {NOTE_B, 4, 221}, {NOTE_C, 5, 221}, {NOTE_B, 4, 221}, 
    {NOTE_G, 4, 221}, {NOTE_E, 4, 221}, {NOTE_G, 4, 221}, 
    {NOTE_B, 4, 221}, {NOTE_C, 5, 221}, {NOTE_FS, 4, 221}, 
    {NOTE_FS, 3, 221}, {NOTE_A, 3, 221}, {NOTE_FS, 3, 221}, 
    {NOTE_A, 3, 221}, {NOTE_G, 4, 221}, {NOTE_FS, 4, 221}, 
    {NOTE_D, 4, 221}, {NOTE_D, 4, 221}, {NOTE_E, 4, 221}, 
    {NOTE_B, 3, 221}, {NOTE_G, 4, 221}, {NOTE_B, 3, 221}, 
    {NOTE_G, 3, 221}, {NOTE_B, 3, 221}, {NOTE_G, 3, 221}, 
    {NOTE_E, 3, 221}, {NOTE_G, 3, 221}, {NOTE_B, 3, 221}, 
    {NOTE_G, 3, 221}, {NOTE_D, 5, 221}, {NOTE_B, 4, 221}, 
    {NOTE_A, 4, 221}, {NOTE_G, 4, 221}, {NOTE_A, 4, 221}, 
    {NOTE_B, 4, 221}, {NOTE_C, 5, 221}, {NOTE_D, 5, 221}, 
    {NOTE_C, 5, 221}, {NOTE_G, 3, 221}, {NOTE_C, 5, 221}, 
    {NOTE_A, 4, 221}, {NOTE_D, 3, 221}, {NOTE_FS, 3, 221}, 
    {NOTE_A, 3, 221}, {NOTE_FS, 3, 221}, {NOTE_B, 4, 221}, 
    {NOTE_FS, 3, 221}, {NOTE_E, 4, 221}, {NOTE_A, 4, 221}, 
    {NOTE_E, 3, 221}, {NOTE_G, 4, 221}, {NOTE_B, 3, 221}, 
    {NOTE_G, 3, 221}, {NOTE_B, 3, 221}, {NOTE_G, 3, 221}, 
    {NOTE_B, 3, 221}, {NOTE_G, 3, 221}, {NOTE_E, 3, 221}, 
    {NOTE_G, 3, 221}, {NOTE_B, 3, 221}, {NOTE_G, 5, 221}, 
    {NOTE_G, 5, 221}, {NOTE_FS, 5, 221}, {NOTE_E, 5, 221}, 
    {NOTE_D, 5, 221}, {NOTE_D, 5, 221}, {NOTE_E, 5, 221}, 
    {NOTE_B, 4, 221}, {NOTE_D, 5, 441}, {NOTE_E, 5, 221}, 
    {NOTE_B, 4, 221}, {NOTE_D, 5, 221}, {NOTE_D, 3, 221}, 
    {NOTE_E, 5, 221}, {NOTE_B, 4, 221}, {NOTE_D, 5, 441}, 
    {NOTE_E, 5, 221}, {NOTE_B, 4, 221}, {NOTE_D, 5, 221}, 
    {NOTE_E, 3, 221}, {NOTE_C, 5, 221}, {NOTE_B, 4, 1985}, 
    {NOTE_G, 5, 221}, {NOTE_G, 5, 221}, {NOTE_FS, 5, 221}, 
    {NOTE_E, 5, 221}, {NOTE_D, 5, 221}, {NOTE_D, 5, 221}, 
    {NOTE_E, 5, 221}, {NOTE_B, 4, 221}, {NOTE_D, 5, 441}, 
    {NOTE_E, 5, 221}, {NOTE_B, 4, 221}, {NOTE_D, 5, 221}, 
    {NOTE_D, 3, 221}, {NOTE_E, 5, 221}, {NOTE_B, 4, 221}, 
    {NOTE_D, 5, 441}, {NOTE_E, 5, 221}, {NOTE_B, 4, 441}, 
    {NOTE_E, 5, 1765}, {NOTE_E, 5, 221}, {NOTE_G, 3, 221}, 
    {NOTE_B, 3, 221}, {NOTE_G, 5, 221}, {NOTE_G, 5, 221}, 
    {NOTE_FS, 5, 221}, {NOTE_E, 5, 221}, {NOTE_D, 5, 221},
    /* ~measure 17 */
    {NOTE_D, 5, 221}, {NOTE_E, 5, 221}, {NOTE_B, 4, 221}, 
    {NOTE_D, 5, 441}, {NOTE_E, 5, 221}, {NOTE_B, 4, 221}, 
    {NOTE_D, 5, 221}, {NOTE_D, 3, 221}, {NOTE_E, 5, 221}, 
    {NOTE_B, 4, 221}, {NOTE_D, 5, 1103}, {NOTE_B, 4, 441}, 
    {NOTE_B, 4, 221}, {NOTE_D, 5, 221}, {NOTE_FS, 3, 441}, 
    {NOTE_B, 4, 221}, {NOTE_A, 4, 221}, {NOTE_E, 3, 441}, 
    {NOTE_G, 4, 221}, {NOTE_FS, 4, 221}, {NOTE_D, 4, 441}, 
    {NOTE_G, 4, 221}, {NOTE_FS, 4, 221}, {NOTE_C, 3, 221}, 
    {NOTE_E, 4, 221}, {NOTE_C, 3, 221}, {NOTE_D, 3, 441}, 
    {NOTE_E, 4, 221}, {NOTE_B, 4, 221}, {NOTE_A, 4, 221}, 
    {NOTE_D, 3, 441}, {NOTE_G, 4, 221}, {NOTE_FS, 4, 441}, 
    {NOTE_B, 3, 221}, {NOTE_D, 4, 221}, {NOTE_G, 3, 221}, 
    {NOTE_E, 4, 1324}, {NOTE_B, 4, 221}, {NOTE_A, 4, 662}, 
    {NOTE_G, 4, 221}, {NOTE_FS, 4, 662}, {NOTE_G, 4, 221}, 
    {NOTE_FS, 4, 221}, {NOTE_E, 4, 1985}, {NOTE_E, 4, 221}, 
    {NOTE_B, 4, 221}, {NOTE_A, 4, 221}, {NOTE_D, 3, 441}, 
    {NOTE_G, 4, 221}, {NOTE_FS, 4, 221}, {NOTE_E, 4, 882}, 
    {NOTE_D, 4, 441}, {NOTE_E, 4, 882}, {NOTE_FS, 3, 221}, 
    {NOTE_G, 3, 221}, {NOTE_D, 4, 882}, {NOTE_B, 5, 221}, 
    {NOTE_C, 6, 221}, {NOTE_B, 5, 221}, {NOTE_G, 5, 221}, 
    {NOTE_E, 5, 221}, {NOTE_G, 5, 221}, {NOTE_B, 5, 221}, 
    {NOTE_C, 6, 221}, {NOTE_FS, 5, 221}, {NOTE_FS, 4, 221}, 
    {NOTE_A, 4, 221}, {NOTE_FS, 4, 221}, {NOTE_FS, 5, 221}, 
    {NOTE_G, 5, 221}, {NOTE_FS, 5, 221}, {NOTE_FS, 4, 221}, 
    {NOTE_D, 5, 221}, {NOTE_E, 5, 221}, {NOTE_B, 4, 221}, 
    {NOTE_D, 5, 221}, {NOTE_B, 4, 221}, {NOTE_G, 4, 221}, 
    {NOTE_B, 4, 221}, {NOTE_G, 4, 221}, {NOTE_E, 4, 221}, 
    {NOTE_G, 4, 221}, {NOTE_B, 4, 221}, {NOTE_G, 4, 221}, 
    {NOTE_B, 4, 221}, {NOTE_G, 4, 221}, {NOTE_B, 4, 221}, 
    {NOTE_G, 4, 221},
    /* ~measure 25 */
    {NOTE_B, 5, 221}, {NOTE_C, 6, 221}, {NOTE_B, 5, 221}, 
    {NOTE_G, 5, 221}, {NOTE_E, 5, 221}, {NOTE_G, 5, 221}, 
    {NOTE_B, 5, 221}, {NOTE_C, 6, 221}, {NOTE_FS, 5, 221}, 
    {NOTE_FS, 4, 221}, {NOTE_A, 4, 221}, {NOTE_FS, 4, 221}, 
    {NOTE_FS, 5, 221}, {NOTE_G, 5, 221}, {NOTE_FS, 5, 221}, 
    {NOTE_FS, 4, 221}, {NOTE_D, 5, 221}, {NOTE_E, 5, 221}, 
    {NOTE_D, 5, 221}, {NOTE_E, 5, 221}, {NOTE_B, 4, 221}, 
    {NOTE_G, 4, 221}, {NOTE_B, 4, 221}, {NOTE_G, 4, 221}, 
    {NOTE_E, 4, 221}, {NOTE_G, 4, 221}, {NOTE_B, 4, 221}, 
    {NOTE_D, 5, 221}, {NOTE_D, 5, 221}, {NOTE_B, 4, 221}, 
    {NOTE_A, 4, 221}, {NOTE_G, 4, 221}, {NOTE_A, 4, 221}, 
    {NOTE_B, 4, 221}, {NOTE_E, 4, 221}, {NOTE_G, 4, 441}, 
    {NOTE_G, 3, 221}, {NOTE_D, 3, 221}, {NOTE_E, 3, 221}, 
    {NOTE_D, 3, 221}, {NOTE_A, 3, 221}, {NOTE_G, 4, 221}, 
    {NOTE_FS, 4, 221}, {NOTE_G, 4, 221}, {NOTE_D, 3, 221}, 
    {NOTE_A, 4, 221}, {NOTE_FS, 4, 221}, {NOTE_E, 3, 221}, 
    {NOTE_E, 4, 221}, {NOTE_E, 3, 221}, {NOTE_E, 3, 441}, 
    {NOTE_B, 3, 221}, {NOTE_E, 3, 221}, {NOTE_B, 3, 221}, 
    {NOTE_E, 3, 221}, {NOTE_B, 3, 221}, {NOTE_E, 3, 221}, 
    {NOTE_D, 5, 221}, {NOTE_D, 5, 221}, {NOTE_B, 4, 221}, 
    {NOTE_A, 4, 221}, {NOTE_G, 4, 221}, {NOTE_A, 4, 221}, 
    {NOTE_B, 4, 221}, {NOTE_E, 4, 221}, {NOTE_G, 4, 441}, 
    {NOTE_G, 3, 221}, {NOTE_D, 3, 221}, {NOTE_A, 4, 221}, 
    {NOTE_D, 3, 221}, {NOTE_A, 3, 221}, {NOTE_A, 4, 221}, 
    {NOTE_A, 4, 221}, {NOTE_A, 4, 221}, {NOTE_G, 4, 221}, 
    {NOTE_A, 4, 221}, {NOTE_C, 5, 221}, {NOTE_E, 3, 221}, 
    {NOTE_B, 4, 221}, {NOTE_E, 3, 221}, {NOTE_E, 3, 441}, 
    {NOTE_B, 3, 221}, {NOTE_E, 3, 221}, {NOTE_B, 3, 221}, 
    {NOTE_E, 3, 221}, {NOTE_B, 3, 221}, {NOTE_E, 3, 221}, 
    {NOTE_E, 3, 441}, {NOTE_G, 3, 221}, {NOTE_E, 3, 221}, 
    {NOTE_E, 3, 221}, {NOTE_B, 4, 221}, {NOTE_C, 5, 221}, 
    {NOTE_B, 4, 221}, {NOTE_G, 4, 221}, {NOTE_E, 4, 221}, 
    {NOTE_G, 4, 221}, {NOTE_B, 4, 221}, {NOTE_C, 5, 221}, 
    {NOTE_FS, 4, 221}, {NOTE_A, 3, 221}, {NOTE_D, 3, 221}, 
    {NOTE_D, 3, 441}, {NOTE_G, 4, 221}, {NOTE_FS, 4, 221}, 
    {NOTE_D, 4, 221}, {NOTE_D, 4, 221}, {NOTE_E, 4, 221}, 
    {NOTE_G, 4, 221}, {NOTE_E, 3, 441}, {NOTE_B, 3, 221}, 
    {NOTE_E, 3, 221}, {NOTE_B, 3, 221}, {NOTE_B, 4, 221}, 
    {NOTE_B, 3, 221}, {NOTE_E, 3, 221}, {NOTE_E, 3, 441}, 
    {NOTE_G, 3, 221}, {NOTE_E, 3, 221}, {NOTE_E, 3, 221},
    /* ~measure 33 */
    {NOTE_B, 4, 221}, {NOTE_C, 5, 221}, {NOTE_B, 4, 221}, 
    {NOTE_G, 4, 221}, {NOTE_E, 4, 221}, {NOTE_G, 4, 221}, 
    {NOTE_B, 4, 221}, {NOTE_C, 5, 221}, {NOTE_FS, 4, 221}, 
    {NOTE_A, 3, 221}, {NOTE_D, 3, 221}, {NOTE_D, 3, 441}, 
    {NOTE_D, 3, 221}, {NOTE_A, 3, 221}, {NOTE_D, 3, 221}, 
    {NOTE_B, 4, 221}, {NOTE_B, 3, 221}, {NOTE_D, 5, 221}, 
    {NOTE_E, 5, 441}, {NOTE_B, 3, 221}, {NOTE_E, 3, 221}, 
    {NOTE_B, 3, 221}, {NOTE_E, 3, 882}, {NOTE_G, 5, 221}, 
    {NOTE_FS, 5, 221}, {NOTE_E, 5, 221}, {NOTE_D, 5, 221}, 
    {NOTE_D, 5, 221}, {NOTE_E, 5, 221}, {NOTE_B, 4, 221}, 
    {NOTE_D, 5, 221}, {NOTE_E, 3, 221}, {NOTE_E, 5, 221}, 
    {NOTE_B, 4, 221}, {NOTE_D, 5, 221}, {NOTE_D, 3, 221}, 
    {NOTE_E, 5, 221}, {NOTE_B, 4, 221}, {NOTE_D, 5, 221}, 
    {NOTE_FS, 3, 221}, {NOTE_E, 5, 221}, {NOTE_B, 4, 221}, 
    {NOTE_D, 5, 221}, {NOTE_E, 3, 221}, {NOTE_C, 5, 221}, 
    {NOTE_B, 4, 441}, {NOTE_G, 3, 441}, {NOTE_B, 3, 441}, 
    {NOTE_FS, 3, 441}, {NOTE_B, 3, 221}, {NOTE_G, 5, 221}, 
    {NOTE_G, 5, 221}, {NOTE_FS, 5, 221}, {NOTE_E, 5, 221}, 
    {NOTE_D, 5, 221}, {NOTE_D, 5, 221}, {NOTE_E, 5, 221}, 
    {NOTE_B, 4, 221}, {NOTE_D, 5, 221}, {NOTE_E, 3, 221}, 
    {NOTE_E, 5, 221}, {NOTE_B, 4, 221}, {NOTE_D, 5, 221}, 
    {NOTE_D, 3, 221}, {NOTE_E, 5, 221}, {NOTE_B, 4, 221}, 
    {NOTE_D, 5, 221}, {NOTE_FS, 3, 221}, {NOTE_E, 5, 221}, 
    {NOTE_A, 3, 441}, {NOTE_B, 4, 441}, {NOTE_E, 5, 441}, 
    {NOTE_G, 3, 441}, {NOTE_B, 3, 441}, {NOTE_FS, 3, 662}, 
    {NOTE_G, 5, 221}, {NOTE_G, 5, 221}, {NOTE_FS, 5, 221}, 
    {NOTE_E, 5, 221}, {NOTE_D, 5, 221}, {NOTE_D, 5, 221}, 
    {NOTE_E, 5, 221}, {NOTE_B, 4, 221}, {NOTE_D, 5, 221}, 
    {NOTE_E, 3, 221}, {NOTE_E, 5, 221}, {NOTE_B, 4, 221}, 
    {NOTE_D, 5, 221}, {NOTE_D, 3, 221}, {NOTE_E, 5, 221}, 
    {NOTE_B, 4, 221}, {NOTE_D, 5, 221}, {NOTE_FS, 3, 441}, 
    {NOTE_D, 3, 221}, {NOTE_D, 3, 221}, {NOTE_D, 5, 441}, 
    {NOTE_B, 4, 221}, {NOTE_D, 5, 221}, {NOTE_FS, 3, 441}, 
    {NOTE_FS, 5, 221}, {NOTE_G, 5, 221}, {NOTE_E, 3, 441}, 
    {NOTE_D, 5, 221}, {NOTE_C, 5, 441}, {NOTE_B, 4, 441}, 
    {NOTE_A, 4, 221},
    /* ~measure 41 */
    {NOTE_C, 3, 221}, {NOTE_G, 4, 221}, {NOTE_G, 3, 441}, 
    {NOTE_E, 3, 221}, {NOTE_E, 4, 221}, {NOTE_B, 4, 221}, 
    {NOTE_A, 4, 221}, {NOTE_A, 4, 441}, {NOTE_G, 4, 221}, 
    {NOTE_FS, 4, 221}, {NOTE_FS, 3, 221}, {NOTE_A, 3, 221}, 
    {NOTE_D, 4, 221}, {NOTE_E, 4, 221}, {NOTE_E, 3, 441}, 
    {NOTE_B, 3, 221}, {NOTE_E, 3, 221}, {NOTE_G, 3, 441}, 
    {NOTE_B, 4, 221}, {NOTE_A, 4, 221}, {NOTE_B, 3, 441}, 
    {NOTE_G, 4, 221}, {NOTE_FS, 4, 221}, {NOTE_FS, 3, 221}, 
    {NOTE_B, 3, 221}, {NOTE_G, 4, 221}, {NOTE_FS, 4, 221}, 
    {NOTE_E, 4, 662}, {NOTE_G, 3, 221}, {NOTE_E, 3, 221}, 
    {NOTE_E, 4, 221}, {NOTE_B, 4, 221}, {NOTE_A, 4, 221}, 
    {NOTE_A, 4, 441}, {NOTE_G, 4, 221}, {NOTE_FS, 4, 221}, 
    {NOTE_FS, 3, 221}, {NOTE_A, 3, 221}, {NOTE_D, 4, 221}, 
    {NOTE_E, 4, 221}, {NOTE_E, 3, 441}, {NOTE_B, 3, 441}, 
    {NOTE_G, 3, 221}, {NOTE_FS, 3, 221}, {NOTE_E, 3, 221}, 
    {NOTE_E, 3, 1103}, {NOTE_G, 5, 221}, {NOTE_FS, 5, 221}, 
    {NOTE_E, 5, 221}, {NOTE_D, 5, 221}, {NOTE_D, 5, 221}, 
    {NOTE_E, 5, 221}, {NOTE_B, 4, 221}, {NOTE_D, 5, 441}, 
    {NOTE_E, 5, 221}, {NOTE_B, 4, 221}, {NOTE_D, 5, 221}, 
    {NOTE_A, 4, 221}, {NOTE_E, 5, 221}, {NOTE_B, 4, 221}, 
    {NOTE_D, 5, 441}, {NOTE_E, 5, 221}, {NOTE_B, 4, 221}, 
    {NOTE_D, 5, 221}, {NOTE_G, 4, 221}, {NOTE_C, 5, 221}, 
    {NOTE_B, 4, 2206}, {NOTE_G, 5, 221}, {NOTE_FS, 5, 221}, 
    {NOTE_E, 5, 221}, {NOTE_D, 5, 221}, {NOTE_D, 5, 221}, 
    {NOTE_E, 5, 221}, {NOTE_B, 4, 221}, {NOTE_D, 5, 441}, 
    {NOTE_E, 5, 221}, {NOTE_B, 4, 221}, {NOTE_D, 5, 221}, 
    {NOTE_A, 4, 221}, {NOTE_E, 5, 221}, {NOTE_B, 4, 221}, 
    {NOTE_D, 5, 441}, {NOTE_E, 5, 221}, {NOTE_B, 4, 221}, 
    {NOTE_E, 5, 221}, {NOTE_G, 4, 441}, {NOTE_B, 3, 441}, 
    {NOTE_D, 4, 441}, {NOTE_G, 3, 441}, {NOTE_B, 3, 441}, 
    {NOTE_E, 3, 441}, {NOTE_G, 5, 221}, {NOTE_FS, 5, 221}, 
    {NOTE_E, 5, 221}, {NOTE_D, 5, 221},
    /* ~measure 49 */
    {NOTE_D, 5, 221}, {NOTE_E, 5, 221}, {NOTE_B, 4, 221}, 
    {NOTE_D, 5, 221}, {NOTE_E, 3, 221}, {NOTE_E, 5, 221}, 
    {NOTE_B, 4, 221}, {NOTE_D, 5, 221}, {NOTE_D, 3, 221}, 
    {NOTE_C, 5, 221}, {NOTE_B, 4, 221}, {NOTE_A, 3, 221}, 
    {NOTE_FS, 3, 221}, {NOTE_A, 3, 221}, {NOTE_D, 3, 221}, 
    {NOTE_D, 3, 221}, {NOTE_B, 4, 221}, {NOTE_D, 3, 221}, 
    {NOTE_B, 4, 221}, {NOTE_D, 5, 221}, {NOTE_FS, 3, 221}, 
    {NOTE_D, 3, 221}, {NOTE_FS, 5, 221}, {NOTE_G, 5, 221}, 
    {NOTE_G, 5, 221}, {NOTE_B, 3, 221}, {NOTE_A, 5, 221}, 
    {NOTE_B, 5, 221}, {NOTE_B, 5, 221}, {NOTE_B, 3, 221}, 
    {NOTE_G, 5, 221}, {NOTE_G, 5, 221}, {NOTE_E, 5, 221}, 
    {NOTE_G, 3, 221}, {NOTE_D, 3, 221}, {NOTE_G, 3, 221}, 
    {NOTE_E, 3, 221}, {NOTE_E, 5, 221}, {NOTE_B, 5, 221}, 
    {NOTE_A, 5, 221}, {NOTE_A, 5, 221}, {NOTE_A, 3, 221}, 
    {NOTE_G, 5, 221}, {NOTE_FS, 5, 221}, {NOTE_FS, 3, 221}, 
    {NOTE_A, 3, 221}, {NOTE_D, 5, 221}, {NOTE_E, 5, 221}, 
    {NOTE_E, 5, 221}, {NOTE_B, 3, 221}, {NOTE_FS, 3, 221}, 
    {NOTE_B, 3, 221}, {NOTE_G, 3, 221}, {NOTE_B, 3, 221}, 
    {NOTE_B, 5, 221}, {NOTE_A, 5, 221}, {NOTE_B, 3, 221}, 
    {NOTE_FS, 3, 221}, {NOTE_G, 5, 221}, {NOTE_FS, 5, 221}, 
    {NOTE_FS, 3, 221}, {NOTE_D, 3, 221}, {NOTE_G, 5, 221}, 
    {NOTE_FS, 5, 221}, {NOTE_E, 5, 221}, {NOTE_G, 3, 221}, 
    {NOTE_D, 3, 221}, {NOTE_G, 3, 221}, {NOTE_E, 3, 221}, 
    {NOTE_E, 5, 221}, {NOTE_B, 5, 221}, {NOTE_A, 5, 221}, 
    {NOTE_A, 5, 221}, {NOTE_A, 3, 221}, {NOTE_G, 5, 221}, 
    {NOTE_FS, 5, 221}, {NOTE_FS, 3, 221}, {NOTE_A, 3, 221}, 
    {NOTE_D, 5, 221}, {NOTE_E, 5, 221}, {NOTE_E, 5, 221}, 
    {NOTE_B, 3, 221}, {NOTE_FS, 3, 221}, {NOTE_B, 3, 221}, 
    {NOTE_G, 3, 221}, {NOTE_B, 3, 221}, {NOTE_E, 3, 221}, 
    {NOTE_B, 3, 221}, {NOTE_E, 3, 221}, {NOTE_B, 3, 221}, 
    {NOTE_E, 3, 221}, {NOTE_B, 3, 221}, {NOTE_G, 5, 221}, 
    {NOTE_FS, 5, 221}, {NOTE_E, 5, 221}, {NOTE_D, 5, 221}, 
    {NOTE_D, 5, 221}, {NOTE_E, 5, 221}, {NOTE_B, 4, 221}, 
    {NOTE_D, 5, 221}, {NOTE_E, 3, 221}, {NOTE_E, 5, 221}, 
    {NOTE_B, 4, 221}, {NOTE_D, 5, 221}, {NOTE_D, 3, 221}, 
    {NOTE_E, 5, 221}, {NOTE_B, 4, 221}, {NOTE_D, 5, 221}, 
    {NOTE_C, 5, 221}, {NOTE_B, 4, 221}, {NOTE_FS, 3, 221}, 
    {NOTE_D, 3, 221}, {NOTE_B, 4, 221}, {NOTE_D, 3, 221}, 
    {NOTE_B, 4, 221}, {NOTE_D, 5, 221}, {NOTE_FS, 3, 221}, 
    {NOTE_D, 3, 221}, {NOTE_FS, 5, 221}, {NOTE_G, 5, 221}, 
    {NOTE_G, 5, 221}, {NOTE_B, 3, 221}, {NOTE_A, 5, 221}, 
    {NOTE_B, 5, 221}, {NOTE_B, 5, 221}, {NOTE_B, 3, 221}, 
    {NOTE_G, 5, 221}, {NOTE_G, 5, 221},
    /* ~measure 57 */
    {NOTE_G, 5, 221}, {NOTE_E, 3, 221}, {NOTE_A, 3, 221}, 
    {NOTE_B, 3, 221}, {NOTE_C, 3, 221}, {NOTE_E, 5, 221}, 
    {NOTE_B, 5, 221}, {NOTE_A, 5, 221}, {NOTE_A, 5, 221}, 
    {NOTE_FS, 3, 221}, {NOTE_G, 5, 221}, {NOTE_FS, 5, 221}, 
    {NOTE_FS, 3, 221}, {NOTE_D, 3, 221}, {NOTE_D, 5, 221}, 
    {NOTE_E, 5, 221}, {NOTE_E, 5, 221}, {NOTE_B, 3, 221}, 
    {NOTE_E, 3, 221}, {NOTE_FS, 3, 221}, {NOTE_G, 3, 221}, 
    {NOTE_FS, 3, 221}, {NOTE_B, 4, 221}, {NOTE_D, 5, 221}, 
    {NOTE_D, 5, 221}, {NOTE_FS, 3, 221}, {NOTE_B, 4, 221}, 
    {NOTE_D, 5, 221}, {NOTE_FS, 3, 221}, {NOTE_D, 3, 221}, 
    {NOTE_E, 5, 221}, {NOTE_E, 5, 221}, {NOTE_D, 5, 221}, 
    {NOTE_C, 5, 221}, {NOTE_D, 3, 221}, {NOTE_G, 3, 221}, 
    {NOTE_E, 3, 221}, {NOTE_E, 4, 221}, {NOTE_B, 4, 221}, 
    {NOTE_A, 4, 221}, {NOTE_A, 4, 221}, {NOTE_A, 3, 221}, 
    {NOTE_G, 4, 221}, {NOTE_FS, 4, 221}, {NOTE_FS, 3, 221}, 
    {NOTE_A, 3, 221}, {NOTE_D, 3, 221}, {NOTE_A, 3, 221}, 
    {NOTE_D, 3, 2647}, {NOTE_G, 4, 441}, {NOTE_G, 4, 441}, 
    {NOTE_B, 5, 221}, {NOTE_C, 6, 221}, {NOTE_B, 5, 221}, 
    {NOTE_G, 5, 221}, {NOTE_E, 5, 221}, {NOTE_G, 5, 221}, 
    {NOTE_B, 5, 221}, {NOTE_C, 6, 221}, {NOTE_FS, 5, 221}, 
    {NOTE_FS, 4, 221}, {NOTE_A, 4, 221}, {NOTE_FS, 4, 221}, 
    {NOTE_FS, 5, 221}, {NOTE_G, 5, 221}, {NOTE_FS, 5, 221}, 
    {NOTE_D, 5, 221}, {NOTE_D, 5, 221}, {NOTE_E, 5, 221}, 
    {NOTE_B, 4, 221}, {NOTE_E, 5, 221}, {NOTE_B, 4, 221}, 
    {NOTE_G, 4, 221}, {NOTE_B, 4, 221}, {NOTE_G, 4, 221}, 
    {NOTE_D, 5, 221}, {NOTE_B, 4, 221}, {NOTE_E, 5, 221}, 
    {NOTE_B, 3, 221}, {NOTE_D, 5, 221}, {NOTE_B, 3, 221}, 
    {NOTE_A, 4, 221}, {NOTE_B, 3, 221}, {NOTE_B, 4, 221}, 
    {NOTE_C, 5, 221}, {NOTE_B, 4, 221}, {NOTE_G, 4, 221}, 
    {NOTE_E, 4, 221}, {NOTE_G, 4, 221}, {NOTE_B, 4, 221}, 
    {NOTE_G, 4, 221}, {NOTE_FS, 4, 221}, {NOTE_FS, 3, 221}, 
    {NOTE_A, 3, 221}, {NOTE_FS, 3, 221}, {NOTE_A, 3, 221}, 
    {NOTE_G, 4, 221}, {NOTE_FS, 4, 221}, {NOTE_D, 4, 221}, 
    {NOTE_G, 4, 221}, {NOTE_FS, 4, 221}, {NOTE_D, 4, 221}, 
    {NOTE_G, 4, 221}, {NOTE_FS, 4, 221}, {NOTE_D, 4, 221}, 
    {NOTE_D, 5, 221}, {NOTE_C, 5, 221}, {NOTE_G, 5, 221}, 
    {NOTE_FS, 5, 221}, {NOTE_D, 5, 221}, {NOTE_G, 4, 221}, 
    {NOTE_FS, 4, 221}, {NOTE_D, 4, 221}, {NOTE_G, 3, 221}, 
    {NOTE_FS, 3, 221},
    /* ~measure 65 */
    {NOTE_D, 4, 3529}, {NOTE_B, 3, 3529}
};

/* 890 buzzer events, about 233 seconds at Poco moto. */
