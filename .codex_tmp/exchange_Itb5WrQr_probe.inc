/*
 * JJ Lin - Exchange Lifetime.
 * Complete single-line PWM buzzer reduction generated from probe.
 * Simultaneous right-hand, left-hand, and chord tones are
 * arpeggiated into one buzzer line with the upper voice first;
 * notes outside the practical buzzer range are folded by octaves.
 * 896 buzzer events, about 255 seconds.
 */
#define EXL(note, octave, ms) {note, octave, (uint16_t)(ms)}
#define EXL_R(ms) {NOTE_REST, 0, (uint16_t)(ms)}

const Tone_t EXCHANGE_LIFETIME[] = {
    /* Events 1-16 */
    EXL(NOTE_A, 4, 221),
    EXL(NOTE_D, 3, 220),
    EXL(NOTE_A, 3, 441),
    EXL(NOTE_G, 5, 221),
    EXL(NOTE_D, 4, 220),
    EXL(NOTE_A, 3, 441),
    EXL(NOTE_A, 5, 221),
    EXL(NOTE_FS, 4, 220),
    EXL(NOTE_A, 3, 441),
    EXL(NOTE_D, 6, 221),
    EXL(NOTE_D, 4, 220),
    EXL(NOTE_A, 3, 441),
    EXL(NOTE_C, 6, 221),
    EXL(NOTE_A, 3, 220),
    EXL(NOTE_E, 3, 441),
    EXL(NOTE_A, 3, 441),
    /* Events 17-32 */
    EXL(NOTE_E, 3, 441),
    EXL(NOTE_B, 5, 221),
    EXL(NOTE_C, 4, 220),
    EXL(NOTE_E, 3, 441),
    EXL(NOTE_A, 3, 441),
    EXL(NOTE_E, 3, 441),
    EXL(NOTE_E, 5, 221),
    EXL(NOTE_C, 3, 220),
    EXL(NOTE_G, 3, 441),
    EXL(NOTE_FS, 5, 221),
    EXL(NOTE_C, 4, 220),
    EXL(NOTE_G, 3, 441),
    EXL(NOTE_G, 5, 221),
    EXL(NOTE_E, 4, 220),
    EXL(NOTE_G, 3, 441),
    EXL(NOTE_C, 4, 441),
    /* Events 33-48 */
    EXL(NOTE_A, 5, 221),
    EXL(NOTE_G, 3, 220),
    EXL(NOTE_D, 5, 221),
    EXL(NOTE_G, 3, 220),
    EXL(NOTE_D, 3, 441),
    EXL(NOTE_G, 3, 441),
    EXL(NOTE_D, 3, 441),
    EXL(NOTE_B, 3, 441),
    EXL(NOTE_D, 3, 441),
    EXL(NOTE_G, 3, 441),
    EXL(NOTE_D, 3, 441),
    EXL(NOTE_FS, 5, 221),
    EXL(NOTE_D, 3, 220),
    EXL(NOTE_A, 3, 441),
    EXL(NOTE_G, 5, 221),
    EXL(NOTE_D, 3, 220),
    /* Events 49-64 */
    EXL(NOTE_FS, 3, 441),
    EXL(NOTE_A, 5, 221),
    EXL(NOTE_A, 3, 220),
    EXL(NOTE_D, 4, 441),
    EXL(NOTE_D, 6, 441),
    EXL(NOTE_FS, 4, 441),
    EXL(NOTE_C, 6, 221),
    EXL(NOTE_A, 3, 220),
    EXL(NOTE_E, 3, 441),
    EXL(NOTE_A, 3, 441),
    EXL(NOTE_C, 4, 441),
    EXL(NOTE_B, 5, 221),
    EXL(NOTE_E, 4, 220),
    EXL(NOTE_C, 4, 441),
    EXL(NOTE_A, 3, 441),
    EXL(NOTE_E, 3, 441),
    /* Events 65-80 */
    EXL(NOTE_G, 5, 221),
    EXL(NOTE_C, 3, 220),
    EXL(NOTE_G, 3, 441),
    EXL(NOTE_C, 4, 441),
    EXL(NOTE_G, 3, 441),
    EXL(NOTE_E, 4, 441),
    EXL(NOTE_G, 3, 441),
    EXL(NOTE_FS, 5, 221),
    EXL(NOTE_C, 4, 220),
    EXL(NOTE_G, 5, 441),
    EXL(NOTE_A, 5, 221),
    EXL(NOTE_A, 3, 220),
    EXL(NOTE_E, 3, 441),
    EXL(NOTE_A, 3, 441),
    EXL(NOTE_CS, 4, 441),
    EXL(NOTE_E, 4, 1765),
    /* Events 81-96 */
    EXL(NOTE_FS, 4, 221),
    EXL(NOTE_D, 3, 220),
    EXL(NOTE_FS, 4, 221),
    EXL(NOTE_A, 3, 220),
    EXL(NOTE_FS, 4, 111),
    EXL(NOTE_D, 4, 110),
    EXL(NOTE_G, 4, 221),
    EXL(NOTE_A, 4, 221),
    EXL(NOTE_B, 4, 221),
    EXL(NOTE_G, 3, 441),
    EXL(NOTE_E, 4, 221),
    EXL(NOTE_D, 3, 220),
    EXL(NOTE_E, 4, 111),
    EXL(NOTE_G, 3, 110),
    EXL(NOTE_FS, 4, 221),
    EXL(NOTE_G, 4, 221),
    /* Events 97-112 */
    EXL(NOTE_A, 4, 221),
    EXL(NOTE_CS, 3, 441),
    EXL(NOTE_E, 4, 221),
    EXL(NOTE_A, 3, 220),
    EXL(NOTE_E, 4, 111),
    EXL(NOTE_CS, 4, 110),
    EXL(NOTE_FS, 4, 221),
    EXL(NOTE_G, 4, 221),
    EXL(NOTE_FS, 4, 662),
    EXL(NOTE_CS, 3, 441),
    EXL(NOTE_FS, 3, 882),
    EXL(NOTE_D, 4, 221),
    EXL(NOTE_B, 3, 220),
    EXL(NOTE_D, 4, 221),
    EXL(NOTE_FS, 3, 220),
    EXL(NOTE_D, 4, 111),
    /* Events 113-128 */
    EXL(NOTE_B, 3, 110),
    EXL(NOTE_E, 4, 221),
    EXL(NOTE_FS, 4, 442),
    EXL(NOTE_E, 3, 441),
    EXL(NOTE_B, 3, 552),
    EXL(NOTE_GS, 3, 110),
    EXL(NOTE_CS, 4, 221),
    EXL(NOTE_D, 4, 221),
    EXL(NOTE_E, 4, 662),
    EXL(NOTE_B, 3, 441),
    EXL(NOTE_E, 3, 441),
    EXL(NOTE_B, 3, 441),
    EXL(NOTE_A, 3, 441),
    EXL(NOTE_E, 3, 441),
    EXL(NOTE_A, 3, 441),
    EXL(NOTE_E, 3, 441),
    /* Events 129-144 */
    EXL(NOTE_CS, 5, 221),
    EXL(NOTE_FS, 3, 220),
    EXL(NOTE_CS, 5, 221),
    EXL(NOTE_CS, 3, 220),
    EXL(NOTE_CS, 5, 111),
    EXL(NOTE_A, 3, 110),
    EXL(NOTE_B, 4, 221),
    EXL(NOTE_A, 4, 221),
    EXL(NOTE_D, 5, 662),
    EXL(NOTE_FS, 3, 441),
    EXL(NOTE_B, 3, 882),
    EXL(NOTE_CS, 5, 221),
    EXL(NOTE_FS, 3, 220),
    EXL(NOTE_CS, 3, 221),
    EXL(NOTE_CS, 5, 332),
    EXL(NOTE_A, 3, 110),
    /* Events 145-160 */
    EXL(NOTE_D, 5, 221),
    EXL(NOTE_E, 5, 441),
    EXL(NOTE_D, 5, 221),
    EXL(NOTE_B, 3, 220),
    EXL(NOTE_FS, 3, 441),
    EXL(NOTE_FS, 5, 221),
    EXL(NOTE_B, 3, 220),
    EXL(NOTE_D, 5, 441),
    EXL(NOTE_B, 4, 221),
    EXL(NOTE_E, 3, 220),
    EXL(NOTE_B, 3, 221),
    EXL(NOTE_B, 4, 368),
    EXL(NOTE_E, 3, 147),
    EXL(NOTE_CS, 5, 147),
    EXL(NOTE_G, 3, 147),
    EXL(NOTE_D, 5, 515),
    /* Events 161-176 */
    EXL(NOTE_FS, 3, 220),
    EXL(NOTE_A, 4, 221),
    EXL(NOTE_D, 3, 220),
    EXL(NOTE_A, 4, 147),
    EXL(NOTE_FS, 3, 147),
    EXL(NOTE_G, 4, 147),
    EXL(NOTE_A, 3, 147),
    EXL(NOTE_FS, 4, 515),
    EXL(NOTE_G, 3, 220),
    EXL(NOTE_D, 3, 441),
    EXL(NOTE_G, 4, 221),
    EXL(NOTE_AS, 3, 220),
    EXL(NOTE_D, 3, 441),
    EXL(NOTE_D, 5, 441),
    EXL(NOTE_AS, 3, 441),
    EXL(NOTE_D, 3, 441),
    /* Events 177-192 */
    EXL(NOTE_E, 5, 662),
    EXL(NOTE_A, 3, 220),
    EXL(NOTE_E, 3, 441),
    EXL(NOTE_A, 3, 441),
    EXL(NOTE_E, 3, 441),
    EXL(NOTE_CS, 4, 882),
    EXL(NOTE_FS, 5, 221),
    EXL(NOTE_G, 5, 221),
    EXL(NOTE_FS, 5, 221),
    EXL(NOTE_E, 5, 221),
    EXL(NOTE_FS, 5, 221),
    EXL(NOTE_G, 3, 220),
    EXL(NOTE_D, 3, 441),
    EXL(NOTE_B, 4, 441),
    EXL(NOTE_G, 3, 441),
    EXL(NOTE_E, 5, 221),
    /* Events 193-208 */
    EXL(NOTE_A, 3, 220),
    EXL(NOTE_E, 3, 441),
    EXL(NOTE_A, 4, 441),
    EXL(NOTE_A, 3, 441),
    EXL(NOTE_E, 5, 221),
    EXL(NOTE_FS, 3, 220),
    EXL(NOTE_CS, 3, 441),
    EXL(NOTE_A, 4, 441),
    EXL(NOTE_FS, 3, 441),
    EXL(NOTE_D, 5, 221),
    EXL(NOTE_B, 3, 220),
    EXL(NOTE_FS, 3, 441),
    EXL(NOTE_FS, 5, 111),
    EXL(NOTE_B, 3, 110),
    EXL(NOTE_G, 5, 221),
    EXL(NOTE_FS, 5, 221),
    /* Events 209-224 */
    EXL(NOTE_E, 5, 221),
    EXL(NOTE_FS, 5, 221),
    EXL(NOTE_E, 3, 220),
    EXL(NOTE_B, 3, 441),
    EXL(NOTE_B, 4, 441),
    EXL(NOTE_G, 3, 441),
    EXL(NOTE_G, 5, 221),
    EXL(NOTE_A, 3, 220),
    EXL(NOTE_FS, 5, 111),
    EXL(NOTE_E, 3, 110),
    EXL(NOTE_E, 5, 221),
    EXL(NOTE_A, 3, 221),
    EXL(NOTE_D, 5, 662),
    EXL(NOTE_FS, 5, 221),
    EXL(NOTE_A, 3, 220),
    EXL(NOTE_E, 3, 441),
    /* Events 225-240 */
    EXL(NOTE_C, 4, 882),
    EXL(NOTE_D, 3, 441),
    EXL(NOTE_A, 3, 441),
    EXL(NOTE_FS, 5, 111),
    EXL(NOTE_D, 4, 110),
    EXL(NOTE_E, 5, 221),
    EXL(NOTE_D, 5, 111),
    EXL(NOTE_D, 3, 110),
    EXL(NOTE_E, 5, 221),
    EXL(NOTE_FS, 5, 221),
    EXL(NOTE_G, 3, 220),
    EXL(NOTE_D, 3, 441),
    EXL(NOTE_B, 5, 221),
    EXL(NOTE_G, 3, 220),
    EXL(NOTE_D, 3, 441),
    EXL(NOTE_E, 5, 221),
    /* Events 241-256 */
    EXL(NOTE_A, 3, 220),
    EXL(NOTE_E, 3, 441),
    EXL(NOTE_FS, 5, 221),
    EXL(NOTE_CS, 4, 220),
    EXL(NOTE_E, 3, 441),
    EXL(NOTE_A, 5, 221),
    EXL(NOTE_FS, 3, 220),
    EXL(NOTE_A, 5, 111),
    EXL(NOTE_CS, 3, 110),
    EXL(NOTE_FS, 5, 221),
    EXL(NOTE_A, 5, 221),
    EXL(NOTE_A, 3, 220),
    EXL(NOTE_D, 5, 111),
    EXL(NOTE_CS, 3, 110),
    EXL(NOTE_D, 5, 662),
    EXL(NOTE_FS, 3, 441),
    /* Events 257-272 */
    EXL(NOTE_B, 3, 221),
    EXL(NOTE_B, 4, 332),
    EXL(NOTE_B, 3, 110),
    EXL(NOTE_CS, 5, 221),
    EXL(NOTE_D, 5, 221),
    EXL(NOTE_E, 3, 220),
    EXL(NOTE_B, 3, 441),
    EXL(NOTE_G, 5, 221),
    EXL(NOTE_E, 3, 220),
    EXL(NOTE_B, 3, 441),
    EXL(NOTE_CS, 5, 442),
    EXL(NOTE_G, 3, 441),
    EXL(NOTE_A, 3, 441),
    EXL(NOTE_E, 5, 441),
    EXL(NOTE_D, 3, 441),
    EXL(NOTE_D, 5, 221),
    /* Events 273-288 */
    EXL(NOTE_A, 3, 220),
    EXL(NOTE_D, 5, 441),
    EXL(NOTE_A, 3, 441),
    EXL(NOTE_FS, 4, 882),
    EXL(NOTE_A, 3, 882),
    EXL(NOTE_FS, 4, 1765),
    EXL(NOTE_D, 4, 1764),
    EXL(NOTE_FS, 5, 111),
    EXL(NOTE_D, 3, 110),
    EXL(NOTE_A, 3, 221),
    EXL(NOTE_D, 4, 221),
    EXL(NOTE_A, 3, 221),
    EXL(NOTE_FS, 4, 221),
    EXL(NOTE_A, 3, 221),
    EXL(NOTE_D, 4, 221),
    EXL(NOTE_A, 3, 221),
    /* Events 289-304 */
    EXL(NOTE_D, 3, 221),
    EXL(NOTE_A, 3, 221),
    EXL(NOTE_D, 4, 221),
    EXL(NOTE_A, 3, 221),
    EXL(NOTE_FS, 4, 221),
    EXL(NOTE_A, 3, 221),
    EXL(NOTE_D, 4, 221),
    EXL(NOTE_A, 3, 221),
    EXL(NOTE_D, 6, 111),
    EXL(NOTE_D, 3, 110),
    EXL(NOTE_A, 3, 221),
    EXL(NOTE_D, 3, 221),
    EXL(NOTE_FS, 3, 221),
    EXL(NOTE_A, 3, 221),
    EXL(NOTE_D, 4, 221),
    EXL(NOTE_FS, 4, 221),
    /* Events 305-320 */
    EXL(NOTE_D, 4, 221),
    EXL(NOTE_D, 3, 221),
    EXL(NOTE_A, 3, 221),
    EXL(NOTE_D, 4, 221),
    EXL(NOTE_A, 3, 221),
    EXL(NOTE_FS, 4, 221),
    EXL(NOTE_A, 3, 221),
    EXL(NOTE_D, 4, 221),
    EXL(NOTE_A, 3, 221),
    EXL(NOTE_A, 5, 111),
    EXL(NOTE_D, 3, 110),
    EXL(NOTE_A, 3, 221),
    EXL(NOTE_D, 3, 221),
    EXL(NOTE_FS, 3, 221),
    EXL(NOTE_D, 5, 111),
    EXL(NOTE_A, 3, 110),
    /* Events 321-336 */
    EXL(NOTE_FS, 3, 221),
    EXL(NOTE_D, 3, 221),
    EXL(NOTE_A, 3, 221),
    EXL(NOTE_D, 3, 221),
    EXL(NOTE_A, 3, 221),
    EXL(NOTE_D, 3, 221),
    EXL(NOTE_FS, 3, 221),
    EXL(NOTE_A, 3, 221),
    EXL(NOTE_A, 4, 221),
    EXL(NOTE_D, 5, 221),
    EXL(NOTE_A, 5, 221),
    EXL(NOTE_GS, 5, 111),
    EXL(NOTE_E, 3, 110),
    EXL(NOTE_B, 3, 221),
    EXL(NOTE_E, 3, 221),
    EXL(NOTE_GS, 3, 221),
    /* Events 337-352 */
    EXL(NOTE_B, 3, 221),
    EXL(NOTE_GS, 3, 221),
    EXL(NOTE_E, 3, 221),
    EXL(NOTE_B, 3, 221),
    EXL(NOTE_B, 5, 111),
    EXL(NOTE_E, 3, 110),
    EXL(NOTE_B, 3, 221),
    EXL(NOTE_E, 3, 221),
    EXL(NOTE_GS, 3, 221),
    EXL(NOTE_B, 3, 221),
    EXL(NOTE_GS, 3, 221),
    EXL(NOTE_E, 3, 221),
    EXL(NOTE_B, 3, 221),
    EXL(NOTE_A, 5, 111),
    EXL(NOTE_D, 3, 110),
    EXL(NOTE_A, 3, 221),
    /* Events 353-368 */
    EXL(NOTE_D, 3, 221),
    EXL(NOTE_FS, 3, 221),
    EXL(NOTE_D, 5, 111),
    EXL(NOTE_A, 3, 110),
    EXL(NOTE_FS, 3, 221),
    EXL(NOTE_D, 3, 221),
    EXL(NOTE_A, 3, 221),
    EXL(NOTE_D, 3, 221),
    EXL(NOTE_A, 3, 221),
    EXL(NOTE_D, 3, 221),
    EXL(NOTE_FS, 3, 221),
    EXL(NOTE_A, 4, 111),
    EXL(NOTE_A, 3, 110),
    EXL(NOTE_FS, 3, 221),
    EXL(NOTE_D, 3, 221),
    EXL(NOTE_A, 3, 221),
    /* Events 369-384 */
    EXL(NOTE_D, 5, 221),
    EXL(NOTE_D, 3, 220),
    EXL(NOTE_A, 3, 441),
    EXL(NOTE_D, 4, 441),
    EXL(NOTE_A, 3, 441),
    EXL(NOTE_FS, 4, 882),
    EXL(NOTE_A, 3, 882),
    EXL(NOTE_FS, 5, 111),
    EXL(NOTE_D, 3, 110),
    EXL(NOTE_A, 3, 221),
    EXL(NOTE_FS, 5, 111),
    EXL(NOTE_D, 3, 110),
    EXL(NOTE_FS, 3, 221),
    EXL(NOTE_FS, 5, 111),
    EXL(NOTE_A, 3, 110),
    EXL(NOTE_G, 5, 221),
    /* Events 385-400 */
    EXL(NOTE_A, 5, 221),
    EXL(NOTE_B, 5, 442),
    EXL(NOTE_E, 3, 221),
    EXL(NOTE_E, 5, 111),
    EXL(NOTE_G, 3, 110),
    EXL(NOTE_B, 3, 221),
    EXL(NOTE_E, 5, 111),
    EXL(NOTE_E, 4, 110),
    EXL(NOTE_FS, 5, 221),
    EXL(NOTE_G, 5, 221),
    EXL(NOTE_A, 5, 442),
    EXL(NOTE_A, 3, 221),
    EXL(NOTE_E, 5, 111),
    EXL(NOTE_CS, 4, 110),
    EXL(NOTE_A, 3, 221),
    EXL(NOTE_E, 5, 111),
    /* Events 401-416 */
    EXL(NOTE_E, 4, 110),
    EXL(NOTE_FS, 5, 221),
    EXL(NOTE_G, 5, 221),
    EXL(NOTE_FS, 5, 442),
    EXL(NOTE_CS, 3, 221),
    EXL(NOTE_FS, 3, 221),
    EXL(NOTE_AS, 3, 221),
    EXL(NOTE_CS, 4, 441),
    EXL(NOTE_FS, 3, 441),
    EXL(NOTE_D, 5, 111),
    EXL(NOTE_B, 3, 110),
    EXL(NOTE_FS, 3, 221),
    EXL(NOTE_D, 5, 111),
    EXL(NOTE_B, 3, 110),
    EXL(NOTE_FS, 3, 221),
    EXL(NOTE_D, 5, 111),
    /* Events 417-432 */
    EXL(NOTE_D, 4, 110),
    EXL(NOTE_E, 5, 221),
    EXL(NOTE_FS, 5, 663),
    EXL(NOTE_B, 3, 221),
    EXL(NOTE_B, 4, 111),
    EXL(NOTE_E, 3, 110),
    EXL(NOTE_GS, 3, 221),
    EXL(NOTE_B, 4, 147),
    EXL(NOTE_B, 3, 147),
    EXL(NOTE_CS, 5, 294),
    EXL(NOTE_D, 5, 294),
    EXL(NOTE_E, 5, 111),
    EXL(NOTE_E, 3, 110),
    EXL(NOTE_G, 3, 221),
    EXL(NOTE_B, 3, 221),
    EXL(NOTE_G, 3, 221),
    /* Events 433-448 */
    EXL(NOTE_E, 4, 441),
    EXL(NOTE_G, 3, 441),
    EXL(NOTE_A, 3, 441),
    EXL(NOTE_FS, 5, 221),
    EXL(NOTE_E, 3, 220),
    EXL(NOTE_E, 5, 221),
    EXL(NOTE_A, 3, 661),
    EXL(NOTE_CS, 6, 111),
    EXL(NOTE_FS, 3, 110),
    EXL(NOTE_CS, 3, 221),
    EXL(NOTE_CS, 6, 111),
    EXL(NOTE_FS, 3, 110),
    EXL(NOTE_A, 3, 221),
    EXL(NOTE_CS, 6, 111),
    EXL(NOTE_CS, 4, 110),
    EXL(NOTE_B, 5, 221),
    /* Events 449-464 */
    EXL(NOTE_A, 5, 111),
    EXL(NOTE_FS, 3, 110),
    EXL(NOTE_D, 6, 442),
    EXL(NOTE_FS, 3, 221),
    EXL(NOTE_B, 3, 221),
    EXL(NOTE_FS, 3, 221),
    EXL(NOTE_D, 4, 441),
    EXL(NOTE_FS, 3, 441),
    EXL(NOTE_CS, 6, 111),
    EXL(NOTE_FS, 3, 110),
    EXL(NOTE_CS, 3, 221),
    EXL(NOTE_FS, 3, 221),
    EXL(NOTE_CS, 6, 111),
    EXL(NOTE_A, 3, 110),
    EXL(NOTE_CS, 6, 111),
    EXL(NOTE_CS, 4, 110),
    /* Events 465-480 */
    EXL(NOTE_D, 6, 221),
    EXL(NOTE_E, 6, 111),
    EXL(NOTE_FS, 3, 110),
    EXL(NOTE_D, 6, 442),
    EXL(NOTE_FS, 3, 221),
    EXL(NOTE_B, 3, 221),
    EXL(NOTE_FS, 3, 221),
    EXL(NOTE_FS, 6, 147),
    EXL(NOTE_D, 4, 147),
    EXL(NOTE_D, 6, 147),
    EXL(NOTE_FS, 3, 147),
    EXL(NOTE_CS, 6, 294),
    EXL(NOTE_B, 5, 111),
    EXL(NOTE_E, 3, 110),
    EXL(NOTE_B, 3, 221),
    EXL(NOTE_E, 3, 221),
    /* Events 481-496 */
    EXL(NOTE_B, 5, 111),
    EXL(NOTE_G, 3, 110),
    EXL(NOTE_B, 5, 147),
    EXL(NOTE_B, 3, 147),
    EXL(NOTE_CS, 6, 294),
    EXL(NOTE_D, 6, 405),
    EXL(NOTE_D, 3, 110),
    EXL(NOTE_A, 3, 221),
    EXL(NOTE_A, 5, 111),
    EXL(NOTE_D, 3, 110),
    EXL(NOTE_FS, 3, 221),
    EXL(NOTE_A, 5, 147),
    EXL(NOTE_A, 3, 147),
    EXL(NOTE_G, 5, 294),
    EXL(NOTE_FS, 5, 405),
    EXL(NOTE_C, 3, 110),
    /* Events 497-512 */
    EXL(NOTE_G, 3, 221),
    EXL(NOTE_C, 4, 221),
    EXL(NOTE_G, 3, 221),
    EXL(NOTE_G, 5, 111),
    EXL(NOTE_E, 4, 110),
    EXL(NOTE_G, 3, 221),
    EXL(NOTE_C, 4, 221),
    EXL(NOTE_G, 3, 221),
    EXL(NOTE_D, 6, 221),
    EXL(NOTE_C, 3, 220),
    EXL(NOTE_G, 3, 441),
    EXL(NOTE_C, 4, 441),
    EXL(NOTE_E, 6, 221),
    EXL(NOTE_E, 5, 220),
    EXL(NOTE_E, 6, 147),
    EXL(NOTE_E, 5, 147),
    /* Events 513-528 */
    EXL(NOTE_A, 3, 147),
    EXL(NOTE_E, 3, 441),
    EXL(NOTE_A, 3, 441),
    EXL(NOTE_E, 3, 441),
    EXL(NOTE_CS, 4, 882),
    EXL(NOTE_FS, 5, 221),
    EXL(NOTE_G, 5, 221),
    EXL(NOTE_FS, 5, 221),
    EXL(NOTE_E, 5, 221),
    EXL(NOTE_FS, 5, 111),
    EXL(NOTE_G, 3, 110),
    EXL(NOTE_D, 3, 221),
    EXL(NOTE_G, 3, 221),
    EXL(NOTE_B, 3, 221),
    EXL(NOTE_B, 4, 221),
    EXL(NOTE_D, 4, 220),
    /* Events 529-544 */
    EXL(NOTE_G, 3, 441),
    EXL(NOTE_E, 5, 111),
    EXL(NOTE_A, 3, 110),
    EXL(NOTE_E, 3, 221),
    EXL(NOTE_A, 3, 221),
    EXL(NOTE_CS, 4, 221),
    EXL(NOTE_A, 4, 221),
    EXL(NOTE_E, 4, 220),
    EXL(NOTE_A, 3, 441),
    EXL(NOTE_E, 5, 111),
    EXL(NOTE_FS, 3, 110),
    EXL(NOTE_CS, 3, 221),
    EXL(NOTE_FS, 3, 221),
    EXL(NOTE_A, 3, 221),
    EXL(NOTE_A, 4, 221),
    EXL(NOTE_CS, 4, 220),
    /* Events 545-560 */
    EXL(NOTE_FS, 3, 441),
    EXL(NOTE_D, 5, 111),
    EXL(NOTE_B, 3, 110),
    EXL(NOTE_FS, 3, 221),
    EXL(NOTE_B, 3, 221),
    EXL(NOTE_FS, 3, 221),
    EXL(NOTE_FS, 5, 111),
    EXL(NOTE_D, 4, 110),
    EXL(NOTE_G, 5, 221),
    EXL(NOTE_FS, 5, 111),
    EXL(NOTE_FS, 3, 110),
    EXL(NOTE_E, 5, 221),
    EXL(NOTE_FS, 5, 111),
    EXL(NOTE_E, 3, 110),
    EXL(NOTE_B, 3, 221),
    EXL(NOTE_E, 3, 221),
    /* Events 561-576 */
    EXL(NOTE_G, 3, 221),
    EXL(NOTE_B, 4, 221),
    EXL(NOTE_B, 3, 220),
    EXL(NOTE_E, 3, 441),
    EXL(NOTE_G, 5, 111),
    EXL(NOTE_A, 3, 110),
    EXL(NOTE_E, 3, 221),
    EXL(NOTE_FS, 5, 111),
    EXL(NOTE_A, 3, 110),
    EXL(NOTE_E, 5, 111),
    EXL(NOTE_CS, 4, 110),
    EXL(NOTE_E, 4, 221),
    EXL(NOTE_D, 5, 221),
    EXL(NOTE_A, 3, 441),
    EXL(NOTE_FS, 5, 221),
    EXL(NOTE_A, 3, 220),
    /* Events 577-592 */
    EXL(NOTE_E, 3, 441),
    EXL(NOTE_C, 4, 441),
    EXL(NOTE_E, 3, 441),
    EXL(NOTE_D, 3, 441),
    EXL(NOTE_A, 3, 441),
    EXL(NOTE_FS, 5, 111),
    EXL(NOTE_D, 4, 110),
    EXL(NOTE_E, 5, 221),
    EXL(NOTE_D, 5, 221),
    EXL(NOTE_E, 5, 221),
    EXL(NOTE_FS, 5, 111),
    EXL(NOTE_G, 3, 110),
    EXL(NOTE_D, 3, 221),
    EXL(NOTE_G, 3, 221),
    EXL(NOTE_D, 3, 221),
    EXL(NOTE_B, 5, 221),
    /* Events 593-608 */
    EXL(NOTE_B, 3, 220),
    EXL(NOTE_D, 3, 441),
    EXL(NOTE_E, 5, 111),
    EXL(NOTE_A, 3, 110),
    EXL(NOTE_E, 3, 221),
    EXL(NOTE_A, 3, 221),
    EXL(NOTE_CS, 4, 221),
    EXL(NOTE_FS, 5, 221),
    EXL(NOTE_E, 4, 220),
    EXL(NOTE_A, 3, 441),
    EXL(NOTE_A, 5, 111),
    EXL(NOTE_FS, 3, 110),
    EXL(NOTE_CS, 3, 221),
    EXL(NOTE_A, 5, 111),
    EXL(NOTE_FS, 3, 110),
    EXL(NOTE_FS, 5, 111),
    /* Events 609-624 */
    EXL(NOTE_A, 3, 110),
    EXL(NOTE_B, 5, 221),
    EXL(NOTE_CS, 4, 220),
    EXL(NOTE_D, 5, 111),
    EXL(NOTE_FS, 3, 110),
    EXL(NOTE_D, 5, 442),
    EXL(NOTE_FS, 3, 221),
    EXL(NOTE_B, 3, 221),
    EXL(NOTE_FS, 3, 221),
    EXL(NOTE_D, 4, 221),
    EXL(NOTE_B, 4, 332),
    EXL(NOTE_FS, 3, 110),
    EXL(NOTE_CS, 5, 221),
    EXL(NOTE_D, 5, 111),
    EXL(NOTE_E, 3, 110),
    EXL(NOTE_B, 3, 221),
    /* Events 625-640 */
    EXL(NOTE_E, 3, 221),
    EXL(NOTE_B, 3, 221),
    EXL(NOTE_G, 5, 221),
    EXL(NOTE_G, 3, 220),
    EXL(NOTE_B, 3, 441),
    EXL(NOTE_CS, 5, 111),
    EXL(NOTE_A, 3, 110),
    EXL(NOTE_E, 3, 221),
    EXL(NOTE_A, 3, 221),
    EXL(NOTE_E, 3, 221),
    EXL(NOTE_CS, 4, 441),
    EXL(NOTE_E, 5, 221),
    EXL(NOTE_E, 3, 220),
    EXL(NOTE_E, 5, 221),
    EXL(NOTE_A, 3, 221),
    EXL(NOTE_D, 5, 111),
    /* Events 641-656 */
    EXL(NOTE_D, 3, 110),
    EXL(NOTE_FS, 3, 221),
    EXL(NOTE_A, 3, 441),
    EXL(NOTE_FS, 3, 441),
    EXL(NOTE_D, 5, 441),
    EXL(NOTE_A, 3, 441),
    EXL(NOTE_FS, 3, 441),
    EXL(NOTE_B, 4, 111),
    EXL(NOTE_D, 3, 110),
    EXL(NOTE_A, 4, 221),
    EXL(NOTE_B, 4, 221),
    EXL(NOTE_G, 3, 220),
    EXL(NOTE_B, 4, 111),
    EXL(NOTE_D, 3, 110),
    EXL(NOTE_A, 4, 221),
    EXL(NOTE_B, 4, 221),
    /* Events 657-672 */
    EXL(NOTE_G, 3, 220),
    EXL(NOTE_B, 4, 111),
    EXL(NOTE_B, 3, 110),
    EXL(NOTE_A, 4, 221),
    EXL(NOTE_B, 4, 147),
    EXL(NOTE_D, 4, 147),
    EXL(NOTE_CS, 5, 294),
    EXL(NOTE_D, 5, 294),
    EXL(NOTE_E, 5, 221),
    EXL(NOTE_G, 3, 220),
    EXL(NOTE_D, 5, 1324),
    EXL(NOTE_FS, 3, 441),
    EXL(NOTE_D, 3, 441),
    EXL(NOTE_FS, 3, 441),
    EXL(NOTE_D, 3, 441),
    EXL(NOTE_B, 3, 441),
    /* Events 673-688 */
    EXL(NOTE_B, 4, 111),
    EXL(NOTE_FS, 3, 110),
    EXL(NOTE_CS, 5, 221),
    EXL(NOTE_B, 3, 882),
    EXL(NOTE_D, 5, 221),
    EXL(NOTE_E, 3, 220),
    EXL(NOTE_D, 5, 111),
    EXL(NOTE_B, 3, 110),
    EXL(NOTE_CS, 5, 221),
    EXL(NOTE_D, 5, 221),
    EXL(NOTE_E, 3, 220),
    EXL(NOTE_D, 5, 111),
    EXL(NOTE_G, 3, 110),
    EXL(NOTE_CS, 5, 221),
    EXL(NOTE_D, 5, 331),
    EXL(NOTE_B, 3, 331),
    /* Events 689-704 */
    EXL(NOTE_D, 5, 221),
    EXL(NOTE_E, 5, 221),
    EXL(NOTE_E, 3, 220),
    EXL(NOTE_D, 5, 221),
    EXL(NOTE_B, 4, 221),
    EXL(NOTE_A, 4, 221),
    EXL(NOTE_D, 3, 220),
    EXL(NOTE_A, 3, 441),
    EXL(NOTE_D, 4, 882),
    EXL(NOTE_E, 3, 441),
    EXL(NOTE_B, 4, 221),
    EXL(NOTE_B, 3, 220),
    EXL(NOTE_D, 5, 441),
    EXL(NOTE_E, 4, 441),
    EXL(NOTE_FS, 3, 441),
    EXL(NOTE_B, 4, 111),
    /* Events 705-720 */
    EXL(NOTE_D, 3, 110),
    EXL(NOTE_A, 4, 221),
    EXL(NOTE_B, 4, 221),
    EXL(NOTE_FS, 3, 220),
    EXL(NOTE_B, 4, 221),
    EXL(NOTE_A, 4, 221),
    EXL(NOTE_B, 4, 221),
    EXL(NOTE_G, 3, 220),
    EXL(NOTE_B, 4, 111),
    EXL(NOTE_D, 3, 110),
    EXL(NOTE_A, 4, 221),
    EXL(NOTE_B, 4, 147),
    EXL(NOTE_G, 3, 147),
    EXL(NOTE_CS, 5, 294),
    EXL(NOTE_D, 5, 294),
    EXL(NOTE_E, 5, 221),
    /* Events 721-736 */
    EXL(NOTE_A, 3, 220),
    EXL(NOTE_D, 5, 111),
    EXL(NOTE_E, 3, 110),
    EXL(NOTE_FS, 5, 221),
    EXL(NOTE_A, 3, 882),
    EXL(NOTE_B, 3, 441),
    EXL(NOTE_G, 5, 221),
    EXL(NOTE_FS, 3, 220),
    EXL(NOTE_FS, 5, 111),
    EXL(NOTE_B, 3, 110),
    EXL(NOTE_E, 5, 441),
    EXL(NOTE_D, 5, 221),
    EXL(NOTE_E, 5, 111),
    EXL(NOTE_E, 3, 110),
    EXL(NOTE_D, 5, 221),
    EXL(NOTE_B, 3, 441),
    /* Events 737-752 */
    EXL(NOTE_D, 5, 441),
    EXL(NOTE_GS, 3, 441),
    EXL(NOTE_B, 3, 441),
    EXL(NOTE_G, 5, 441),
    EXL(NOTE_FS, 5, 111),
    EXL(NOTE_E, 3, 110),
    EXL(NOTE_E, 5, 441),
    EXL(NOTE_D, 5, 221),
    EXL(NOTE_E, 5, 221),
    EXL(NOTE_G, 3, 220),
    EXL(NOTE_D, 3, 441),
    EXL(NOTE_AS, 3, 441),
    EXL(NOTE_D, 3, 441),
    EXL(NOTE_A, 3, 441),
    EXL(NOTE_E, 3, 441),
    EXL(NOTE_FS, 5, 111),
    /* Events 753-768 */
    EXL(NOTE_CS, 4, 110),
    EXL(NOTE_G, 5, 221),
    EXL(NOTE_FS, 5, 221),
    EXL(NOTE_E, 5, 221),
    EXL(NOTE_FS, 5, 441),
    EXL(NOTE_G, 3, 441),
    EXL(NOTE_B, 4, 882),
    EXL(NOTE_E, 5, 441),
    EXL(NOTE_A, 3, 441),
    EXL(NOTE_A, 4, 882),
    EXL(NOTE_E, 5, 441),
    EXL(NOTE_FS, 3, 441),
    EXL(NOTE_A, 4, 882),
    EXL(NOTE_D, 5, 441),
    EXL(NOTE_B, 3, 441),
    EXL(NOTE_FS, 5, 221),
    /* Events 769-784 */
    EXL(NOTE_G, 5, 221),
    EXL(NOTE_FS, 5, 221),
    EXL(NOTE_E, 5, 221),
    EXL(NOTE_FS, 5, 221),
    EXL(NOTE_E, 3, 220),
    EXL(NOTE_B, 3, 441),
    EXL(NOTE_B, 4, 221),
    EXL(NOTE_E, 3, 220),
    EXL(NOTE_B, 3, 441),
    EXL(NOTE_G, 5, 221),
    EXL(NOTE_A, 3, 220),
    EXL(NOTE_FS, 5, 111),
    EXL(NOTE_E, 3, 110),
    EXL(NOTE_E, 5, 221),
    EXL(NOTE_A, 3, 221),
    EXL(NOTE_D, 5, 221),
    /* Events 785-800 */
    EXL(NOTE_E, 3, 441),
    EXL(NOTE_A, 5, 221),
    EXL(NOTE_D, 3, 220),
    EXL(NOTE_A, 3, 441),
    EXL(NOTE_D, 3, 441),
    EXL(NOTE_FS, 3, 441),
    EXL(NOTE_A, 3, 441),
    EXL(NOTE_FS, 3, 441),
    EXL(NOTE_FS, 5, 111),
    EXL(NOTE_A, 3, 110),
    EXL(NOTE_E, 5, 221),
    EXL(NOTE_D, 5, 111),
    EXL(NOTE_D, 4, 110),
    EXL(NOTE_E, 5, 221),
    EXL(NOTE_FS, 5, 221),
    EXL(NOTE_G, 3, 220),
    /* Events 801-816 */
    EXL(NOTE_D, 3, 441),
    EXL(NOTE_B, 5, 221),
    EXL(NOTE_B, 3, 220),
    EXL(NOTE_D, 3, 441),
    EXL(NOTE_E, 5, 221),
    EXL(NOTE_A, 3, 220),
    EXL(NOTE_E, 3, 441),
    EXL(NOTE_FS, 5, 221),
    EXL(NOTE_A, 3, 220),
    EXL(NOTE_E, 3, 441),
    EXL(NOTE_A, 5, 221),
    EXL(NOTE_FS, 3, 220),
    EXL(NOTE_A, 5, 111),
    EXL(NOTE_CS, 3, 110),
    EXL(NOTE_FS, 5, 221),
    EXL(NOTE_B, 5, 221),
    /* Events 817-832 */
    EXL(NOTE_FS, 3, 220),
    EXL(NOTE_CS, 3, 221),
    EXL(NOTE_D, 5, 221),
    EXL(NOTE_E, 5, 111),
    EXL(NOTE_B, 3, 110),
    EXL(NOTE_D, 5, 221),
    EXL(NOTE_FS, 3, 441),
    EXL(NOTE_B, 3, 221),
    EXL(NOTE_B, 4, 442),
    EXL(NOTE_CS, 5, 221),
    EXL(NOTE_D, 5, 221),
    EXL(NOTE_E, 3, 220),
    EXL(NOTE_B, 3, 441),
    EXL(NOTE_G, 5, 221),
    EXL(NOTE_G, 3, 220),
    EXL(NOTE_B, 3, 441),
    /* Events 833-848 */
    EXL(NOTE_CS, 5, 221),
    EXL(NOTE_A, 3, 220),
    EXL(NOTE_E, 3, 441),
    EXL(NOTE_A, 3, 441),
    EXL(NOTE_A, 4, 221),
    EXL(NOTE_E, 3, 220),
    EXL(NOTE_B, 3, 221),
    EXL(NOTE_E, 5, 221),
    EXL(NOTE_D, 5, 221),
    EXL(NOTE_FS, 3, 220),
    EXL(NOTE_B, 3, 441),
    EXL(NOTE_FS, 3, 441),
    EXL(NOTE_B, 4, 111),
    EXL(NOTE_E, 3, 110),
    EXL(NOTE_A, 4, 662),
    EXL(NOTE_B, 3, 441),
    /* Events 849-864 */
    EXL(NOTE_B, 4, 221),
    EXL(NOTE_CS, 5, 221),
    EXL(NOTE_D, 5, 221),
    EXL(NOTE_E, 3, 220),
    EXL(NOTE_B, 3, 441),
    EXL(NOTE_FS, 5, 441),
    EXL(NOTE_E, 4, 441),
    EXL(NOTE_CS, 5, 589),
    EXL(NOTE_E, 3, 588),
    EXL(NOTE_A, 3, 588),
    EXL(NOTE_E, 5, 441),
    EXL(NOTE_D, 5, 3088),
    EXL(NOTE_FS, 5, 221),
    EXL(NOTE_D, 3, 220),
    EXL(NOTE_A, 3, 441),
    EXL(NOTE_D, 4, 441),
    /* Events 865-880 */
    EXL(NOTE_A, 3, 441),
    EXL(NOTE_D, 4, 882),
    EXL(NOTE_FS, 5, 221),
    EXL(NOTE_G, 5, 221),
    EXL(NOTE_A, 5, 441),
    EXL(NOTE_G, 5, 221),
    EXL(NOTE_A, 3, 220),
    EXL(NOTE_E, 3, 441),
    EXL(NOTE_A, 3, 441),
    EXL(NOTE_E, 3, 441),
    EXL(NOTE_FS, 5, 883),
    EXL(NOTE_C, 4, 882),
    EXL(NOTE_E, 5, 221),
    EXL(NOTE_C, 3, 220),
    EXL(NOTE_G, 3, 441),
    EXL(NOTE_C, 4, 441),
    /* Events 881-896 */
    EXL(NOTE_G, 3, 441),
    EXL(NOTE_E, 5, 221),
    EXL(NOTE_E, 4, 220),
    EXL(NOTE_FS, 5, 441),
    EXL(NOTE_G, 5, 221),
    EXL(NOTE_G, 3, 220),
    EXL(NOTE_A, 5, 441),
    EXL(NOTE_D, 5, 221),
    EXL(NOTE_B, 3, 220),
    EXL(NOTE_G, 3, 441),
    EXL(NOTE_B, 3, 441),
    EXL(NOTE_G, 3, 441),
    EXL(NOTE_D, 4, 2648),
    EXL(NOTE_FS, 3, 882),
    EXL(NOTE_A, 3, 882),
    EXL(NOTE_D, 3, 882)
};

#undef EXL_R
#undef EXL
