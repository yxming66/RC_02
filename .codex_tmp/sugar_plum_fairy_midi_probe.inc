/*
 * Tchaikovsky - Dance of the Sugar Plum Fairy.
 * Single-line PWM buzzer reduction generated from PiaStudy 21qqYUXk2Ak MIDI.
 * The right-hand line is preferred at simultaneous onsets; bass notes
 * are folded by octaves into the practical buzzer range.
 * 455 events, about 91 seconds.
 */
#define FD(note, octave, ms) {note, octave, (uint16_t)(ms)}
#define FD_R(ms) {NOTE_REST, 0, (uint16_t)(ms)}

const Tone_t SUGAR_PLUM_FAIRY[] = {
    /* Events 1-16 */
    FD(NOTE_E, 3, 429),
    FD(NOTE_E, 4, 429),
    FD(NOTE_E, 3, 429),
    FD(NOTE_FS, 4, 429),
    FD(NOTE_E, 3, 429),
    FD(NOTE_G, 4, 429),
    FD(NOTE_E, 3, 429),
    FD(NOTE_DS, 4, 429),
    FD(NOTE_E, 3, 429),
    FD(NOTE_E, 4, 429),
    FD(NOTE_E, 3, 429),
    FD(NOTE_FS, 4, 429),
    FD(NOTE_E, 3, 429),
    FD(NOTE_G, 4, 429),
    FD(NOTE_E, 3, 429),
    FD(NOTE_DS, 4, 429),
    /* Events 17-32 */
    FD(NOTE_E, 3, 429),
    FD(NOTE_G, 6, 214),
    FD(NOTE_E, 6, 214),
    FD(NOTE_G, 6, 429),
    FD(NOTE_FS, 6, 429),
    FD(NOTE_DS, 6, 429),
    FD(NOTE_E, 6, 429),
    FD(NOTE_D, 6, 857),
    FD(NOTE_CS, 6, 857),
    FD(NOTE_C, 6, 857),
    FD(NOTE_B, 5, 214),
    FD(NOTE_E, 6, 214),
    FD(NOTE_C, 6, 214),
    FD(NOTE_E, 6, 214),
    FD(NOTE_B, 5, 429),
    FD(NOTE_E, 3, 107),
    /* Events 33-48 */
    FD(NOTE_D, 3, 107),
    FD(NOTE_C, 3, 107),
    FD(NOTE_B, 3, 107),
    FD(NOTE_AS, 3, 429),
    FD(NOTE_G, 5, 214),
    FD(NOTE_E, 5, 214),
    FD(NOTE_G, 5, 429),
    FD(NOTE_FS, 5, 429),
    FD(NOTE_C, 6, 429),
    FD(NOTE_B, 5, 429),
    FD(NOTE_G, 6, 857),
    FD(NOTE_FS, 6, 857),
    FD(NOTE_E, 6, 857),
    FD(NOTE_DS, 6, 214),
    FD(NOTE_FS, 6, 214),
    FD(NOTE_E, 6, 214),
    /* Events 49-64 */
    FD(NOTE_FS, 6, 214),
    FD(NOTE_DS, 6, 429),
    FD(NOTE_B, 3, 107),
    FD(NOTE_A, 3, 107),
    FD(NOTE_G, 3, 107),
    FD(NOTE_FS, 3, 107),
    FD(NOTE_E, 3, 429),
    FD(NOTE_G, 6, 214),
    FD(NOTE_E, 6, 214),
    FD(NOTE_G, 6, 429),
    FD(NOTE_FS, 6, 429),
    FD(NOTE_DS, 6, 429),
    FD(NOTE_E, 6, 429),
    FD(NOTE_D, 6, 857),
    FD(NOTE_CS, 6, 857),
    FD(NOTE_C, 6, 857),
    /* Events 65-80 */
    FD(NOTE_B, 5, 214),
    FD(NOTE_E, 6, 214),
    FD(NOTE_C, 6, 214),
    FD(NOTE_E, 6, 214),
    FD(NOTE_B, 5, 429),
    FD(NOTE_G, 4, 107),
    FD(NOTE_FS, 4, 107),
    FD(NOTE_E, 4, 107),
    FD(NOTE_D, 4, 107),
    FD(NOTE_CS, 4, 429),
    FD(NOTE_E, 5, 214),
    FD(NOTE_CS, 5, 214),
    FD(NOTE_E, 5, 429),
    FD(NOTE_DS, 5, 107),
    FD(NOTE_E, 4, 107),
    FD(NOTE_DS, 4, 107),
    /* Events 81-96 */
    FD(NOTE_CS, 4, 107),
    FD(NOTE_B, 3, 429),
    FD(NOTE_D, 5, 214),
    FD(NOTE_B, 4, 214),
    FD(NOTE_D, 5, 429),
    FD(NOTE_CS, 5, 107),
    FD(NOTE_D, 4, 107),
    FD(NOTE_CS, 4, 107),
    FD(NOTE_B, 3, 107),
    FD(NOTE_A, 3, 429),
    FD(NOTE_C, 5, 214),
    FD(NOTE_A, 4, 214),
    FD(NOTE_C, 5, 429),
    FD(NOTE_B, 4, 107),
    FD(NOTE_C, 4, 107),
    FD(NOTE_B, 3, 107),
    /* Events 97-112 */
    FD(NOTE_A, 3, 107),
    FD(NOTE_G, 3, 429),
    FD(NOTE_B, 4, 107),
    FD(NOTE_DS, 5, 107),
    FD(NOTE_FS, 5, 107),
    FD(NOTE_B, 5, 107),
    FD(NOTE_E, 5, 429),
    FD(NOTE_B, 3, 429),
    FD(NOTE_CS, 4, 214),
    FD(NOTE_CS, 5, 214),
    FD(NOTE_DS, 4, 214),
    FD(NOTE_DS, 5, 214),
    FD(NOTE_E, 4, 214),
    FD(NOTE_E, 5, 214),
    FD(NOTE_FS, 4, 214),
    FD(NOTE_FS, 5, 214),
    /* Events 113-128 */
    FD(NOTE_G, 4, 214),
    FD(NOTE_G, 5, 214),
    FD(NOTE_E, 4, 214),
    FD(NOTE_E, 5, 214),
    FD(NOTE_DS, 4, 214),
    FD(NOTE_DS, 5, 214),
    FD(NOTE_B, 3, 143),
    FD(NOTE_CS, 4, 143),
    FD(NOTE_B, 3, 143),
    FD(NOTE_A, 3, 143),
    FD(NOTE_G, 3, 143),
    FD(NOTE_A, 3, 143),
    FD(NOTE_G, 3, 143),
    FD(NOTE_B, 3, 143),
    FD(NOTE_G, 3, 143),
    FD(NOTE_B, 3, 143),
    /* Events 129-144 */
    FD(NOTE_G, 3, 143),
    FD(NOTE_B, 3, 143),
    FD(NOTE_G, 3, 143),
    FD(NOTE_B, 3, 143),
    FD(NOTE_A, 3, 143),
    FD(NOTE_G, 3, 143),
    FD(NOTE_FS, 3, 143),
    FD(NOTE_A, 3, 143),
    FD(NOTE_FS, 3, 143),
    FD(NOTE_A, 3, 143),
    FD(NOTE_FS, 3, 143),
    FD(NOTE_A, 3, 143),
    FD(NOTE_FS, 3, 143),
    FD(NOTE_A, 3, 143),
    FD(NOTE_B, 3, 429),
    FD(NOTE_CS, 4, 214),
    /* Events 145-160 */
    FD(NOTE_CS, 5, 214),
    FD(NOTE_DS, 4, 214),
    FD(NOTE_DS, 5, 214),
    FD(NOTE_E, 4, 214),
    FD(NOTE_E, 5, 214),
    FD(NOTE_FS, 4, 214),
    FD(NOTE_FS, 5, 214),
    FD(NOTE_G, 4, 214),
    FD(NOTE_G, 5, 214),
    FD(NOTE_E, 4, 214),
    FD(NOTE_E, 5, 214),
    FD(NOTE_DS, 4, 214),
    FD(NOTE_DS, 5, 214),
    FD(NOTE_B, 3, 143),
    FD(NOTE_CS, 4, 143),
    FD(NOTE_B, 3, 143),
    /* Events 161-176 */
    FD(NOTE_A, 3, 143),
    FD(NOTE_G, 3, 143),
    FD(NOTE_B, 3, 143),
    FD(NOTE_G, 3, 143),
    FD(NOTE_B, 3, 143),
    FD(NOTE_G, 3, 143),
    FD(NOTE_B, 3, 143),
    FD(NOTE_G, 3, 143),
    FD(NOTE_B, 3, 143),
    FD(NOTE_G, 3, 143),
    FD(NOTE_B, 3, 143),
    FD(NOTE_A, 3, 143),
    FD(NOTE_G, 3, 143),
    FD(NOTE_FS, 3, 143),
    FD(NOTE_A, 3, 143),
    FD(NOTE_FS, 3, 143),
    /* Events 177-192 */
    FD(NOTE_A, 3, 143),
    FD(NOTE_FS, 3, 143),
    FD(NOTE_A, 3, 143),
    FD(NOTE_FS, 3, 143),
    FD(NOTE_A, 3, 143),
    FD(NOTE_B, 3, 429),
    FD(NOTE_CS, 4, 214),
    FD(NOTE_CS, 5, 214),
    FD(NOTE_DS, 4, 214),
    FD(NOTE_DS, 5, 214),
    FD(NOTE_E, 4, 214),
    FD(NOTE_E, 5, 214),
    FD(NOTE_B, 3, 429),
    FD(NOTE_DS, 4, 214),
    FD(NOTE_DS, 5, 214),
    FD(NOTE_E, 4, 214),
    /* Events 193-208 */
    FD(NOTE_E, 5, 214),
    FD(NOTE_FS, 4, 214),
    FD(NOTE_FS, 5, 214),
    FD(NOTE_B, 3, 429),
    FD(NOTE_E, 4, 214),
    FD(NOTE_E, 5, 214),
    FD(NOTE_FS, 4, 214),
    FD(NOTE_FS, 5, 214),
    FD(NOTE_G, 4, 214),
    FD(NOTE_G, 5, 214),
    FD(NOTE_G, 4, 214),
    FD(NOTE_G, 5, 214),
    FD(NOTE_A, 5, 428),
    FD(NOTE_B, 3, 214),
    FD(NOTE_A, 5, 214),
    FD(NOTE_B, 4, 21),
    /* Events 209-224 */
    FD(NOTE_DS, 5, 29),
    FD(NOTE_FS, 5, 29),
    FD(NOTE_B, 5, 350),
    FD(NOTE_D, 4, 50),
    FD(NOTE_FS, 4, 57),
    FD(NOTE_A, 4, 50),
    FD(NOTE_C, 5, 57),
    FD(NOTE_D, 5, 50),
    FD(NOTE_FS, 5, 57),
    FD(NOTE_A, 5, 50),
    FD(NOTE_C, 6, 57),
    FD(NOTE_DS, 4, 50),
    FD(NOTE_FS, 4, 57),
    FD(NOTE_B, 4, 50),
    FD(NOTE_DS, 5, 107),
    FD(NOTE_FS, 5, 57),
    /* Events 225-240 */
    FD(NOTE_A, 5, 50),
    FD(NOTE_B, 5, 57),
    FD(NOTE_F, 4, 50),
    FD(NOTE_A, 4, 57),
    FD(NOTE_C, 5, 50),
    FD(NOTE_E, 5, 57),
    FD(NOTE_D, 5, 50),
    FD(NOTE_FS, 5, 57),
    FD(NOTE_A, 5, 50),
    FD(NOTE_C, 6, 57),
    FD(NOTE_DS, 4, 50),
    FD(NOTE_F, 4, 57),
    FD(NOTE_B, 4, 50),
    FD(NOTE_DS, 5, 107),
    FD(NOTE_FS, 5, 57),
    FD(NOTE_A, 5, 50),
    /* Events 241-256 */
    FD(NOTE_B, 5, 57),
    FD(NOTE_A, 4, 50),
    FD(NOTE_C, 5, 57),
    FD(NOTE_DS, 5, 50),
    FD(NOTE_G, 5, 57),
    FD(NOTE_F, 5, 50),
    FD(NOTE_A, 5, 57),
    FD(NOTE_C, 6, 50),
    FD(NOTE_E, 6, 57),
    FD(NOTE_DS, 4, 50),
    FD(NOTE_FS, 4, 57),
    FD(NOTE_A, 4, 50),
    FD(NOTE_B, 4, 57),
    FD(NOTE_DS, 5, 50),
    FD(NOTE_FS, 5, 57),
    FD(NOTE_A, 5, 50),
    /* Events 257-272 */
    FD(NOTE_B, 5, 57),
    FD(NOTE_D, 4, 50),
    FD(NOTE_FS, 4, 57),
    FD(NOTE_A, 4, 50),
    FD(NOTE_C, 5, 57),
    FD(NOTE_D, 5, 50),
    FD(NOTE_FS, 5, 57),
    FD(NOTE_A, 5, 50),
    FD(NOTE_C, 6, 57),
    FD(NOTE_FS, 4, 50),
    FD(NOTE_A, 4, 57),
    FD(NOTE_B, 4, 50),
    FD(NOTE_D, 5, 57),
    FD(NOTE_DS, 5, 50),
    FD(NOTE_FS, 5, 57),
    FD(NOTE_A, 5, 50),
    /* Events 273-288 */
    FD(NOTE_B, 5, 57),
    FD(NOTE_F, 4, 50),
    FD(NOTE_A, 4, 57),
    FD(NOTE_C, 5, 50),
    FD(NOTE_E, 5, 57),
    FD(NOTE_F, 5, 50),
    FD(NOTE_A, 5, 57),
    FD(NOTE_C, 6, 50),
    FD(NOTE_E, 6, 57),
    FD(NOTE_FS, 4, 50),
    FD(NOTE_A, 4, 57),
    FD(NOTE_B, 4, 50),
    FD(NOTE_DS, 5, 107),
    FD(NOTE_FS, 5, 57),
    FD(NOTE_A, 5, 50),
    FD(NOTE_DS, 6, 57),
    /* Events 289-304 */
    FD(NOTE_F, 4, 50),
    FD(NOTE_A, 4, 57),
    FD(NOTE_C, 5, 50),
    FD(NOTE_E, 5, 57),
    FD(NOTE_F, 5, 50),
    FD(NOTE_A, 5, 57),
    FD(NOTE_C, 6, 50),
    FD(NOTE_E, 6, 57),
    FD(NOTE_FS, 4, 50),
    FD(NOTE_A, 4, 57),
    FD(NOTE_B, 4, 50),
    FD(NOTE_DS, 5, 57),
    FD(NOTE_FS, 5, 50),
    FD(NOTE_A, 5, 57),
    FD(NOTE_B, 5, 50),
    FD(NOTE_DS, 6, 57),
    /* Events 305-320 */
    FD(NOTE_A, 4, 50),
    FD(NOTE_C, 5, 57),
    FD(NOTE_DS, 5, 50),
    FD(NOTE_G, 5, 57),
    FD(NOTE_A, 5, 50),
    FD(NOTE_C, 6, 57),
    FD(NOTE_DS, 6, 50),
    FD(NOTE_G, 6, 57),
    FD(NOTE_B, 4, 71),
    FD(NOTE_DS, 5, 71),
    FD(NOTE_FS, 5, 71),
    FD(NOTE_B, 5, 71),
    FD(NOTE_DS, 6, 71),
    FD(NOTE_FS, 6, 71),
    FD(NOTE_A, 4, 50),
    FD(NOTE_C, 5, 57),
    /* Events 321-336 */
    FD(NOTE_DS, 5, 50),
    FD(NOTE_G, 5, 57),
    FD(NOTE_A, 5, 50),
    FD(NOTE_C, 6, 57),
    FD(NOTE_DS, 6, 50),
    FD(NOTE_G, 6, 57),
    FD(NOTE_B, 4, 71),
    FD(NOTE_DS, 5, 71),
    FD(NOTE_FS, 5, 71),
    FD(NOTE_B, 5, 71),
    FD(NOTE_DS, 6, 71),
    FD(NOTE_FS, 6, 71),
    FD(NOTE_D, 5, 50),
    FD(NOTE_FS, 5, 57),
    FD(NOTE_A, 5, 50),
    FD(NOTE_C, 6, 57),
    /* Events 337-352 */
    FD(NOTE_D, 6, 50),
    FD(NOTE_FS, 6, 57),
    FD(NOTE_A, 6, 50),
    FD(NOTE_C, 7, 57),
    FD(NOTE_DS, 5, 50),
    FD(NOTE_A, 5, 57),
    FD(NOTE_C, 6, 50),
    FD(NOTE_D, 6, 57),
    FD(NOTE_DS, 6, 50),
    FD(NOTE_A, 6, 57),
    FD(NOTE_C, 7, 50),
    FD(NOTE_D, 6, 57),
    FD(NOTE_D, 5, 50),
    FD(NOTE_FS, 5, 57),
    FD(NOTE_A, 5, 50),
    FD(NOTE_C, 6, 57),
    /* Events 353-368 */
    FD(NOTE_D, 6, 50),
    FD(NOTE_FS, 6, 57),
    FD(NOTE_A, 6, 50),
    FD(NOTE_C, 7, 57),
    FD(NOTE_D, 5, 50),
    FD(NOTE_FS, 5, 57),
    FD(NOTE_A, 5, 50),
    FD(NOTE_B, 5, 57),
    FD(NOTE_DS, 6, 50),
    FD(NOTE_FS, 6, 57),
    FD(NOTE_A, 6, 50),
    FD(NOTE_B, 6, 57),
    FD(NOTE_B, 3, 107),
    FD(NOTE_A, 3, 107),
    FD(NOTE_G, 3, 107),
    FD(NOTE_FS, 3, 107),
    /* Events 369-384 */
    FD(NOTE_E, 3, 429),
    FD(NOTE_G, 6, 214),
    FD(NOTE_E, 6, 214),
    FD(NOTE_G, 6, 429),
    FD(NOTE_FS, 6, 429),
    FD(NOTE_DS, 6, 429),
    FD(NOTE_E, 6, 429),
    FD(NOTE_D, 6, 857),
    FD(NOTE_CS, 6, 857),
    FD(NOTE_C, 7, 857),
    FD(NOTE_B, 6, 214),
    FD(NOTE_E, 6, 214),
    FD(NOTE_C, 7, 214),
    FD(NOTE_E, 6, 214),
    FD(NOTE_B, 6, 429),
    FD(NOTE_E, 4, 107),
    /* Events 385-400 */
    FD(NOTE_D, 4, 107),
    FD(NOTE_C, 4, 107),
    FD(NOTE_B, 3, 107),
    FD(NOTE_AS, 3, 429),
    FD(NOTE_G, 6, 214),
    FD(NOTE_E, 6, 214),
    FD(NOTE_G, 6, 429),
    FD(NOTE_FS, 6, 429),
    FD(NOTE_C, 7, 429),
    FD(NOTE_B, 6, 429),
    FD(NOTE_G, 6, 857),
    FD(NOTE_FS, 6, 857),
    FD(NOTE_E, 6, 857),
    FD(NOTE_DS, 6, 214),
    FD(NOTE_FS, 6, 214),
    FD(NOTE_E, 6, 214),
    /* Events 401-416 */
    FD(NOTE_FS, 6, 214),
    FD(NOTE_DS, 6, 429),
    FD(NOTE_B, 4, 107),
    FD(NOTE_A, 4, 107),
    FD(NOTE_G, 4, 107),
    FD(NOTE_FS, 4, 107),
    FD(NOTE_E, 4, 429),
    FD(NOTE_G, 6, 214),
    FD(NOTE_E, 6, 214),
    FD(NOTE_G, 6, 429),
    FD(NOTE_FS, 6, 429),
    FD(NOTE_DS, 6, 429),
    FD(NOTE_E, 6, 429),
    FD(NOTE_D, 6, 857),
    FD(NOTE_CS, 6, 857),
    FD(NOTE_C, 7, 857),
    /* Events 417-432 */
    FD(NOTE_B, 6, 214),
    FD(NOTE_E, 6, 214),
    FD(NOTE_C, 7, 214),
    FD(NOTE_E, 6, 214),
    FD(NOTE_B, 6, 429),
    FD(NOTE_G, 5, 107),
    FD(NOTE_FS, 5, 107),
    FD(NOTE_E, 5, 107),
    FD(NOTE_D, 5, 107),
    FD(NOTE_CS, 5, 429),
    FD(NOTE_E, 6, 214),
    FD(NOTE_CS, 6, 214),
    FD(NOTE_E, 6, 429),
    FD(NOTE_DS, 6, 107),
    FD(NOTE_E, 5, 107),
    FD(NOTE_DS, 5, 107),
    /* Events 433-448 */
    FD(NOTE_CS, 5, 107),
    FD(NOTE_B, 4, 429),
    FD(NOTE_D, 6, 214),
    FD(NOTE_B, 6, 214),
    FD(NOTE_D, 6, 429),
    FD(NOTE_CS, 6, 107),
    FD(NOTE_D, 5, 107),
    FD(NOTE_CS, 5, 107),
    FD(NOTE_B, 4, 107),
    FD(NOTE_A, 4, 429),
    FD(NOTE_C, 7, 214),
    FD(NOTE_A, 6, 214),
    FD(NOTE_C, 7, 429),
    FD(NOTE_B, 6, 107),
    FD(NOTE_C, 5, 107),
    FD(NOTE_B, 4, 107),
    /* Events 449-455 */
    FD(NOTE_A, 4, 107),
    FD(NOTE_B, 4, 429),
    FD(NOTE_B, 6, 107),
    FD(NOTE_DS, 6, 107),
    FD(NOTE_FS, 6, 107),
    FD(NOTE_B, 6, 107),
    FD(NOTE_E, 6, 858)
};

#undef FD_R
#undef FD
