/*
 * Tchaikovsky - Dance of the Sugar Plum Fairy.
 * Single-line PWM buzzer reduction generated from PiaStudy 21qqYUXk2Ak space.json.
 * The source is the PiaStudy timestamp/space data matching the
 * provided 12-page Presto agitato PDF. Each visible playback onset
 * contributes one buzzer tone, so moving accompaniment is preserved
 * instead of being hidden under long held notes.
 * Simultaneous notes are reduced upper-voice first, but repeated
 * top notes fall through to another chord tone when that exposes
 * motion that would otherwise sound like a tied note.
 * Notes outside the practical buzzer range are folded by octaves into C3-C7.
 * 493 events, about 91 seconds.
 */
#define SPF(note, octave, ms) {note, octave, (uint16_t)(ms)}
#define SPF_R(ms) {NOTE_REST, 0, (uint16_t)(ms)}

const Tone_t SUGAR_PLUM_FAIRY[] = {
    /* Events 1-16 */
    SPF(NOTE_E, 3, 429),
    SPF(NOTE_E, 4, 428),
    SPF(NOTE_E, 3, 429),
    SPF(NOTE_FS, 4, 428),
    SPF(NOTE_E, 3, 429),
    SPF(NOTE_G, 4, 428),
    SPF(NOTE_E, 3, 429),
    SPF(NOTE_DS, 4, 429),
    SPF(NOTE_E, 3, 428),
    SPF(NOTE_E, 4, 429),
    SPF(NOTE_E, 3, 428),
    SPF(NOTE_FS, 4, 429),
    SPF(NOTE_E, 3, 428),
    SPF(NOTE_G, 4, 429),
    SPF(NOTE_E, 3, 429),
    SPF(NOTE_DS, 4, 428),
    /* Events 17-32 */
    SPF(NOTE_E, 3, 429),
    SPF(NOTE_G, 6, 214),
    SPF(NOTE_E, 6, 214),
    SPF(NOTE_G, 6, 429),
    SPF(NOTE_FS, 6, 428),
    SPF(NOTE_DS, 6, 429),
    SPF(NOTE_E, 6, 429),
    SPF(NOTE_D, 6, 214),
    SPF(NOTE_GS, 5, 214),
    SPF(NOTE_D, 6, 429),
    SPF(NOTE_CS, 6, 214),
    SPF(NOTE_AS, 5, 214),
    SPF(NOTE_CS, 6, 429),
    SPF(NOTE_C, 6, 214),
    SPF(NOTE_A, 5, 214),
    SPF(NOTE_C, 6, 429),
    /* Events 33-48 */
    SPF(NOTE_B, 5, 214),
    SPF(NOTE_E, 6, 214),
    SPF(NOTE_C, 6, 214),
    SPF(NOTE_E, 6, 214),
    SPF(NOTE_B, 5, 429),
    SPF(NOTE_E, 3, 107),
    SPF(NOTE_D, 3, 107),
    SPF(NOTE_C, 3, 107),
    SPF(NOTE_B, 3, 107),
    SPF(NOTE_AS, 3, 429),
    SPF(NOTE_G, 5, 214),
    SPF(NOTE_E, 5, 214),
    SPF(NOTE_G, 5, 429),
    SPF(NOTE_FS, 5, 429),
    SPF(NOTE_C, 6, 428),
    SPF(NOTE_B, 5, 429),
    /* Events 49-64 */
    SPF(NOTE_G, 6, 214),
    SPF(NOTE_E, 6, 214),
    SPF(NOTE_G, 6, 429),
    SPF(NOTE_FS, 6, 214),
    SPF(NOTE_D, 6, 214),
    SPF(NOTE_FS, 6, 429),
    SPF(NOTE_E, 6, 214),
    SPF(NOTE_CS, 6, 214),
    SPF(NOTE_E, 6, 428),
    SPF(NOTE_DS, 6, 214),
    SPF(NOTE_FS, 6, 214),
    SPF(NOTE_E, 6, 214),
    SPF(NOTE_FS, 6, 214),
    SPF(NOTE_DS, 6, 429),
    SPF(NOTE_B, 3, 107),
    SPF(NOTE_A, 3, 107),
    /* Events 65-80 */
    SPF(NOTE_G, 3, 107),
    SPF(NOTE_FS, 3, 107),
    SPF(NOTE_E, 3, 429),
    SPF(NOTE_G, 6, 214),
    SPF(NOTE_E, 6, 214),
    SPF(NOTE_G, 6, 428),
    SPF(NOTE_FS, 6, 429),
    SPF(NOTE_DS, 6, 428),
    SPF(NOTE_E, 6, 429),
    SPF(NOTE_D, 6, 214),
    SPF(NOTE_GS, 5, 214),
    SPF(NOTE_D, 6, 429),
    SPF(NOTE_CS, 6, 214),
    SPF(NOTE_AS, 5, 214),
    SPF(NOTE_CS, 6, 428),
    SPF(NOTE_C, 6, 214),
    /* Events 81-96 */
    SPF(NOTE_A, 5, 214),
    SPF(NOTE_C, 6, 428),
    SPF(NOTE_B, 5, 214),
    SPF(NOTE_E, 6, 214),
    SPF(NOTE_C, 6, 214),
    SPF(NOTE_E, 6, 214),
    SPF(NOTE_B, 5, 429),
    SPF(NOTE_G, 4, 107),
    SPF(NOTE_FS, 4, 107),
    SPF(NOTE_E, 4, 107),
    SPF(NOTE_D, 4, 107),
    SPF(NOTE_CS, 4, 428),
    SPF(NOTE_E, 5, 214),
    SPF(NOTE_CS, 5, 214),
    SPF(NOTE_E, 5, 428),
    SPF(NOTE_DS, 5, 107),
    /* Events 97-112 */
    SPF(NOTE_E, 4, 107),
    SPF(NOTE_DS, 4, 107),
    SPF(NOTE_CS, 4, 107),
    SPF(NOTE_B, 3, 428),
    SPF(NOTE_D, 5, 214),
    SPF(NOTE_B, 4, 214),
    SPF(NOTE_D, 5, 429),
    SPF(NOTE_CS, 5, 107),
    SPF(NOTE_D, 4, 107),
    SPF(NOTE_CS, 4, 107),
    SPF(NOTE_B, 3, 107),
    SPF(NOTE_A, 3, 429),
    SPF(NOTE_C, 5, 214),
    SPF(NOTE_A, 4, 214),
    SPF(NOTE_C, 5, 429),
    SPF(NOTE_B, 4, 107),
    /* Events 113-128 */
    SPF(NOTE_C, 4, 107),
    SPF(NOTE_B, 3, 107),
    SPF(NOTE_A, 3, 107),
    SPF(NOTE_G, 3, 429),
    SPF(NOTE_B, 4, 107),
    SPF(NOTE_DS, 5, 107),
    SPF(NOTE_FS, 5, 107),
    SPF(NOTE_B, 5, 107),
    SPF(NOTE_E, 5, 428),
    SPF(NOTE_B, 3, 429),
    SPF(NOTE_CS, 4, 214),
    SPF(NOTE_CS, 5, 214),
    SPF(NOTE_DS, 4, 214),
    SPF(NOTE_DS, 5, 214),
    SPF(NOTE_E, 4, 214),
    SPF(NOTE_E, 5, 214),
    /* Events 129-144 */
    SPF(NOTE_FS, 4, 214),
    SPF(NOTE_FS, 5, 214),
    SPF(NOTE_G, 4, 214),
    SPF(NOTE_G, 5, 214),
    SPF(NOTE_E, 4, 214),
    SPF(NOTE_E, 5, 214),
    SPF(NOTE_DS, 4, 214),
    SPF(NOTE_DS, 5, 214),
    SPF(NOTE_B, 3, 143),
    SPF(NOTE_CS, 4, 142),
    SPF(NOTE_B, 3, 143),
    SPF(NOTE_A, 3, 143),
    SPF(NOTE_G, 3, 143),
    SPF(NOTE_A, 3, 143),
    SPF(NOTE_G, 3, 143),
    SPF(NOTE_B, 3, 143),
    /* Events 145-160 */
    SPF(NOTE_G, 3, 142),
    SPF(NOTE_B, 3, 143),
    SPF(NOTE_G, 3, 143),
    SPF(NOTE_B, 3, 143),
    SPF(NOTE_G, 3, 143),
    SPF(NOTE_B, 3, 143),
    SPF(NOTE_A, 3, 143),
    SPF(NOTE_G, 3, 142),
    SPF(NOTE_FS, 3, 143),
    SPF(NOTE_A, 3, 143),
    SPF(NOTE_FS, 3, 143),
    SPF(NOTE_A, 3, 143),
    SPF(NOTE_FS, 3, 143),
    SPF(NOTE_A, 3, 143),
    SPF(NOTE_FS, 3, 142),
    SPF(NOTE_A, 3, 143),
    /* Events 161-176 */
    SPF(NOTE_B, 3, 429),
    SPF(NOTE_CS, 4, 214),
    SPF(NOTE_CS, 5, 214),
    SPF(NOTE_DS, 4, 214),
    SPF(NOTE_DS, 5, 214),
    SPF(NOTE_E, 4, 214),
    SPF(NOTE_E, 5, 214),
    SPF(NOTE_FS, 4, 214),
    SPF(NOTE_FS, 5, 214),
    SPF(NOTE_G, 4, 214),
    SPF(NOTE_G, 5, 214),
    SPF(NOTE_E, 4, 214),
    SPF(NOTE_E, 5, 214),
    SPF(NOTE_DS, 4, 214),
    SPF(NOTE_DS, 5, 214),
    SPF(NOTE_B, 3, 143),
    /* Events 177-192 */
    SPF(NOTE_CS, 4, 143),
    SPF(NOTE_B, 3, 142),
    SPF(NOTE_A, 3, 143),
    SPF(NOTE_G, 3, 143),
    SPF(NOTE_B, 3, 143),
    SPF(NOTE_G, 3, 143),
    SPF(NOTE_B, 3, 143),
    SPF(NOTE_G, 3, 143),
    SPF(NOTE_B, 3, 142),
    SPF(NOTE_G, 3, 143),
    SPF(NOTE_B, 3, 143),
    SPF(NOTE_G, 3, 143),
    SPF(NOTE_B, 3, 143),
    SPF(NOTE_A, 3, 143),
    SPF(NOTE_G, 3, 143),
    SPF(NOTE_FS, 3, 142),
    /* Events 193-208 */
    SPF(NOTE_A, 3, 143),
    SPF(NOTE_FS, 3, 143),
    SPF(NOTE_A, 3, 143),
    SPF(NOTE_FS, 3, 143),
    SPF(NOTE_A, 3, 143),
    SPF(NOTE_FS, 3, 143),
    SPF(NOTE_A, 3, 142),
    SPF(NOTE_B, 3, 429),
    SPF(NOTE_CS, 4, 214),
    SPF(NOTE_CS, 5, 214),
    SPF(NOTE_DS, 4, 214),
    SPF(NOTE_DS, 5, 214),
    SPF(NOTE_E, 4, 214),
    SPF(NOTE_E, 5, 214),
    SPF(NOTE_B, 3, 428),
    SPF(NOTE_DS, 4, 214),
    /* Events 209-224 */
    SPF(NOTE_DS, 5, 214),
    SPF(NOTE_E, 4, 214),
    SPF(NOTE_E, 5, 214),
    SPF(NOTE_FS, 4, 214),
    SPF(NOTE_FS, 5, 214),
    SPF(NOTE_B, 3, 429),
    SPF(NOTE_E, 4, 214),
    SPF(NOTE_E, 5, 214),
    SPF(NOTE_FS, 4, 214),
    SPF(NOTE_FS, 5, 214),
    SPF(NOTE_G, 4, 214),
    SPF(NOTE_G, 5, 214),
    SPF(NOTE_G, 4, 215),
    SPF(NOTE_G, 5, 214),
    SPF(NOTE_A, 5, 214),
    SPF(NOTE_E, 5, 214),
    /* Events 225-240 */
    SPF(NOTE_B, 3, 215),
    SPF(NOTE_A, 5, 214),
    SPF(NOTE_B, 5, 429),
    SPF(NOTE_D, 4, 53),
    SPF(NOTE_FS, 4, 54),
    SPF(NOTE_A, 4, 53),
    SPF(NOTE_C, 5, 54),
    SPF(NOTE_D, 5, 53),
    SPF(NOTE_FS, 5, 54),
    SPF(NOTE_A, 5, 54),
    SPF(NOTE_C, 6, 53),
    SPF(NOTE_DS, 4, 54),
    SPF(NOTE_FS, 4, 53),
    SPF(NOTE_B, 4, 54),
    SPF(NOTE_DS, 5, 53),
    SPF(NOTE_DS, 5, 54),
    /* Events 241-256 */
    SPF(NOTE_FS, 5, 54),
    SPF(NOTE_A, 5, 53),
    SPF(NOTE_B, 5, 54),
    SPF(NOTE_FS, 4, 53),
    SPF(NOTE_A, 4, 54),
    SPF(NOTE_C, 5, 53),
    SPF(NOTE_E, 5, 54),
    SPF(NOTE_D, 5, 54),
    SPF(NOTE_FS, 5, 53),
    SPF(NOTE_A, 5, 54),
    SPF(NOTE_C, 6, 53),
    SPF(NOTE_DS, 4, 54),
    SPF(NOTE_FS, 4, 53),
    SPF(NOTE_B, 4, 54),
    SPF(NOTE_DS, 5, 54),
    SPF(NOTE_DS, 5, 53),
    /* Events 257-272 */
    SPF(NOTE_FS, 5, 54),
    SPF(NOTE_A, 5, 53),
    SPF(NOTE_B, 5, 54),
    SPF(NOTE_A, 4, 53),
    SPF(NOTE_C, 5, 54),
    SPF(NOTE_DS, 5, 54),
    SPF(NOTE_G, 5, 53),
    SPF(NOTE_FS, 5, 54),
    SPF(NOTE_A, 5, 53),
    SPF(NOTE_C, 6, 54),
    SPF(NOTE_E, 6, 53),
    SPF(NOTE_DS, 4, 54),
    SPF(NOTE_FS, 4, 54),
    SPF(NOTE_A, 4, 53),
    SPF(NOTE_B, 4, 54),
    SPF(NOTE_DS, 5, 53),
    /* Events 273-288 */
    SPF(NOTE_FS, 5, 54),
    SPF(NOTE_A, 5, 53),
    SPF(NOTE_B, 5, 54),
    SPF(NOTE_D, 4, 54),
    SPF(NOTE_FS, 4, 53),
    SPF(NOTE_A, 4, 54),
    SPF(NOTE_C, 5, 53),
    SPF(NOTE_D, 5, 54),
    SPF(NOTE_FS, 5, 53),
    SPF(NOTE_A, 5, 54),
    SPF(NOTE_C, 6, 54),
    SPF(NOTE_FS, 4, 53),
    SPF(NOTE_A, 4, 54),
    SPF(NOTE_B, 4, 53),
    SPF(NOTE_D, 5, 54),
    SPF(NOTE_DS, 5, 53),
    /* Events 289-304 */
    SPF(NOTE_FS, 5, 54),
    SPF(NOTE_A, 5, 54),
    SPF(NOTE_B, 5, 53),
    SPF(NOTE_FS, 4, 54),
    SPF(NOTE_A, 4, 53),
    SPF(NOTE_C, 5, 54),
    SPF(NOTE_E, 5, 53),
    SPF(NOTE_FS, 5, 54),
    SPF(NOTE_A, 5, 54),
    SPF(NOTE_C, 6, 53),
    SPF(NOTE_E, 6, 54),
    SPF(NOTE_FS, 4, 53),
    SPF(NOTE_A, 4, 54),
    SPF(NOTE_B, 4, 53),
    SPF(NOTE_DS, 5, 54),
    SPF(NOTE_DS, 6, 54),
    /* Events 305-320 */
    SPF(NOTE_FS, 6, 53),
    SPF(NOTE_A, 6, 54),
    SPF(NOTE_DS, 6, 53),
    SPF(NOTE_FS, 4, 54),
    SPF(NOTE_A, 4, 53),
    SPF(NOTE_C, 5, 54),
    SPF(NOTE_E, 5, 54),
    SPF(NOTE_FS, 6, 53),
    SPF(NOTE_A, 6, 54),
    SPF(NOTE_C, 7, 53),
    SPF(NOTE_E, 6, 54),
    SPF(NOTE_FS, 4, 53),
    SPF(NOTE_A, 4, 54),
    SPF(NOTE_B, 4, 54),
    SPF(NOTE_DS, 5, 53),
    SPF(NOTE_FS, 6, 54),
    /* Events 321-336 */
    SPF(NOTE_A, 6, 53),
    SPF(NOTE_B, 6, 54),
    SPF(NOTE_DS, 6, 53),
    SPF(NOTE_A, 4, 54),
    SPF(NOTE_C, 5, 54),
    SPF(NOTE_DS, 5, 53),
    SPF(NOTE_G, 5, 54),
    SPF(NOTE_A, 5, 53),
    SPF(NOTE_C, 6, 54),
    SPF(NOTE_DS, 6, 53),
    SPF(NOTE_G, 6, 54),
    SPF(NOTE_B, 4, 71),
    SPF(NOTE_DS, 5, 71),
    SPF(NOTE_FS, 5, 71),
    SPF(NOTE_B, 5, 71),
    SPF(NOTE_DS, 6, 71),
    /* Events 337-352 */
    SPF(NOTE_FS, 6, 71),
    SPF(NOTE_A, 4, 53),
    SPF(NOTE_C, 5, 54),
    SPF(NOTE_DS, 5, 53),
    SPF(NOTE_G, 5, 54),
    SPF(NOTE_A, 5, 53),
    SPF(NOTE_C, 6, 54),
    SPF(NOTE_DS, 6, 54),
    SPF(NOTE_G, 6, 53),
    SPF(NOTE_B, 4, 71),
    SPF(NOTE_DS, 5, 71),
    SPF(NOTE_FS, 5, 71),
    SPF(NOTE_B, 5, 71),
    SPF(NOTE_DS, 6, 71),
    SPF(NOTE_FS, 6, 71),
    SPF(NOTE_D, 5, 53),
    /* Events 353-368 */
    SPF(NOTE_FS, 5, 54),
    SPF(NOTE_A, 5, 53),
    SPF(NOTE_C, 6, 54),
    SPF(NOTE_D, 6, 54),
    SPF(NOTE_FS, 6, 53),
    SPF(NOTE_A, 6, 54),
    SPF(NOTE_C, 7, 53),
    SPF(NOTE_DS, 5, 54),
    SPF(NOTE_A, 5, 53),
    SPF(NOTE_C, 6, 54),
    SPF(NOTE_D, 6, 54),
    SPF(NOTE_DS, 6, 53),
    SPF(NOTE_A, 6, 54),
    SPF(NOTE_C, 7, 53),
    SPF(NOTE_D, 6, 54),
    SPF(NOTE_D, 5, 53),
    /* Events 369-384 */
    SPF(NOTE_FS, 5, 54),
    SPF(NOTE_A, 5, 54),
    SPF(NOTE_C, 6, 53),
    SPF(NOTE_D, 6, 54),
    SPF(NOTE_FS, 6, 53),
    SPF(NOTE_A, 6, 54),
    SPF(NOTE_C, 7, 53),
    SPF(NOTE_D, 5, 54),
    SPF(NOTE_FS, 5, 54),
    SPF(NOTE_A, 5, 53),
    SPF(NOTE_B, 5, 54),
    SPF(NOTE_DS, 6, 53),
    SPF(NOTE_FS, 6, 54),
    SPF(NOTE_A, 6, 53),
    SPF(NOTE_B, 6, 54),
    SPF(NOTE_B, 3, 107),
    /* Events 385-400 */
    SPF(NOTE_A, 3, 107),
    SPF(NOTE_G, 3, 107),
    SPF(NOTE_FS, 3, 107),
    SPF(NOTE_E, 3, 428),
    SPF(NOTE_G, 6, 214),
    SPF(NOTE_E, 6, 214),
    SPF(NOTE_G, 6, 428),
    SPF(NOTE_FS, 6, 429),
    SPF(NOTE_DS, 6, 428),
    SPF(NOTE_E, 6, 429),
    SPF(NOTE_D, 6, 214),
    SPF(NOTE_GS, 5, 214),
    SPF(NOTE_D, 6, 428),
    SPF(NOTE_CS, 6, 214),
    SPF(NOTE_AS, 5, 214),
    SPF(NOTE_CS, 6, 428),
    /* Events 401-416 */
    SPF(NOTE_C, 6, 214),
    SPF(NOTE_A, 5, 214),
    SPF(NOTE_C, 6, 428),
    SPF(NOTE_B, 6, 214),
    SPF(NOTE_E, 6, 214),
    SPF(NOTE_C, 7, 214),
    SPF(NOTE_E, 6, 214),
    SPF(NOTE_B, 6, 428),
    SPF(NOTE_E, 4, 107),
    SPF(NOTE_D, 4, 107),
    SPF(NOTE_C, 4, 107),
    SPF(NOTE_B, 3, 107),
    SPF(NOTE_AS, 3, 428),
    SPF(NOTE_G, 6, 214),
    SPF(NOTE_E, 6, 214),
    SPF(NOTE_G, 6, 428),
    /* Events 417-432 */
    SPF(NOTE_FS, 6, 429),
    SPF(NOTE_C, 7, 429),
    SPF(NOTE_B, 6, 428),
    SPF(NOTE_G, 6, 214),
    SPF(NOTE_E, 6, 214),
    SPF(NOTE_G, 6, 428),
    SPF(NOTE_FS, 6, 214),
    SPF(NOTE_D, 6, 214),
    SPF(NOTE_FS, 6, 428),
    SPF(NOTE_E, 6, 214),
    SPF(NOTE_CS, 6, 214),
    SPF(NOTE_E, 6, 429),
    SPF(NOTE_DS, 6, 214),
    SPF(NOTE_FS, 6, 214),
    SPF(NOTE_E, 6, 214),
    SPF(NOTE_FS, 6, 214),
    /* Events 433-448 */
    SPF(NOTE_DS, 6, 428),
    SPF(NOTE_B, 4, 107),
    SPF(NOTE_A, 4, 107),
    SPF(NOTE_G, 4, 107),
    SPF(NOTE_FS, 4, 107),
    SPF(NOTE_E, 4, 428),
    SPF(NOTE_G, 6, 214),
    SPF(NOTE_E, 6, 214),
    SPF(NOTE_G, 6, 429),
    SPF(NOTE_FS, 6, 428),
    SPF(NOTE_DS, 6, 429),
    SPF(NOTE_E, 6, 428),
    SPF(NOTE_D, 6, 214),
    SPF(NOTE_GS, 6, 214),
    SPF(NOTE_D, 6, 428),
    SPF(NOTE_CS, 6, 214),
    /* Events 449-464 */
    SPF(NOTE_AS, 6, 214),
    SPF(NOTE_CS, 6, 429),
    SPF(NOTE_C, 7, 214),
    SPF(NOTE_A, 6, 214),
    SPF(NOTE_C, 7, 429),
    SPF(NOTE_B, 6, 214),
    SPF(NOTE_E, 6, 214),
    SPF(NOTE_C, 7, 215),
    SPF(NOTE_E, 6, 214),
    SPF(NOTE_B, 6, 428),
    SPF(NOTE_G, 5, 107),
    SPF(NOTE_FS, 5, 107),
    SPF(NOTE_E, 5, 107),
    SPF(NOTE_D, 5, 107),
    SPF(NOTE_CS, 5, 429),
    SPF(NOTE_E, 6, 214),
    /* Events 465-480 */
    SPF(NOTE_CS, 6, 214),
    SPF(NOTE_E, 6, 429),
    SPF(NOTE_DS, 6, 107),
    SPF(NOTE_E, 5, 107),
    SPF(NOTE_DS, 5, 107),
    SPF(NOTE_CS, 5, 107),
    SPF(NOTE_B, 4, 429),
    SPF(NOTE_D, 6, 214),
    SPF(NOTE_B, 6, 214),
    SPF(NOTE_D, 6, 429),
    SPF(NOTE_CS, 6, 107),
    SPF(NOTE_D, 5, 107),
    SPF(NOTE_CS, 5, 107),
    SPF(NOTE_B, 4, 107),
    SPF(NOTE_A, 4, 428),
    SPF(NOTE_C, 7, 214),
    /* Events 481-493 */
    SPF(NOTE_A, 6, 214),
    SPF(NOTE_C, 7, 428),
    SPF(NOTE_B, 6, 107),
    SPF(NOTE_C, 5, 107),
    SPF(NOTE_B, 4, 107),
    SPF(NOTE_A, 4, 107),
    SPF(NOTE_B, 4, 428),
    SPF(NOTE_B, 6, 107),
    SPF(NOTE_DS, 6, 107),
    SPF(NOTE_FS, 6, 107),
    SPF(NOTE_B, 6, 107),
    SPF(NOTE_E, 6, 429),
    SPF(NOTE_B, 5, 429)
};

#undef SPF_R
#undef SPF
