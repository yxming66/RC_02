/*
 * Maksim Mrvica - Croatian Rhapsody.
 * Single-line PWM buzzer reduction generated from PiaStudy 1hLQ3PQj04n MIDI.
 * The right-hand line is preferred at simultaneous onsets; bass notes
 * are folded by octaves into the practical buzzer range.
 * 1072 events, about 207 seconds.
 */
#define FD(note, octave, ms) {note, octave, (uint16_t)(ms)}
#define FD_R(ms) {NOTE_REST, 0, (uint16_t)(ms)}

const Tone_t CROATIAN_RHAPSODY[] = {
    /* Events 1-16 */
    FD(NOTE_G, 4, 2500),
    FD(NOTE_G, 6, 156),
    FD(NOTE_DS, 6, 156),
    FD(NOTE_C, 6, 313),
    FD(NOTE_G, 6, 156),
    FD(NOTE_DS, 6, 156),
    FD(NOTE_C, 6, 469),
    FD(NOTE_GS, 5, 156),
    FD(NOTE_F, 5, 313),
    FD(NOTE_C, 6, 156),
    FD(NOTE_GS, 5, 156),
    FD(NOTE_F, 5, 313),
    FD(NOTE_D, 6, 156),
    FD(NOTE_B, 5, 156),
    FD(NOTE_G, 5, 313),
    FD(NOTE_D, 6, 313),
    /* Events 17-32 */
    FD(NOTE_G, 5, 156),
    FD(NOTE_DS, 5, 156),
    FD(NOTE_C, 5, 313),
    FD(NOTE_G, 5, 156),
    FD(NOTE_DS, 5, 156),
    FD(NOTE_C, 5, 625),
    FD(NOTE_G, 6, 156),
    FD(NOTE_DS, 6, 156),
    FD(NOTE_C, 6, 313),
    FD(NOTE_G, 6, 156),
    FD(NOTE_DS, 6, 156),
    FD(NOTE_G, 6, 156),
    FD(NOTE_C, 6, 312),
    FD(NOTE_GS, 5, 156),
    FD(NOTE_F, 5, 313),
    FD(NOTE_C, 6, 156),
    /* Events 33-48 */
    FD(NOTE_GS, 5, 156),
    FD(NOTE_C, 6, 156),
    FD(NOTE_F, 5, 156),
    FD(NOTE_D, 6, 156),
    FD(NOTE_B, 5, 156),
    FD(NOTE_G, 5, 313),
    FD(NOTE_D, 6, 313),
    FD(NOTE_G, 5, 156),
    FD(NOTE_DS, 5, 156),
    FD(NOTE_C, 5, 313),
    FD(NOTE_G, 5, 156),
    FD(NOTE_DS, 5, 156),
    FD(NOTE_C, 5, 625),
    FD(NOTE_G, 5, 156),
    FD(NOTE_DS, 5, 156),
    FD(NOTE_C, 5, 625),
    /* Events 49-64 */
    FD(NOTE_G, 5, 156),
    FD(NOTE_C, 5, 156),
    FD(NOTE_G, 5, 156),
    FD(NOTE_DS, 5, 156),
    FD(NOTE_C, 5, 625),
    FD(NOTE_G, 5, 156),
    FD(NOTE_C, 5, 156),
    FD(NOTE_G, 5, 156),
    FD(NOTE_DS, 5, 156),
    FD(NOTE_C, 5, 313),
    FD(NOTE_G, 5, 313),
    FD(NOTE_B, 4, 156),
    FD(NOTE_G, 5, 156),
    FD(NOTE_C, 3, 313),
    FD(NOTE_G, 5, 156),
    FD(NOTE_DS, 5, 156),
    /* Events 65-80 */
    FD(NOTE_C, 5, 625),
    FD(NOTE_G, 5, 156),
    FD(NOTE_DS, 5, 156),
    FD(NOTE_C, 5, 625),
    FD(NOTE_G, 5, 156),
    FD(NOTE_C, 5, 156),
    FD(NOTE_G, 5, 156),
    FD(NOTE_DS, 5, 156),
    FD(NOTE_C, 5, 625),
    FD(NOTE_G, 5, 156),
    FD(NOTE_C, 5, 156),
    FD(NOTE_G, 5, 156),
    FD(NOTE_DS, 5, 156),
    FD(NOTE_C, 5, 313),
    FD(NOTE_G, 5, 313),
    FD(NOTE_B, 4, 156),
    /* Events 81-96 */
    FD(NOTE_G, 5, 156),
    FD(NOTE_C, 3, 313),
    FD(NOTE_G, 5, 156),
    FD(NOTE_DS, 5, 156),
    FD(NOTE_C, 5, 625),
    FD(NOTE_G, 5, 156),
    FD(NOTE_DS, 5, 156),
    FD(NOTE_C, 5, 313),
    FD(NOTE_C, 4, 313),
    FD(NOTE_G, 5, 156),
    FD(NOTE_C, 5, 312),
    FD(NOTE_GS, 4, 156),
    FD(NOTE_F, 4, 313),
    FD(NOTE_F, 3, 625),
    FD(NOTE_D, 5, 156),
    FD(NOTE_B, 4, 156),
    /* Events 97-112 */
    FD(NOTE_G, 4, 313),
    FD(NOTE_D, 5, 313),
    FD(NOTE_G, 4, 156),
    FD(NOTE_DS, 4, 156),
    FD(NOTE_C, 4, 313),
    FD(NOTE_G, 4, 156),
    FD(NOTE_DS, 4, 156),
    FD(NOTE_C, 4, 625),
    FD(NOTE_G, 5, 156),
    FD(NOTE_DS, 5, 156),
    FD(NOTE_C, 5, 313),
    FD(NOTE_C, 4, 313),
    FD(NOTE_G, 5, 156),
    FD(NOTE_C, 5, 312),
    FD(NOTE_GS, 4, 156),
    FD(NOTE_F, 4, 313),
    /* Events 113-128 */
    FD(NOTE_F, 3, 625),
    FD(NOTE_D, 5, 156),
    FD(NOTE_B, 4, 156),
    FD(NOTE_G, 4, 313),
    FD(NOTE_D, 5, 313),
    FD(NOTE_G, 4, 156),
    FD(NOTE_DS, 4, 156),
    FD(NOTE_C, 4, 313),
    FD(NOTE_G, 4, 156),
    FD(NOTE_DS, 4, 156),
    FD(NOTE_C, 4, 625),
    FD(NOTE_G, 4, 156),
    FD(NOTE_DS, 4, 156),
    FD(NOTE_C, 4, 156),
    FD(NOTE_C, 3, 156),
    FD(NOTE_C, 4, 156),
    /* Events 129-144 */
    FD(NOTE_G, 3, 156),
    FD(NOTE_G, 4, 156),
    FD(NOTE_C, 4, 156),
    FD(NOTE_G, 4, 156),
    FD(NOTE_DS, 4, 156),
    FD(NOTE_C, 4, 156),
    FD(NOTE_F, 3, 312),
    FD(NOTE_C, 3, 156),
    FD(NOTE_G, 4, 156),
    FD(NOTE_C, 4, 156),
    FD(NOTE_G, 4, 156),
    FD(NOTE_DS, 4, 156),
    FD(NOTE_C, 4, 313),
    FD(NOTE_G, 4, 313),
    FD(NOTE_B, 3, 156),
    FD(NOTE_C, 4, 156),
    /* Events 145-160 */
    FD(NOTE_C, 3, 313),
    FD(NOTE_G, 4, 156),
    FD(NOTE_DS, 4, 156),
    FD(NOTE_C, 4, 625),
    FD(NOTE_G, 4, 156),
    FD(NOTE_DS, 4, 156),
    FD(NOTE_C, 4, 156),
    FD(NOTE_C, 3, 156),
    FD(NOTE_C, 4, 156),
    FD(NOTE_G, 3, 156),
    FD(NOTE_G, 4, 156),
    FD(NOTE_C, 4, 156),
    FD(NOTE_G, 4, 156),
    FD(NOTE_DS, 4, 156),
    FD(NOTE_C, 4, 156),
    FD(NOTE_F, 3, 312),
    /* Events 161-176 */
    FD(NOTE_C, 3, 156),
    FD(NOTE_G, 4, 156),
    FD(NOTE_C, 4, 156),
    FD(NOTE_G, 4, 156),
    FD(NOTE_DS, 4, 156),
    FD(NOTE_C, 4, 313),
    FD(NOTE_G, 4, 313),
    FD(NOTE_B, 3, 156),
    FD(NOTE_C, 4, 156),
    FD(NOTE_C, 3, 313),
    FD(NOTE_G, 4, 156),
    FD(NOTE_DS, 4, 156),
    FD(NOTE_C, 4, 625),
    FD(NOTE_DS, 5, 156),
    FD(NOTE_G, 4, 156),
    FD(NOTE_C, 5, 156),
    /* Events 177-192 */
    FD(NOTE_D, 5, 156),
    FD(NOTE_DS, 5, 156),
    FD(NOTE_G, 4, 156),
    FD(NOTE_C, 5, 156),
    FD(NOTE_DS, 5, 156),
    FD(NOTE_F, 5, 156),
    FD(NOTE_G, 4, 156),
    FD(NOTE_DS, 5, 156),
    FD(NOTE_G, 4, 156),
    FD(NOTE_D, 5, 156),
    FD(NOTE_G, 4, 156),
    FD(NOTE_C, 5, 156),
    FD(NOTE_G, 4, 156),
    FD(NOTE_D, 5, 156),
    FD(NOTE_G, 4, 156),
    FD(NOTE_B, 4, 156),
    /* Events 193-208 */
    FD(NOTE_C, 5, 156),
    FD(NOTE_D, 5, 156),
    FD(NOTE_G, 4, 156),
    FD(NOTE_B, 4, 156),
    FD(NOTE_D, 5, 156),
    FD(NOTE_DS, 5, 156),
    FD(NOTE_G, 4, 156),
    FD(NOTE_D, 5, 156),
    FD(NOTE_G, 4, 156),
    FD(NOTE_C, 5, 156),
    FD(NOTE_G, 4, 156),
    FD(NOTE_G, 5, 156),
    FD(NOTE_G, 4, 156),
    FD(NOTE_DS, 5, 156),
    FD(NOTE_G, 4, 156),
    FD(NOTE_C, 5, 156),
    /* Events 209-224 */
    FD(NOTE_D, 5, 156),
    FD(NOTE_DS, 5, 156),
    FD(NOTE_G, 4, 156),
    FD(NOTE_C, 5, 156),
    FD(NOTE_DS, 5, 156),
    FD(NOTE_F, 5, 156),
    FD(NOTE_G, 4, 156),
    FD(NOTE_DS, 5, 156),
    FD(NOTE_G, 4, 156),
    FD(NOTE_D, 5, 156),
    FD(NOTE_G, 4, 156),
    FD(NOTE_C, 5, 156),
    FD(NOTE_G, 4, 156),
    FD(NOTE_G, 5, 156),
    FD(NOTE_G, 4, 156),
    FD(NOTE_B, 4, 156),
    /* Events 225-240 */
    FD(NOTE_G, 4, 156),
    FD(NOTE_DS, 5, 156),
    FD(NOTE_G, 4, 156),
    FD(NOTE_D, 5, 156),
    FD(NOTE_G, 4, 156),
    FD(NOTE_C, 5, 156),
    FD(NOTE_G, 4, 156),
    FD(NOTE_G, 5, 156),
    FD(NOTE_G, 4, 156),
    FD(NOTE_C, 5, 625),
    FD(NOTE_DS, 6, 156),
    FD(NOTE_G, 5, 156),
    FD(NOTE_C, 6, 156),
    FD(NOTE_D, 6, 156),
    FD(NOTE_DS, 6, 156),
    FD(NOTE_G, 5, 156),
    /* Events 241-256 */
    FD(NOTE_C, 6, 156),
    FD(NOTE_DS, 6, 156),
    FD(NOTE_F, 6, 156),
    FD(NOTE_G, 5, 156),
    FD(NOTE_DS, 6, 156),
    FD(NOTE_G, 5, 156),
    FD(NOTE_D, 6, 156),
    FD(NOTE_G, 5, 156),
    FD(NOTE_C, 6, 156),
    FD(NOTE_G, 5, 156),
    FD(NOTE_D, 6, 156),
    FD(NOTE_G, 5, 156),
    FD(NOTE_B, 5, 156),
    FD(NOTE_C, 6, 156),
    FD(NOTE_D, 6, 156),
    FD(NOTE_G, 5, 156),
    /* Events 257-272 */
    FD(NOTE_B, 5, 156),
    FD(NOTE_D, 6, 156),
    FD(NOTE_DS, 6, 156),
    FD(NOTE_G, 5, 156),
    FD(NOTE_D, 6, 156),
    FD(NOTE_G, 5, 156),
    FD(NOTE_C, 6, 156),
    FD(NOTE_G, 5, 156),
    FD(NOTE_G, 6, 156),
    FD(NOTE_G, 5, 156),
    FD(NOTE_DS, 6, 156),
    FD(NOTE_G, 5, 156),
    FD(NOTE_C, 6, 156),
    FD(NOTE_D, 6, 156),
    FD(NOTE_DS, 6, 156),
    FD(NOTE_G, 5, 156),
    /* Events 273-288 */
    FD(NOTE_C, 6, 156),
    FD(NOTE_DS, 6, 156),
    FD(NOTE_F, 6, 156),
    FD(NOTE_G, 5, 156),
    FD(NOTE_DS, 6, 156),
    FD(NOTE_G, 5, 156),
    FD(NOTE_D, 6, 156),
    FD(NOTE_G, 5, 156),
    FD(NOTE_C, 6, 156),
    FD(NOTE_G, 5, 156),
    FD(NOTE_G, 6, 156),
    FD(NOTE_G, 5, 156),
    FD(NOTE_B, 5, 156),
    FD(NOTE_G, 5, 156),
    FD(NOTE_DS, 6, 156),
    FD(NOTE_G, 5, 156),
    /* Events 289-304 */
    FD(NOTE_D, 6, 156),
    FD(NOTE_G, 5, 156),
    FD(NOTE_C, 6, 156),
    FD(NOTE_G, 5, 156),
    FD(NOTE_G, 6, 156),
    FD(NOTE_G, 5, 156),
    FD(NOTE_C, 6, 625),
    FD(NOTE_G, 5, 156),
    FD(NOTE_C, 5, 156),
    FD(NOTE_DS, 5, 156),
    FD(NOTE_F, 5, 156),
    FD(NOTE_G, 5, 156),
    FD(NOTE_C, 5, 156),
    FD(NOTE_F, 5, 156),
    FD(NOTE_AS, 5, 156),
    FD(NOTE_GS, 5, 156),
    /* Events 305-320 */
    FD(NOTE_C, 5, 156),
    FD(NOTE_G, 5, 156),
    FD(NOTE_C, 5, 156),
    FD(NOTE_F, 5, 156),
    FD(NOTE_C, 5, 156),
    FD(NOTE_DS, 5, 156),
    FD(NOTE_C, 5, 156),
    FD(NOTE_F, 5, 156),
    FD(NOTE_AS, 4, 156),
    FD(NOTE_D, 5, 156),
    FD(NOTE_DS, 5, 156),
    FD(NOTE_F, 5, 156),
    FD(NOTE_AS, 4, 156),
    FD(NOTE_D, 5, 156),
    FD(NOTE_GS, 5, 156),
    FD(NOTE_G, 5, 156),
    /* Events 321-336 */
    FD(NOTE_AS, 4, 156),
    FD(NOTE_F, 5, 156),
    FD(NOTE_AS, 4, 156),
    FD(NOTE_DS, 5, 156),
    FD(NOTE_AS, 4, 156),
    FD(NOTE_D, 5, 156),
    FD(NOTE_AS, 4, 156),
    FD(NOTE_DS, 5, 156),
    FD(NOTE_GS, 4, 156),
    FD(NOTE_C, 5, 156),
    FD(NOTE_D, 5, 156),
    FD(NOTE_DS, 5, 156),
    FD(NOTE_GS, 4, 156),
    FD(NOTE_C, 5, 156),
    FD(NOTE_G, 5, 156),
    FD(NOTE_F, 5, 156),
    /* Events 337-352 */
    FD(NOTE_GS, 4, 156),
    FD(NOTE_DS, 5, 156),
    FD(NOTE_GS, 4, 156),
    FD(NOTE_D, 5, 156),
    FD(NOTE_GS, 4, 156),
    FD(NOTE_C, 5, 156),
    FD(NOTE_GS, 4, 156),
    FD(NOTE_D, 5, 313),
    FD(NOTE_G, 4, 313),
    FD(NOTE_DS, 5, 313),
    FD(NOTE_D, 5, 313),
    FD(NOTE_C, 5, 313),
    FD(NOTE_G, 5, 313),
    FD(NOTE_C, 6, 625),
    FD(NOTE_G, 5, 156),
    FD(NOTE_C, 5, 156),
    /* Events 353-368 */
    FD(NOTE_DS, 5, 156),
    FD(NOTE_F, 5, 156),
    FD(NOTE_G, 5, 156),
    FD(NOTE_C, 5, 156),
    FD(NOTE_F, 5, 156),
    FD(NOTE_AS, 5, 156),
    FD(NOTE_GS, 5, 156),
    FD(NOTE_C, 5, 156),
    FD(NOTE_G, 5, 156),
    FD(NOTE_C, 5, 156),
    FD(NOTE_GS, 5, 156),
    FD(NOTE_C, 5, 156),
    FD(NOTE_C, 6, 156),
    FD(NOTE_C, 5, 156),
    FD(NOTE_AS, 5, 156),
    FD(NOTE_D, 5, 156),
    /* Events 369-384 */
    FD(NOTE_F, 5, 156),
    FD(NOTE_C, 6, 156),
    FD(NOTE_AS, 5, 156),
    FD(NOTE_D, 5, 156),
    FD(NOTE_GS, 5, 156),
    FD(NOTE_D, 5, 156),
    FD(NOTE_G, 5, 156),
    FD(NOTE_AS, 4, 156),
    FD(NOTE_F, 5, 156),
    FD(NOTE_AS, 4, 156),
    FD(NOTE_DS, 5, 156),
    FD(NOTE_AS, 4, 156),
    FD(NOTE_D, 5, 156),
    FD(NOTE_AS, 4, 156),
    FD(NOTE_DS, 5, 156),
    FD(NOTE_GS, 4, 156),
    /* Events 385-400 */
    FD(NOTE_C, 5, 156),
    FD(NOTE_D, 5, 156),
    FD(NOTE_DS, 5, 156),
    FD(NOTE_GS, 4, 156),
    FD(NOTE_C, 5, 156),
    FD(NOTE_G, 5, 156),
    FD(NOTE_F, 5, 156),
    FD(NOTE_GS, 4, 156),
    FD(NOTE_DS, 5, 156),
    FD(NOTE_GS, 4, 156),
    FD(NOTE_D, 5, 156),
    FD(NOTE_GS, 4, 156),
    FD(NOTE_C, 5, 156),
    FD(NOTE_GS, 4, 156),
    FD(NOTE_D, 5, 156),
    FD(NOTE_G, 4, 156),
    /* Events 401-416 */
    FD(NOTE_B, 4, 156),
    FD(NOTE_D, 5, 156),
    FD(NOTE_F, 5, 156),
    FD(NOTE_B, 4, 156),
    FD(NOTE_D, 5, 156),
    FD(NOTE_F, 5, 156),
    FD(NOTE_G, 5, 156),
    FD(NOTE_D, 5, 156),
    FD(NOTE_F, 5, 156),
    FD(NOTE_G, 5, 156),
    FD(NOTE_B, 5, 156),
    FD(NOTE_F, 5, 156),
    FD(NOTE_G, 5, 156),
    FD(NOTE_B, 5, 156),
    FD(NOTE_D, 6, 156),
    FD(NOTE_G, 5, 156),
    /* Events 417-432 */
    FD(NOTE_B, 5, 156),
    FD(NOTE_D, 6, 156),
    FD(NOTE_F, 6, 156),
    FD(NOTE_B, 5, 156),
    FD(NOTE_D, 6, 156),
    FD(NOTE_F, 6, 156),
    FD(NOTE_G, 6, 156),
    FD(NOTE_D, 6, 156),
    FD(NOTE_F, 6, 156),
    FD(NOTE_G, 6, 156),
    FD(NOTE_B, 6, 156),
    FD(NOTE_F, 6, 156),
    FD(NOTE_G, 6, 156),
    FD(NOTE_B, 6, 156),
    FD(NOTE_C, 7, 156),
    FD(NOTE_DS, 3, 313),
    /* Events 433-448 */
    FD(NOTE_G, 3, 156),
    FD(NOTE_F, 3, 156),
    FD(NOTE_C, 3, 156),
    FD(NOTE_DS, 3, 156),
    FD(NOTE_D, 3, 156),
    FD(NOTE_C, 3, 156),
    FD(NOTE_DS, 3, 313),
    FD(NOTE_G, 3, 156),
    FD(NOTE_F, 3, 156),
    FD(NOTE_C, 3, 156),
    FD(NOTE_DS, 3, 156),
    FD(NOTE_D, 3, 156),
    FD(NOTE_C, 5, 156),
    FD(NOTE_DS, 5, 313),
    FD(NOTE_C, 5, 156),
    FD(NOTE_F, 5, 156),
    /* Events 449-464 */
    FD(NOTE_C, 5, 156),
    FD(NOTE_DS, 5, 156),
    FD(NOTE_AS, 4, 156),
    FD(NOTE_C, 5, 156),
    FD(NOTE_DS, 5, 313),
    FD(NOTE_C, 5, 156),
    FD(NOTE_F, 5, 156),
    FD(NOTE_C, 5, 156),
    FD(NOTE_DS, 5, 156),
    FD(NOTE_D, 3, 156),
    FD(NOTE_C, 3, 156),
    FD(NOTE_C, 6, 156),
    FD(NOTE_DS, 5, 156),
    FD(NOTE_G, 5, 156),
    FD(NOTE_C, 5, 156),
    FD(NOTE_DS, 5, 156),
    /* Events 465-480 */
    FD(NOTE_C, 5, 156),
    FD(NOTE_D, 3, 156),
    FD(NOTE_C, 3, 156),
    FD(NOTE_FS, 4, 156),
    FD(NOTE_G, 4, 156),
    FD(NOTE_C, 5, 156),
    FD(NOTE_DS, 5, 156),
    FD(NOTE_F, 5, 156),
    FD(NOTE_DS, 5, 156),
    FD(NOTE_D, 3, 156),
    FD(NOTE_G, 5, 156),
    FD(NOTE_AS, 5, 313),
    FD(NOTE_G, 5, 156),
    FD(NOTE_C, 6, 156),
    FD(NOTE_G, 5, 156),
    FD(NOTE_AS, 5, 156),
    /* Events 481-496 */
    FD(NOTE_D, 3, 156),
    FD(NOTE_G, 5, 156),
    FD(NOTE_AS, 5, 313),
    FD(NOTE_G, 5, 156),
    FD(NOTE_C, 6, 156),
    FD(NOTE_C, 3, 156),
    FD(NOTE_G, 5, 78),
    FD(NOTE_GS, 5, 78),
    FD(NOTE_AS, 5, 78),
    FD(NOTE_B, 5, 78),
    FD(NOTE_G, 5, 156),
    FD(NOTE_DS, 5, 156),
    FD(NOTE_C, 5, 313),
    FD(NOTE_C, 4, 313),
    FD(NOTE_G, 5, 156),
    FD(NOTE_C, 5, 312),
    /* Events 497-512 */
    FD(NOTE_GS, 4, 156),
    FD(NOTE_F, 4, 313),
    FD(NOTE_F, 3, 625),
    FD(NOTE_D, 5, 156),
    FD(NOTE_B, 4, 156),
    FD(NOTE_G, 4, 313),
    FD(NOTE_D, 5, 313),
    FD(NOTE_G, 4, 156),
    FD(NOTE_DS, 4, 156),
    FD(NOTE_C, 4, 313),
    FD(NOTE_G, 4, 156),
    FD(NOTE_DS, 4, 156),
    FD(NOTE_C, 4, 625),
    FD(NOTE_G, 5, 156),
    FD(NOTE_DS, 5, 156),
    FD(NOTE_C, 5, 313),
    /* Events 513-528 */
    FD(NOTE_C, 4, 313),
    FD(NOTE_G, 5, 156),
    FD(NOTE_C, 5, 312),
    FD(NOTE_GS, 4, 156),
    FD(NOTE_F, 4, 313),
    FD(NOTE_F, 3, 625),
    FD(NOTE_D, 5, 156),
    FD(NOTE_B, 4, 156),
    FD(NOTE_G, 4, 313),
    FD(NOTE_D, 5, 313),
    FD(NOTE_G, 4, 156),
    FD(NOTE_DS, 4, 156),
    FD(NOTE_C, 4, 313),
    FD(NOTE_G, 4, 156),
    FD(NOTE_DS, 4, 156),
    FD(NOTE_C, 4, 625),
    /* Events 529-544 */
    FD(NOTE_G, 4, 156),
    FD(NOTE_DS, 4, 156),
    FD(NOTE_C, 4, 156),
    FD(NOTE_C, 3, 156),
    FD(NOTE_C, 4, 156),
    FD(NOTE_G, 3, 156),
    FD(NOTE_G, 4, 156),
    FD(NOTE_C, 4, 156),
    FD(NOTE_G, 4, 156),
    FD(NOTE_DS, 4, 156),
    FD(NOTE_C, 4, 156),
    FD(NOTE_F, 3, 312),
    FD(NOTE_C, 3, 156),
    FD(NOTE_G, 4, 156),
    FD(NOTE_C, 4, 156),
    FD(NOTE_G, 4, 156),
    /* Events 545-560 */
    FD(NOTE_DS, 4, 156),
    FD(NOTE_C, 4, 313),
    FD(NOTE_G, 4, 313),
    FD(NOTE_B, 3, 156),
    FD(NOTE_C, 4, 156),
    FD(NOTE_C, 3, 313),
    FD(NOTE_G, 4, 156),
    FD(NOTE_DS, 4, 156),
    FD(NOTE_C, 4, 625),
    FD(NOTE_G, 4, 156),
    FD(NOTE_DS, 4, 156),
    FD(NOTE_C, 4, 156),
    FD(NOTE_C, 3, 156),
    FD(NOTE_C, 4, 156),
    FD(NOTE_G, 3, 156),
    FD(NOTE_G, 4, 156),
    /* Events 561-576 */
    FD(NOTE_C, 4, 156),
    FD(NOTE_G, 4, 156),
    FD(NOTE_DS, 4, 156),
    FD(NOTE_C, 4, 156),
    FD(NOTE_F, 3, 312),
    FD(NOTE_C, 3, 156),
    FD(NOTE_G, 4, 156),
    FD(NOTE_C, 4, 156),
    FD(NOTE_G, 4, 156),
    FD(NOTE_DS, 4, 156),
    FD(NOTE_C, 4, 313),
    FD(NOTE_G, 4, 313),
    FD(NOTE_B, 3, 156),
    FD(NOTE_C, 4, 156),
    FD(NOTE_C, 3, 313),
    FD(NOTE_G, 4, 156),
    /* Events 577-592 */
    FD(NOTE_DS, 4, 156),
    FD(NOTE_C, 4, 625),
    FD(NOTE_DS, 5, 156),
    FD(NOTE_G, 4, 156),
    FD(NOTE_C, 5, 156),
    FD(NOTE_D, 5, 156),
    FD(NOTE_DS, 5, 156),
    FD(NOTE_G, 4, 156),
    FD(NOTE_C, 5, 156),
    FD(NOTE_DS, 5, 156),
    FD(NOTE_F, 5, 156),
    FD(NOTE_G, 4, 156),
    FD(NOTE_DS, 5, 156),
    FD(NOTE_G, 4, 156),
    FD(NOTE_D, 5, 156),
    FD(NOTE_G, 4, 156),
    /* Events 593-608 */
    FD(NOTE_C, 5, 156),
    FD(NOTE_G, 4, 156),
    FD(NOTE_D, 5, 156),
    FD(NOTE_G, 4, 156),
    FD(NOTE_B, 4, 156),
    FD(NOTE_C, 5, 156),
    FD(NOTE_D, 5, 156),
    FD(NOTE_G, 4, 156),
    FD(NOTE_B, 4, 156),
    FD(NOTE_D, 5, 156),
    FD(NOTE_DS, 5, 156),
    FD(NOTE_G, 4, 156),
    FD(NOTE_D, 5, 156),
    FD(NOTE_G, 4, 156),
    FD(NOTE_C, 5, 156),
    FD(NOTE_G, 4, 156),
    /* Events 609-624 */
    FD(NOTE_G, 5, 156),
    FD(NOTE_G, 4, 156),
    FD(NOTE_DS, 5, 156),
    FD(NOTE_G, 4, 156),
    FD(NOTE_C, 5, 156),
    FD(NOTE_D, 5, 156),
    FD(NOTE_DS, 5, 156),
    FD(NOTE_G, 4, 156),
    FD(NOTE_C, 5, 156),
    FD(NOTE_DS, 5, 156),
    FD(NOTE_F, 5, 156),
    FD(NOTE_G, 4, 156),
    FD(NOTE_DS, 5, 156),
    FD(NOTE_G, 4, 156),
    FD(NOTE_D, 5, 156),
    FD(NOTE_G, 4, 156),
    /* Events 625-640 */
    FD(NOTE_C, 5, 156),
    FD(NOTE_G, 4, 156),
    FD(NOTE_G, 5, 156),
    FD(NOTE_G, 4, 156),
    FD(NOTE_B, 4, 156),
    FD(NOTE_G, 4, 156),
    FD(NOTE_DS, 5, 156),
    FD(NOTE_G, 4, 156),
    FD(NOTE_D, 5, 156),
    FD(NOTE_G, 4, 156),
    FD(NOTE_C, 5, 156),
    FD(NOTE_G, 4, 156),
    FD(NOTE_G, 5, 156),
    FD(NOTE_G, 4, 156),
    FD(NOTE_C, 5, 625),
    FD(NOTE_G, 5, 156),
    /* Events 641-656 */
    FD(NOTE_C, 5, 156),
    FD(NOTE_DS, 5, 156),
    FD(NOTE_F, 5, 156),
    FD(NOTE_G, 5, 156),
    FD(NOTE_C, 5, 156),
    FD(NOTE_F, 5, 156),
    FD(NOTE_AS, 5, 156),
    FD(NOTE_GS, 5, 156),
    FD(NOTE_C, 5, 156),
    FD(NOTE_G, 5, 156),
    FD(NOTE_C, 5, 156),
    FD(NOTE_GS, 5, 156),
    FD(NOTE_C, 5, 156),
    FD(NOTE_C, 6, 156),
    FD(NOTE_C, 5, 156),
    FD(NOTE_AS, 5, 156),
    /* Events 657-672 */
    FD(NOTE_D, 5, 156),
    FD(NOTE_F, 5, 156),
    FD(NOTE_C, 6, 156),
    FD(NOTE_AS, 5, 156),
    FD(NOTE_D, 5, 156),
    FD(NOTE_GS, 5, 156),
    FD(NOTE_D, 5, 156),
    FD(NOTE_G, 5, 156),
    FD(NOTE_AS, 4, 156),
    FD(NOTE_F, 5, 156),
    FD(NOTE_AS, 4, 156),
    FD(NOTE_DS, 5, 156),
    FD(NOTE_AS, 4, 156),
    FD(NOTE_D, 5, 156),
    FD(NOTE_AS, 4, 156),
    FD(NOTE_DS, 5, 156),
    /* Events 673-688 */
    FD(NOTE_GS, 4, 156),
    FD(NOTE_C, 5, 156),
    FD(NOTE_D, 5, 156),
    FD(NOTE_DS, 5, 156),
    FD(NOTE_GS, 4, 156),
    FD(NOTE_C, 5, 156),
    FD(NOTE_G, 5, 156),
    FD(NOTE_F, 5, 156),
    FD(NOTE_GS, 4, 156),
    FD(NOTE_DS, 5, 156),
    FD(NOTE_GS, 4, 156),
    FD(NOTE_D, 5, 156),
    FD(NOTE_GS, 4, 156),
    FD(NOTE_C, 5, 156),
    FD(NOTE_GS, 4, 156),
    FD(NOTE_D, 5, 156),
    /* Events 689-704 */
    FD(NOTE_G, 4, 156),
    FD(NOTE_B, 4, 156),
    FD(NOTE_D, 5, 156),
    FD(NOTE_F, 5, 156),
    FD(NOTE_B, 4, 156),
    FD(NOTE_D, 5, 156),
    FD(NOTE_F, 5, 156),
    FD(NOTE_G, 5, 156),
    FD(NOTE_D, 5, 156),
    FD(NOTE_F, 5, 156),
    FD(NOTE_G, 5, 156),
    FD(NOTE_B, 5, 156),
    FD(NOTE_G, 5, 156),
    FD(NOTE_F, 5, 156),
    FD(NOTE_D, 5, 156),
    FD(NOTE_DS, 5, 156),
    /* Events 705-720 */
    FD(NOTE_GS, 4, 156),
    FD(NOTE_C, 5, 156),
    FD(NOTE_DS, 5, 156),
    FD(NOTE_GS, 5, 156),
    FD(NOTE_C, 5, 156),
    FD(NOTE_DS, 5, 156),
    FD(NOTE_GS, 5, 156),
    FD(NOTE_C, 6, 156),
    FD(NOTE_DS, 5, 156),
    FD(NOTE_GS, 5, 156),
    FD(NOTE_C, 6, 156),
    FD(NOTE_DS, 6, 156),
    FD(NOTE_C, 6, 156),
    FD(NOTE_GS, 5, 156),
    FD(NOTE_FS, 5, 156),
    FD(NOTE_GS, 5, 156),
    /* Events 721-736 */
    FD(NOTE_E, 5, 156),
    FD(NOTE_CS, 5, 313),
    FD(NOTE_GS, 4, 156),
    FD(NOTE_E, 4, 156),
    FD(NOTE_CS, 4, 313),
    FD(NOTE_CS, 5, 156),
    FD(NOTE_A, 4, 156),
    FD(NOTE_FS, 4, 313),
    FD(NOTE_CS, 6, 156),
    FD(NOTE_A, 5, 156),
    FD(NOTE_FS, 5, 313),
    FD(NOTE_DS, 5, 156),
    FD(NOTE_C, 5, 156),
    FD(NOTE_GS, 4, 313),
    FD(NOTE_DS, 5, 313),
    FD(NOTE_GS, 4, 156),
    /* Events 737-752 */
    FD(NOTE_E, 4, 156),
    FD(NOTE_CS, 4, 313),
    FD(NOTE_GS, 4, 156),
    FD(NOTE_E, 4, 156),
    FD(NOTE_CS, 4, 625),
    FD(NOTE_GS, 5, 156),
    FD(NOTE_E, 5, 156),
    FD(NOTE_CS, 5, 313),
    FD(NOTE_GS, 4, 156),
    FD(NOTE_E, 4, 156),
    FD(NOTE_CS, 4, 313),
    FD(NOTE_CS, 5, 156),
    FD(NOTE_A, 4, 156),
    FD(NOTE_FS, 4, 313),
    FD(NOTE_CS, 6, 156),
    FD(NOTE_A, 5, 156),
    /* Events 753-768 */
    FD(NOTE_FS, 5, 313),
    FD(NOTE_DS, 5, 156),
    FD(NOTE_C, 5, 156),
    FD(NOTE_GS, 4, 313),
    FD(NOTE_DS, 5, 313),
    FD(NOTE_GS, 4, 156),
    FD(NOTE_E, 4, 156),
    FD(NOTE_CS, 4, 313),
    FD(NOTE_GS, 4, 156),
    FD(NOTE_E, 4, 156),
    FD(NOTE_CS, 4, 625),
    FD(NOTE_GS, 4, 156),
    FD(NOTE_E, 4, 156),
    FD(NOTE_CS, 4, 156),
    FD(NOTE_CS, 3, 156),
    FD(NOTE_CS, 4, 156),
    /* Events 769-784 */
    FD(NOTE_GS, 3, 156),
    FD(NOTE_GS, 4, 156),
    FD(NOTE_CS, 4, 156),
    FD(NOTE_GS, 4, 156),
    FD(NOTE_E, 4, 156),
    FD(NOTE_CS, 4, 156),
    FD(NOTE_FS, 3, 312),
    FD(NOTE_CS, 3, 156),
    FD(NOTE_GS, 4, 156),
    FD(NOTE_CS, 4, 156),
    FD(NOTE_GS, 4, 156),
    FD(NOTE_E, 4, 156),
    FD(NOTE_CS, 4, 313),
    FD(NOTE_GS, 4, 313),
    FD(NOTE_C, 4, 156),
    FD(NOTE_GS, 4, 156),
    /* Events 785-800 */
    FD(NOTE_CS, 3, 313),
    FD(NOTE_GS, 4, 156),
    FD(NOTE_E, 4, 156),
    FD(NOTE_CS, 4, 625),
    FD(NOTE_GS, 4, 156),
    FD(NOTE_E, 4, 156),
    FD(NOTE_CS, 4, 156),
    FD(NOTE_CS, 3, 156),
    FD(NOTE_CS, 4, 156),
    FD(NOTE_GS, 3, 156),
    FD(NOTE_GS, 4, 156),
    FD(NOTE_CS, 4, 156),
    FD(NOTE_GS, 4, 156),
    FD(NOTE_E, 4, 156),
    FD(NOTE_CS, 4, 156),
    FD(NOTE_FS, 3, 312),
    /* Events 801-816 */
    FD(NOTE_CS, 3, 156),
    FD(NOTE_GS, 4, 156),
    FD(NOTE_CS, 4, 156),
    FD(NOTE_GS, 4, 156),
    FD(NOTE_E, 4, 156),
    FD(NOTE_CS, 4, 313),
    FD(NOTE_GS, 4, 313),
    FD(NOTE_C, 4, 156),
    FD(NOTE_GS, 4, 156),
    FD(NOTE_CS, 3, 313),
    FD(NOTE_GS, 4, 156),
    FD(NOTE_E, 4, 156),
    FD(NOTE_CS, 4, 625),
    FD(NOTE_E, 5, 156),
    FD(NOTE_GS, 4, 156),
    FD(NOTE_CS, 5, 156),
    /* Events 817-832 */
    FD(NOTE_DS, 5, 156),
    FD(NOTE_E, 5, 156),
    FD(NOTE_GS, 4, 156),
    FD(NOTE_CS, 5, 156),
    FD(NOTE_E, 5, 156),
    FD(NOTE_FS, 5, 156),
    FD(NOTE_GS, 4, 156),
    FD(NOTE_E, 5, 156),
    FD(NOTE_GS, 4, 156),
    FD(NOTE_DS, 5, 156),
    FD(NOTE_GS, 4, 156),
    FD(NOTE_CS, 5, 156),
    FD(NOTE_GS, 4, 156),
    FD(NOTE_DS, 5, 156),
    FD(NOTE_GS, 4, 156),
    FD(NOTE_C, 5, 156),
    /* Events 833-848 */
    FD(NOTE_CS, 5, 156),
    FD(NOTE_DS, 5, 156),
    FD(NOTE_GS, 4, 156),
    FD(NOTE_CS, 5, 156),
    FD(NOTE_DS, 5, 156),
    FD(NOTE_E, 5, 156),
    FD(NOTE_GS, 4, 156),
    FD(NOTE_DS, 5, 156),
    FD(NOTE_GS, 4, 156),
    FD(NOTE_CS, 5, 156),
    FD(NOTE_GS, 4, 156),
    FD(NOTE_GS, 5, 156),
    FD(NOTE_GS, 4, 156),
    FD(NOTE_E, 5, 156),
    FD(NOTE_GS, 4, 156),
    FD(NOTE_CS, 5, 156),
    /* Events 849-864 */
    FD(NOTE_DS, 5, 156),
    FD(NOTE_E, 5, 156),
    FD(NOTE_GS, 4, 156),
    FD(NOTE_CS, 5, 156),
    FD(NOTE_E, 5, 156),
    FD(NOTE_FS, 5, 156),
    FD(NOTE_GS, 4, 156),
    FD(NOTE_E, 5, 156),
    FD(NOTE_GS, 4, 156),
    FD(NOTE_DS, 5, 156),
    FD(NOTE_GS, 4, 156),
    FD(NOTE_CS, 5, 156),
    FD(NOTE_GS, 4, 156),
    FD(NOTE_GS, 5, 156),
    FD(NOTE_GS, 4, 156),
    FD(NOTE_C, 5, 156),
    /* Events 865-880 */
    FD(NOTE_GS, 4, 156),
    FD(NOTE_E, 5, 156),
    FD(NOTE_GS, 4, 156),
    FD(NOTE_DS, 5, 156),
    FD(NOTE_GS, 4, 156),
    FD(NOTE_CS, 5, 156),
    FD(NOTE_GS, 4, 156),
    FD(NOTE_GS, 5, 156),
    FD(NOTE_GS, 4, 156),
    FD(NOTE_CS, 6, 625),
    FD(NOTE_GS, 5, 156),
    FD(NOTE_CS, 5, 156),
    FD(NOTE_E, 5, 156),
    FD(NOTE_FS, 5, 156),
    FD(NOTE_GS, 5, 156),
    FD(NOTE_CS, 5, 156),
    /* Events 881-896 */
    FD(NOTE_E, 5, 156),
    FD(NOTE_B, 5, 156),
    FD(NOTE_A, 5, 156),
    FD(NOTE_CS, 5, 156),
    FD(NOTE_GS, 5, 156),
    FD(NOTE_CS, 5, 156),
    FD(NOTE_A, 5, 156),
    FD(NOTE_CS, 5, 156),
    FD(NOTE_CS, 6, 156),
    FD(NOTE_CS, 5, 156),
    FD(NOTE_B, 5, 156),
    FD(NOTE_DS, 5, 156),
    FD(NOTE_FS, 5, 156),
    FD(NOTE_CS, 6, 156),
    FD(NOTE_B, 5, 156),
    FD(NOTE_DS, 5, 156),
    /* Events 897-912 */
    FD(NOTE_A, 5, 156),
    FD(NOTE_DS, 5, 156),
    FD(NOTE_GS, 5, 156),
    FD(NOTE_B, 4, 156),
    FD(NOTE_FS, 5, 156),
    FD(NOTE_B, 4, 156),
    FD(NOTE_E, 5, 156),
    FD(NOTE_B, 4, 156),
    FD(NOTE_DS, 5, 156),
    FD(NOTE_B, 4, 156),
    FD(NOTE_E, 5, 156),
    FD(NOTE_A, 4, 156),
    FD(NOTE_CS, 5, 156),
    FD(NOTE_DS, 5, 156),
    FD(NOTE_E, 5, 156),
    FD(NOTE_A, 4, 156),
    /* Events 913-928 */
    FD(NOTE_CS, 5, 156),
    FD(NOTE_GS, 5, 156),
    FD(NOTE_FS, 5, 156),
    FD(NOTE_A, 4, 156),
    FD(NOTE_E, 5, 156),
    FD(NOTE_A, 4, 156),
    FD(NOTE_DS, 5, 156),
    FD(NOTE_A, 4, 156),
    FD(NOTE_CS, 5, 156),
    FD(NOTE_A, 4, 156),
    FD(NOTE_DS, 5, 156),
    FD(NOTE_GS, 4, 156),
    FD(NOTE_C, 5, 156),
    FD(NOTE_DS, 5, 156),
    FD(NOTE_GS, 5, 156),
    FD(NOTE_C, 5, 156),
    /* Events 929-944 */
    FD(NOTE_DS, 5, 156),
    FD(NOTE_GS, 5, 156),
    FD(NOTE_C, 6, 156),
    FD(NOTE_DS, 5, 156),
    FD(NOTE_GS, 5, 156),
    FD(NOTE_C, 6, 156),
    FD(NOTE_DS, 6, 156),
    FD(NOTE_C, 6, 156),
    FD(NOTE_GS, 5, 156),
    FD(NOTE_FS, 5, 156),
    FD(NOTE_GS, 5, 156),
    FD(NOTE_E, 5, 156),
    FD(NOTE_CS, 5, 313),
    FD(NOTE_GS, 4, 156),
    FD(NOTE_E, 4, 156),
    FD(NOTE_CS, 4, 313),
    /* Events 945-960 */
    FD(NOTE_CS, 5, 156),
    FD(NOTE_A, 4, 156),
    FD(NOTE_FS, 4, 313),
    FD(NOTE_CS, 6, 156),
    FD(NOTE_A, 5, 156),
    FD(NOTE_FS, 5, 313),
    FD(NOTE_DS, 5, 156),
    FD(NOTE_C, 5, 156),
    FD(NOTE_GS, 4, 313),
    FD(NOTE_DS, 5, 313),
    FD(NOTE_GS, 4, 156),
    FD(NOTE_E, 4, 156),
    FD(NOTE_CS, 4, 313),
    FD(NOTE_GS, 4, 156),
    FD(NOTE_E, 4, 156),
    FD(NOTE_CS, 4, 625),
    /* Events 961-976 */
    FD(NOTE_GS, 5, 156),
    FD(NOTE_E, 5, 156),
    FD(NOTE_CS, 5, 313),
    FD(NOTE_GS, 4, 156),
    FD(NOTE_E, 4, 156),
    FD(NOTE_CS, 4, 313),
    FD(NOTE_CS, 5, 156),
    FD(NOTE_A, 4, 156),
    FD(NOTE_FS, 4, 313),
    FD(NOTE_CS, 6, 156),
    FD(NOTE_A, 5, 156),
    FD(NOTE_FS, 5, 313),
    FD(NOTE_DS, 5, 156),
    FD(NOTE_C, 5, 156),
    FD(NOTE_GS, 4, 313),
    FD(NOTE_DS, 5, 313),
    /* Events 977-992 */
    FD(NOTE_GS, 4, 156),
    FD(NOTE_E, 4, 156),
    FD(NOTE_CS, 4, 313),
    FD(NOTE_GS, 4, 156),
    FD(NOTE_E, 4, 156),
    FD(NOTE_CS, 4, 625),
    FD(NOTE_GS, 4, 156),
    FD(NOTE_E, 4, 156),
    FD(NOTE_CS, 4, 156),
    FD(NOTE_CS, 3, 156),
    FD(NOTE_CS, 4, 156),
    FD(NOTE_GS, 3, 156),
    FD(NOTE_GS, 4, 156),
    FD(NOTE_CS, 4, 156),
    FD(NOTE_GS, 4, 156),
    FD(NOTE_E, 4, 156),
    /* Events 993-1008 */
    FD(NOTE_CS, 4, 156),
    FD(NOTE_FS, 3, 312),
    FD(NOTE_CS, 3, 156),
    FD(NOTE_GS, 4, 156),
    FD(NOTE_CS, 4, 156),
    FD(NOTE_GS, 4, 156),
    FD(NOTE_E, 4, 156),
    FD(NOTE_CS, 4, 313),
    FD(NOTE_GS, 4, 313),
    FD(NOTE_C, 4, 156),
    FD(NOTE_GS, 4, 156),
    FD(NOTE_CS, 3, 313),
    FD(NOTE_GS, 4, 156),
    FD(NOTE_E, 4, 156),
    FD(NOTE_CS, 4, 625),
    FD(NOTE_GS, 4, 156),
    /* Events 1009-1024 */
    FD(NOTE_E, 4, 156),
    FD(NOTE_CS, 4, 156),
    FD(NOTE_CS, 3, 156),
    FD(NOTE_CS, 4, 156),
    FD(NOTE_GS, 3, 156),
    FD(NOTE_GS, 4, 156),
    FD(NOTE_CS, 4, 156),
    FD(NOTE_GS, 4, 156),
    FD(NOTE_E, 4, 156),
    FD(NOTE_CS, 4, 156),
    FD(NOTE_FS, 3, 312),
    FD(NOTE_CS, 3, 156),
    FD(NOTE_GS, 4, 156),
    FD(NOTE_CS, 4, 156),
    FD(NOTE_GS, 4, 156),
    FD(NOTE_E, 4, 156),
    /* Events 1025-1040 */
    FD(NOTE_CS, 4, 313),
    FD(NOTE_GS, 4, 313),
    FD(NOTE_C, 4, 156),
    FD(NOTE_GS, 4, 156),
    FD(NOTE_CS, 3, 313),
    FD(NOTE_GS, 4, 156),
    FD(NOTE_E, 4, 156),
    FD(NOTE_CS, 4, 625),
    FD(NOTE_GS, 5, 156),
    FD(NOTE_E, 5, 156),
    FD(NOTE_CS, 5, 313),
    FD(NOTE_GS, 4, 156),
    FD(NOTE_E, 4, 156),
    FD(NOTE_CS, 4, 313),
    FD(NOTE_CS, 5, 156),
    FD(NOTE_A, 4, 156),
    /* Events 1041-1056 */
    FD(NOTE_FS, 4, 313),
    FD(NOTE_CS, 6, 156),
    FD(NOTE_A, 5, 156),
    FD(NOTE_FS, 5, 313),
    FD(NOTE_DS, 5, 156),
    FD(NOTE_C, 5, 156),
    FD(NOTE_GS, 4, 313),
    FD(NOTE_DS, 5, 313),
    FD(NOTE_GS, 4, 156),
    FD(NOTE_E, 4, 156),
    FD(NOTE_CS, 4, 313),
    FD(NOTE_GS, 4, 156),
    FD(NOTE_E, 4, 156),
    FD(NOTE_CS, 4, 625),
    FD(NOTE_GS, 5, 156),
    FD(NOTE_E, 5, 156),
    /* Events 1057-1072 */
    FD(NOTE_CS, 5, 313),
    FD(NOTE_GS, 4, 156),
    FD(NOTE_E, 4, 156),
    FD(NOTE_CS, 4, 313),
    FD(NOTE_CS, 5, 156),
    FD(NOTE_A, 4, 156),
    FD(NOTE_FS, 4, 313),
    FD(NOTE_CS, 6, 156),
    FD(NOTE_A, 5, 156),
    FD(NOTE_FS, 5, 313),
    FD(NOTE_DS, 5, 156),
    FD(NOTE_C, 5, 156),
    FD(NOTE_GS, 4, 313),
    FD(NOTE_DS, 5, 313),
    FD(NOTE_GS, 4, 626),
    FD(NOTE_CS, 6, 938)
};

#undef FD_R
#undef FD
