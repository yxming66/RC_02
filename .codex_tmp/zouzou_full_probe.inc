/*
 * Li Ronghao - Zou Zou.
 * Complete single-line PWM buzzer reduction generated from PiaStudy 1EHDscVDK space data matching the provided PDF, quarter note = 59 BPM.
 * Simultaneous right-hand, left-hand, and chord tones are
 * arpeggiated into one buzzer line with the upper voice first;
 * notes outside the practical buzzer range are folded by octaves.
 * 1017 buzzer events, about 301 seconds.
 */
#define ZZ(note, octave, ms) {note, octave, (uint16_t)(ms)}
#define ZZ_R(ms) {NOTE_REST, 0, (uint16_t)(ms)}

const Tone_t ZOU_ZOU[] = {
    /* Events 1-16 */
    ZZ_R(2542),
    ZZ(NOTE_E, 4, 254),
    ZZ(NOTE_E, 3, 254),
    ZZ(NOTE_B, 3, 254),
    ZZ(NOTE_B, 3, 254),
    ZZ(NOTE_A, 3, 254),
    ZZ(NOTE_A, 3, 254),
    ZZ(NOTE_A, 3, 127),
    ZZ(NOTE_D, 3, 127),
    ZZ(NOTE_E, 4, 508),
    ZZ(NOTE_A, 3, 254),
    ZZ(NOTE_E, 4, 254),
    ZZ(NOTE_D, 3, 254),
    ZZ(NOTE_A, 3, 254),
    ZZ(NOTE_D, 4, 254),
    ZZ(NOTE_A, 3, 254),
    /* Events 17-32 */
    ZZ(NOTE_D, 4, 254),
    ZZ(NOTE_CS, 4, 508),
    ZZ(NOTE_B, 3, 254),
    ZZ(NOTE_D, 3, 254),
    ZZ(NOTE_A, 3, 508),
    ZZ(NOTE_GS, 3, 127),
    ZZ(NOTE_D, 3, 127),
    ZZ(NOTE_E, 4, 508),
    ZZ(NOTE_GS, 3, 254),
    ZZ(NOTE_E, 4, 254),
    ZZ(NOTE_E, 3, 254),
    ZZ(NOTE_GS, 3, 254),
    ZZ(NOTE_B, 3, 254),
    ZZ(NOTE_B, 3, 1017),
    ZZ(NOTE_B, 3, 1017),
    ZZ(NOTE_A, 3, 127),
    /* Events 33-48 */
    ZZ(NOTE_D, 3, 127),
    ZZ(NOTE_E, 4, 508),
    ZZ(NOTE_A, 3, 254),
    ZZ(NOTE_E, 4, 254),
    ZZ(NOTE_D, 3, 254),
    ZZ(NOTE_A, 3, 254),
    ZZ(NOTE_D, 4, 254),
    ZZ(NOTE_D, 3, 254),
    ZZ(NOTE_D, 4, 254),
    ZZ(NOTE_CS, 4, 508),
    ZZ(NOTE_B, 3, 254),
    ZZ(NOTE_D, 3, 254),
    ZZ(NOTE_A, 3, 508),
    ZZ(NOTE_GS, 3, 127),
    ZZ(NOTE_D, 3, 127),
    ZZ(NOTE_E, 4, 508),
    /* Events 49-64 */
    ZZ(NOTE_GS, 3, 254),
    ZZ(NOTE_E, 4, 254),
    ZZ(NOTE_E, 3, 254),
    ZZ(NOTE_GS, 3, 508),
    ZZ(NOTE_B, 3, 2034),
    ZZ(NOTE_D, 3, 1017),
    ZZ(NOTE_FS, 4, 127),
    ZZ(NOTE_A, 3, 127),
    ZZ(NOTE_GS, 4, 254),
    ZZ(NOTE_A, 4, 254),
    ZZ(NOTE_FS, 4, 254),
    ZZ(NOTE_GS, 4, 509),
    ZZ(NOTE_B, 3, 508),
    ZZ(NOTE_GS, 3, 1017),
    ZZ(NOTE_CS, 3, 1017),
    ZZ(NOTE_B, 4, 127),
    /* Events 65-80 */
    ZZ(NOTE_GS, 3, 127),
    ZZ(NOTE_B, 4, 254),
    ZZ(NOTE_B, 4, 254),
    ZZ(NOTE_A, 4, 254),
    ZZ(NOTE_A, 4, 1017),
    ZZ(NOTE_FS, 3, 1017),
    ZZ(NOTE_D, 3, 1017),
    ZZ(NOTE_FS, 4, 127),
    ZZ(NOTE_A, 3, 127),
    ZZ(NOTE_GS, 4, 254),
    ZZ(NOTE_A, 4, 254),
    ZZ(NOTE_FS, 4, 254),
    ZZ(NOTE_GS, 4, 509),
    ZZ(NOTE_E, 3, 508),
    ZZ(NOTE_B, 3, 1017),
    ZZ(NOTE_CS, 3, 763),
    /* Events 81-96 */
    ZZ(NOTE_E, 5, 254),
    ZZ(NOTE_E, 5, 127),
    ZZ(NOTE_GS, 3, 127),
    ZZ(NOTE_B, 4, 254),
    ZZ(NOTE_B, 4, 254),
    ZZ(NOTE_A, 4, 254),
    ZZ(NOTE_A, 4, 1017),
    ZZ(NOTE_A, 3, 1017),
    ZZ(NOTE_D, 3, 763),
    ZZ(NOTE_A, 4, 254),
    ZZ(NOTE_FS, 5, 85),
    ZZ(NOTE_A, 3, 85),
    ZZ(NOTE_FS, 3, 84),
    ZZ(NOTE_FS, 5, 254),
    ZZ(NOTE_FS, 5, 254),
    ZZ(NOTE_CS, 5, 254),
    /* Events 97-112 */
    ZZ(NOTE_E, 5, 254),
    ZZ(NOTE_E, 3, 254),
    ZZ(NOTE_B, 4, 508),
    ZZ(NOTE_B, 3, 509),
    ZZ(NOTE_GS, 3, 508),
    ZZ(NOTE_CS, 3, 763),
    ZZ(NOTE_E, 5, 254),
    ZZ(NOTE_E, 5, 85),
    ZZ(NOTE_CS, 4, 85),
    ZZ(NOTE_GS, 3, 84),
    ZZ(NOTE_CS, 5, 254),
    ZZ(NOTE_B, 4, 254),
    ZZ(NOTE_A, 4, 254),
    ZZ(NOTE_FS, 4, 509),
    ZZ(NOTE_FS, 3, 508),
    ZZ(NOTE_A, 3, 254),
    /* Events 113-128 */
    ZZ(NOTE_CS, 3, 254),
    ZZ(NOTE_B, 4, 254),
    ZZ(NOTE_A, 4, 254),
    ZZ(NOTE_CS, 5, 127),
    ZZ(NOTE_B, 3, 127),
    ZZ(NOTE_E, 5, 254),
    ZZ(NOTE_FS, 5, 254),
    ZZ(NOTE_B, 4, 254),
    ZZ(NOTE_B, 3, 127),
    ZZ(NOTE_FS, 3, 127),
    ZZ(NOTE_A, 4, 508),
    ZZ(NOTE_E, 4, 254),
    ZZ(NOTE_E, 5, 254),
    ZZ(NOTE_E, 3, 254),
    ZZ(NOTE_CS, 5, 254),
    ZZ(NOTE_B, 4, 254),
    /* Events 129-144 */
    ZZ(NOTE_E, 4, 382),
    ZZ(NOTE_B, 3, 381),
    ZZ(NOTE_A, 4, 254),
    ZZ(NOTE_GS, 4, 254),
    ZZ(NOTE_A, 3, 254),
    ZZ(NOTE_FS, 4, 254),
    ZZ(NOTE_E, 4, 254),
    ZZ(NOTE_E, 4, 1017),
    ZZ(NOTE_GS, 4, 2034),
    ZZ(NOTE_D, 3, 508),
    ZZ(NOTE_A, 3, 508),
    ZZ(NOTE_FS, 4, 127),
    ZZ(NOTE_D, 4, 127),
    ZZ(NOTE_GS, 4, 254),
    ZZ(NOTE_A, 4, 127),
    ZZ(NOTE_A, 3, 127),
    /* Events 145-160 */
    ZZ(NOTE_FS, 4, 254),
    ZZ(NOTE_GS, 4, 254),
    ZZ(NOTE_E, 3, 254),
    ZZ(NOTE_B, 3, 508),
    ZZ(NOTE_E, 4, 508),
    ZZ(NOTE_B, 3, 508),
    ZZ(NOTE_CS, 3, 508),
    ZZ(NOTE_GS, 3, 508),
    ZZ(NOTE_B, 4, 127),
    ZZ(NOTE_CS, 4, 127),
    ZZ(NOTE_B, 4, 254),
    ZZ(NOTE_B, 4, 127),
    ZZ(NOTE_GS, 3, 127),
    ZZ(NOTE_A, 4, 254),
    ZZ(NOTE_A, 4, 508),
    ZZ(NOTE_CS, 3, 508),
    /* Events 161-176 */
    ZZ(NOTE_A, 3, 508),
    ZZ(NOTE_CS, 3, 508),
    ZZ(NOTE_D, 3, 508),
    ZZ(NOTE_A, 3, 508),
    ZZ(NOTE_FS, 4, 127),
    ZZ(NOTE_D, 4, 127),
    ZZ(NOTE_GS, 4, 254),
    ZZ(NOTE_A, 4, 127),
    ZZ(NOTE_A, 3, 127),
    ZZ(NOTE_FS, 4, 254),
    ZZ(NOTE_GS, 4, 254),
    ZZ(NOTE_E, 3, 254),
    ZZ(NOTE_B, 3, 508),
    ZZ(NOTE_E, 4, 508),
    ZZ(NOTE_B, 3, 508),
    ZZ(NOTE_CS, 3, 508),
    /* Events 177-192 */
    ZZ(NOTE_GS, 3, 254),
    ZZ(NOTE_E, 5, 254),
    ZZ(NOTE_E, 5, 127),
    ZZ(NOTE_CS, 4, 127),
    ZZ(NOTE_B, 4, 254),
    ZZ(NOTE_B, 4, 127),
    ZZ(NOTE_GS, 3, 127),
    ZZ(NOTE_B, 4, 254),
    ZZ(NOTE_A, 4, 254),
    ZZ(NOTE_FS, 3, 254),
    ZZ(NOTE_CS, 3, 508),
    ZZ(NOTE_A, 3, 508),
    ZZ(NOTE_CS, 3, 508),
    ZZ(NOTE_D, 3, 508),
    ZZ(NOTE_A, 3, 254),
    ZZ(NOTE_A, 4, 254),
    /* Events 193-208 */
    ZZ(NOTE_FS, 5, 127),
    ZZ(NOTE_D, 4, 127),
    ZZ(NOTE_FS, 5, 254),
    ZZ(NOTE_FS, 5, 127),
    ZZ(NOTE_A, 3, 127),
    ZZ(NOTE_CS, 5, 254),
    ZZ(NOTE_E, 5, 254),
    ZZ(NOTE_E, 3, 254),
    ZZ(NOTE_B, 4, 254),
    ZZ(NOTE_B, 3, 254),
    ZZ(NOTE_E, 4, 508),
    ZZ(NOTE_B, 3, 508),
    ZZ(NOTE_CS, 3, 508),
    ZZ(NOTE_GS, 3, 254),
    ZZ(NOTE_E, 5, 254),
    ZZ(NOTE_E, 5, 127),
    /* Events 209-224 */
    ZZ(NOTE_CS, 4, 127),
    ZZ(NOTE_CS, 5, 254),
    ZZ(NOTE_B, 4, 127),
    ZZ(NOTE_GS, 3, 127),
    ZZ(NOTE_A, 4, 254),
    ZZ(NOTE_FS, 4, 254),
    ZZ(NOTE_FS, 3, 254),
    ZZ(NOTE_CS, 3, 508),
    ZZ(NOTE_A, 3, 508),
    ZZ(NOTE_B, 4, 127),
    ZZ(NOTE_CS, 3, 127),
    ZZ(NOTE_A, 4, 254),
    ZZ(NOTE_CS, 5, 127),
    ZZ(NOTE_B, 3, 127),
    ZZ(NOTE_E, 5, 254),
    ZZ(NOTE_FS, 5, 127),
    /* Events 225-240 */
    ZZ(NOTE_FS, 3, 127),
    ZZ(NOTE_B, 4, 254),
    ZZ(NOTE_B, 3, 254),
    ZZ(NOTE_A, 4, 254),
    ZZ(NOTE_B, 3, 254),
    ZZ(NOTE_E, 4, 254),
    ZZ(NOTE_CS, 5, 127),
    ZZ(NOTE_E, 3, 127),
    ZZ(NOTE_E, 5, 254),
    ZZ(NOTE_FS, 5, 127),
    ZZ(NOTE_B, 3, 127),
    ZZ(NOTE_B, 4, 254),
    ZZ(NOTE_E, 3, 508),
    ZZ(NOTE_E, 4, 127),
    ZZ(NOTE_B, 3, 127),
    ZZ(NOTE_B, 4, 254),
    /* Events 241-256 */
    ZZ(NOTE_A, 4, 254),
    ZZ(NOTE_A, 3, 254),
    ZZ(NOTE_E, 3, 508),
    ZZ(NOTE_D, 4, 254),
    ZZ(NOTE_CS, 4, 254),
    ZZ(NOTE_E, 3, 508),
    ZZ(NOTE_D, 3, 254),
    ZZ(NOTE_E, 3, 254),
    ZZ(NOTE_E, 5, 508),
    ZZ(NOTE_B, 4, 254),
    ZZ(NOTE_E, 3, 254),
    ZZ(NOTE_A, 4, 508),
    ZZ(NOTE_B, 4, 127),
    ZZ(NOTE_A, 3, 127),
    ZZ(NOTE_CS, 5, 254),
    ZZ(NOTE_CS, 5, 127),
    /* Events 257-272 */
    ZZ(NOTE_E, 3, 127),
    ZZ(NOTE_B, 4, 254),
    ZZ(NOTE_CS, 5, 254),
    ZZ(NOTE_A, 3, 254),
    ZZ(NOTE_E, 3, 254),
    ZZ(NOTE_B, 4, 254),
    ZZ(NOTE_FS, 3, 127),
    ZZ(NOTE_GS, 3, 127),
    ZZ(NOTE_CS, 5, 254),
    ZZ(NOTE_CS, 5, 254),
    ZZ(NOTE_B, 4, 254),
    ZZ(NOTE_CS, 5, 255),
    ZZ(NOTE_GS, 3, 254),
    ZZ(NOTE_CS, 3, 254),
    ZZ(NOTE_CS, 5, 254),
    ZZ(NOTE_GS, 5, 127),
    /* Events 273-288 */
    ZZ(NOTE_FS, 3, 127),
    ZZ(NOTE_FS, 5, 254),
    ZZ(NOTE_FS, 5, 127),
    ZZ(NOTE_CS, 3, 127),
    ZZ(NOTE_CS, 5, 254),
    ZZ(NOTE_A, 4, 254),
    ZZ(NOTE_FS, 3, 254),
    ZZ(NOTE_FS, 4, 127),
    ZZ(NOTE_CS, 3, 127),
    ZZ(NOTE_B, 4, 254),
    ZZ(NOTE_D, 3, 127),
    ZZ(NOTE_E, 3, 127),
    ZZ(NOTE_A, 4, 763),
    ZZ(NOTE_E, 3, 382),
    ZZ(NOTE_A, 3, 381),
    ZZ(NOTE_E, 5, 254),
    /* Events 289-304 */
    ZZ(NOTE_E, 5, 127),
    ZZ(NOTE_D, 3, 127),
    ZZ(NOTE_E, 5, 254),
    ZZ(NOTE_A, 3, 254),
    ZZ(NOTE_A, 4, 254),
    ZZ(NOTE_D, 3, 254),
    ZZ(NOTE_FS, 4, 254),
    ZZ(NOTE_A, 3, 254),
    ZZ(NOTE_E, 5, 254),
    ZZ(NOTE_GS, 3, 127),
    ZZ(NOTE_CS, 3, 127),
    ZZ(NOTE_E, 5, 508),
    ZZ(NOTE_A, 4, 254),
    ZZ(NOTE_A, 4, 85),
    ZZ(NOTE_FS, 3, 85),
    ZZ(NOTE_FS, 3, 84),
    /* Events 305-320 */
    ZZ(NOTE_FS, 4, 508),
    ZZ(NOTE_E, 5, 254),
    ZZ(NOTE_E, 5, 254),
    ZZ(NOTE_B, 3, 254),
    ZZ(NOTE_CS, 5, 127),
    ZZ(NOTE_FS, 3, 127),
    ZZ(NOTE_FS, 5, 254),
    ZZ(NOTE_B, 3, 254),
    ZZ(NOTE_A, 4, 254),
    ZZ(NOTE_FS, 3, 254),
    ZZ(NOTE_B, 4, 254),
    ZZ(NOTE_E, 3, 508),
    ZZ(NOTE_E, 5, 254),
    ZZ(NOTE_B, 3, 254),
    ZZ(NOTE_B, 4, 254),
    ZZ(NOTE_E, 3, 254),
    /* Events 321-336 */
    ZZ(NOTE_A, 4, 508),
    ZZ(NOTE_B, 4, 127),
    ZZ(NOTE_A, 3, 127),
    ZZ(NOTE_CS, 5, 254),
    ZZ(NOTE_CS, 5, 127),
    ZZ(NOTE_E, 3, 127),
    ZZ(NOTE_B, 4, 254),
    ZZ(NOTE_CS, 5, 254),
    ZZ(NOTE_A, 3, 254),
    ZZ(NOTE_E, 3, 254),
    ZZ(NOTE_B, 4, 254),
    ZZ(NOTE_FS, 3, 127),
    ZZ(NOTE_GS, 3, 127),
    ZZ(NOTE_CS, 5, 254),
    ZZ(NOTE_CS, 5, 254),
    ZZ(NOTE_B, 4, 254),
    /* Events 337-352 */
    ZZ(NOTE_CS, 5, 255),
    ZZ(NOTE_GS, 3, 254),
    ZZ(NOTE_CS, 3, 254),
    ZZ(NOTE_CS, 5, 254),
    ZZ(NOTE_GS, 5, 127),
    ZZ(NOTE_FS, 3, 127),
    ZZ(NOTE_FS, 5, 254),
    ZZ(NOTE_GS, 5, 127),
    ZZ(NOTE_CS, 3, 127),
    ZZ(NOTE_A, 5, 254),
    ZZ(NOTE_A, 5, 254),
    ZZ(NOTE_FS, 3, 254),
    ZZ(NOTE_CS, 5, 127),
    ZZ(NOTE_CS, 3, 127),
    ZZ(NOTE_B, 4, 254),
    ZZ(NOTE_A, 4, 339),
    /* Events 353-368 */
    ZZ(NOTE_D, 3, 339),
    ZZ(NOTE_E, 3, 339),
    ZZ(NOTE_E, 3, 254),
    ZZ(NOTE_A, 3, 254),
    ZZ(NOTE_A, 4, 254),
    ZZ(NOTE_E, 5, 254),
    ZZ(NOTE_E, 5, 127),
    ZZ(NOTE_D, 3, 127),
    ZZ(NOTE_E, 5, 254),
    ZZ(NOTE_A, 3, 254),
    ZZ(NOTE_A, 4, 254),
    ZZ(NOTE_D, 3, 254),
    ZZ(NOTE_FS, 4, 254),
    ZZ(NOTE_A, 3, 254),
    ZZ(NOTE_E, 5, 254),
    ZZ(NOTE_GS, 3, 127),
    /* Events 369-384 */
    ZZ(NOTE_CS, 3, 127),
    ZZ(NOTE_E, 5, 508),
    ZZ(NOTE_A, 4, 254),
    ZZ(NOTE_FS, 3, 127),
    ZZ(NOTE_FS, 3, 127),
    ZZ(NOTE_FS, 4, 508),
    ZZ(NOTE_E, 5, 254),
    ZZ(NOTE_E, 5, 127),
    ZZ(NOTE_B, 3, 127),
    ZZ(NOTE_CS, 5, 254),
    ZZ(NOTE_CS, 5, 127),
    ZZ(NOTE_FS, 3, 127),
    ZZ(NOTE_B, 4, 254),
    ZZ(NOTE_B, 4, 254),
    ZZ(NOTE_B, 3, 254),
    ZZ(NOTE_FS, 3, 254),
    /* Events 385-400 */
    ZZ(NOTE_E, 5, 254),
    ZZ(NOTE_E, 5, 127),
    ZZ(NOTE_E, 3, 127),
    ZZ(NOTE_CS, 5, 254),
    ZZ(NOTE_CS, 5, 127),
    ZZ(NOTE_B, 3, 127),
    ZZ(NOTE_B, 4, 254),
    ZZ(NOTE_B, 4, 127),
    ZZ(NOTE_E, 3, 127),
    ZZ(NOTE_B, 3, 254),
    ZZ(NOTE_E, 3, 254),
    ZZ(NOTE_A, 4, 254),
    ZZ(NOTE_A, 3, 254),
    ZZ(NOTE_E, 4, 254),
    ZZ(NOTE_A, 4, 254),
    ZZ(NOTE_A, 3, 254),
    /* Events 401-416 */
    ZZ(NOTE_A, 3, 763),
    ZZ(NOTE_D, 4, 254),
    ZZ(NOTE_D, 4, 85),
    ZZ(NOTE_FS, 3, 85),
    ZZ(NOTE_GS, 3, 84),
    ZZ(NOTE_E, 4, 254),
    ZZ(NOTE_CS, 4, 508),
    ZZ(NOTE_B, 3, 170),
    ZZ(NOTE_GS, 3, 169),
    ZZ(NOTE_CS, 3, 169),
    ZZ(NOTE_A, 3, 508),
    ZZ(NOTE_A, 3, 127),
    ZZ(NOTE_FS, 3, 127),
    ZZ(NOTE_E, 4, 254),
    ZZ(NOTE_CS, 3, 254),
    ZZ(NOTE_A, 3, 254),
    /* Events 417-432 */
    ZZ(NOTE_E, 4, 254),
    ZZ(NOTE_FS, 3, 254),
    ZZ(NOTE_A, 3, 127),
    ZZ(NOTE_CS, 3, 127),
    ZZ(NOTE_E, 4, 254),
    ZZ(NOTE_D, 3, 127),
    ZZ(NOTE_E, 3, 127),
    ZZ(NOTE_FS, 4, 254),
    ZZ(NOTE_CS, 4, 508),
    ZZ(NOTE_B, 3, 170),
    ZZ(NOTE_E, 3, 169),
    ZZ(NOTE_A, 3, 169),
    ZZ(NOTE_A, 3, 508),
    ZZ(NOTE_A, 3, 127),
    ZZ(NOTE_D, 3, 127),
    ZZ(NOTE_E, 4, 254),
    /* Events 433-448 */
    ZZ(NOTE_A, 3, 254),
    ZZ(NOTE_A, 3, 254),
    ZZ(NOTE_E, 4, 254),
    ZZ(NOTE_D, 3, 254),
    ZZ(NOTE_FS, 3, 254),
    ZZ(NOTE_D, 4, 254),
    ZZ(NOTE_A, 3, 127),
    ZZ(NOTE_D, 3, 127),
    ZZ(NOTE_E, 4, 254),
    ZZ(NOTE_CS, 4, 508),
    ZZ(NOTE_B, 3, 254),
    ZZ(NOTE_FS, 3, 254),
    ZZ(NOTE_A, 3, 508),
    ZZ(NOTE_A, 3, 127),
    ZZ(NOTE_B, 3, 127),
    ZZ(NOTE_E, 4, 508),
    /* Events 449-464 */
    ZZ(NOTE_A, 3, 254),
    ZZ(NOTE_E, 4, 127),
    ZZ(NOTE_D, 3, 127),
    ZZ(NOTE_CS, 4, 254),
    ZZ(NOTE_A, 3, 254),
    ZZ(NOTE_B, 3, 254),
    ZZ(NOTE_E, 3, 2034),
    ZZ(NOTE_D, 3, 508),
    ZZ(NOTE_A, 3, 508),
    ZZ(NOTE_FS, 4, 127),
    ZZ(NOTE_D, 4, 127),
    ZZ(NOTE_GS, 4, 254),
    ZZ(NOTE_A, 4, 127),
    ZZ(NOTE_A, 3, 127),
    ZZ(NOTE_FS, 4, 254),
    ZZ(NOTE_GS, 4, 254),
    /* Events 465-480 */
    ZZ(NOTE_E, 3, 254),
    ZZ(NOTE_B, 3, 508),
    ZZ(NOTE_E, 4, 508),
    ZZ(NOTE_B, 3, 508),
    ZZ(NOTE_CS, 3, 508),
    ZZ(NOTE_GS, 3, 508),
    ZZ(NOTE_B, 4, 127),
    ZZ(NOTE_CS, 4, 127),
    ZZ(NOTE_B, 4, 254),
    ZZ(NOTE_B, 4, 127),
    ZZ(NOTE_GS, 3, 127),
    ZZ(NOTE_A, 4, 254),
    ZZ(NOTE_A, 4, 508),
    ZZ(NOTE_CS, 3, 508),
    ZZ(NOTE_A, 3, 508),
    ZZ(NOTE_CS, 3, 508),
    /* Events 481-496 */
    ZZ(NOTE_D, 3, 508),
    ZZ(NOTE_A, 3, 508),
    ZZ(NOTE_FS, 4, 127),
    ZZ(NOTE_D, 4, 127),
    ZZ(NOTE_GS, 4, 254),
    ZZ(NOTE_A, 4, 127),
    ZZ(NOTE_A, 3, 127),
    ZZ(NOTE_FS, 4, 254),
    ZZ(NOTE_GS, 4, 254),
    ZZ(NOTE_E, 3, 254),
    ZZ(NOTE_B, 3, 508),
    ZZ(NOTE_E, 4, 508),
    ZZ(NOTE_B, 3, 508),
    ZZ(NOTE_CS, 3, 508),
    ZZ(NOTE_GS, 3, 254),
    ZZ(NOTE_E, 5, 254),
    /* Events 497-512 */
    ZZ(NOTE_E, 5, 127),
    ZZ(NOTE_CS, 4, 127),
    ZZ(NOTE_B, 4, 254),
    ZZ(NOTE_B, 4, 127),
    ZZ(NOTE_GS, 3, 127),
    ZZ(NOTE_B, 4, 254),
    ZZ(NOTE_A, 4, 254),
    ZZ(NOTE_FS, 3, 254),
    ZZ(NOTE_CS, 3, 508),
    ZZ(NOTE_A, 3, 508),
    ZZ(NOTE_CS, 3, 508),
    ZZ(NOTE_D, 3, 508),
    ZZ(NOTE_A, 3, 254),
    ZZ(NOTE_A, 4, 254),
    ZZ(NOTE_FS, 5, 127),
    ZZ(NOTE_D, 4, 127),
    /* Events 513-528 */
    ZZ(NOTE_FS, 5, 254),
    ZZ(NOTE_FS, 5, 127),
    ZZ(NOTE_A, 3, 127),
    ZZ(NOTE_CS, 5, 254),
    ZZ(NOTE_E, 5, 254),
    ZZ(NOTE_E, 3, 254),
    ZZ(NOTE_B, 4, 254),
    ZZ(NOTE_B, 3, 254),
    ZZ(NOTE_E, 4, 508),
    ZZ(NOTE_B, 3, 508),
    ZZ(NOTE_CS, 3, 508),
    ZZ(NOTE_GS, 3, 254),
    ZZ(NOTE_E, 5, 254),
    ZZ(NOTE_E, 5, 127),
    ZZ(NOTE_CS, 4, 127),
    ZZ(NOTE_CS, 5, 254),
    /* Events 529-544 */
    ZZ(NOTE_B, 4, 127),
    ZZ(NOTE_GS, 3, 127),
    ZZ(NOTE_A, 4, 254),
    ZZ(NOTE_FS, 4, 254),
    ZZ(NOTE_FS, 3, 254),
    ZZ(NOTE_CS, 3, 508),
    ZZ(NOTE_A, 3, 508),
    ZZ(NOTE_B, 4, 127),
    ZZ(NOTE_CS, 3, 127),
    ZZ(NOTE_A, 4, 254),
    ZZ(NOTE_CS, 5, 127),
    ZZ(NOTE_B, 3, 127),
    ZZ(NOTE_E, 5, 254),
    ZZ(NOTE_FS, 5, 127),
    ZZ(NOTE_FS, 3, 127),
    ZZ(NOTE_B, 4, 254),
    /* Events 545-560 */
    ZZ(NOTE_B, 3, 254),
    ZZ(NOTE_A, 4, 254),
    ZZ(NOTE_B, 3, 254),
    ZZ(NOTE_E, 4, 254),
    ZZ(NOTE_CS, 5, 127),
    ZZ(NOTE_E, 3, 127),
    ZZ(NOTE_E, 5, 254),
    ZZ(NOTE_FS, 5, 127),
    ZZ(NOTE_B, 3, 127),
    ZZ(NOTE_B, 4, 254),
    ZZ(NOTE_E, 3, 508),
    ZZ(NOTE_E, 4, 127),
    ZZ(NOTE_B, 3, 127),
    ZZ(NOTE_B, 4, 254),
    ZZ(NOTE_A, 4, 254),
    ZZ(NOTE_A, 3, 254),
    /* Events 561-576 */
    ZZ(NOTE_E, 3, 508),
    ZZ(NOTE_D, 4, 254),
    ZZ(NOTE_CS, 4, 254),
    ZZ(NOTE_E, 3, 508),
    ZZ(NOTE_D, 3, 254),
    ZZ(NOTE_E, 3, 254),
    ZZ(NOTE_E, 5, 508),
    ZZ(NOTE_B, 4, 254),
    ZZ(NOTE_E, 3, 254),
    ZZ(NOTE_A, 4, 508),
    ZZ(NOTE_B, 4, 127),
    ZZ(NOTE_A, 3, 127),
    ZZ(NOTE_CS, 5, 254),
    ZZ(NOTE_CS, 5, 127),
    ZZ(NOTE_E, 3, 127),
    ZZ(NOTE_B, 4, 254),
    /* Events 577-592 */
    ZZ(NOTE_CS, 5, 254),
    ZZ(NOTE_A, 3, 254),
    ZZ(NOTE_E, 3, 254),
    ZZ(NOTE_B, 4, 254),
    ZZ(NOTE_FS, 3, 127),
    ZZ(NOTE_GS, 3, 127),
    ZZ(NOTE_CS, 5, 254),
    ZZ(NOTE_CS, 5, 254),
    ZZ(NOTE_B, 4, 254),
    ZZ(NOTE_CS, 5, 255),
    ZZ(NOTE_GS, 3, 254),
    ZZ(NOTE_CS, 3, 254),
    ZZ(NOTE_CS, 5, 254),
    ZZ(NOTE_GS, 5, 127),
    ZZ(NOTE_FS, 3, 127),
    ZZ(NOTE_FS, 5, 254),
    /* Events 593-608 */
    ZZ(NOTE_FS, 5, 127),
    ZZ(NOTE_CS, 3, 127),
    ZZ(NOTE_CS, 5, 254),
    ZZ(NOTE_A, 4, 254),
    ZZ(NOTE_FS, 3, 254),
    ZZ(NOTE_FS, 4, 127),
    ZZ(NOTE_CS, 3, 127),
    ZZ(NOTE_B, 4, 254),
    ZZ(NOTE_D, 3, 127),
    ZZ(NOTE_E, 3, 127),
    ZZ(NOTE_A, 4, 763),
    ZZ(NOTE_E, 3, 382),
    ZZ(NOTE_A, 3, 381),
    ZZ(NOTE_E, 5, 254),
    ZZ(NOTE_E, 5, 127),
    ZZ(NOTE_D, 3, 127),
    /* Events 609-624 */
    ZZ(NOTE_E, 5, 254),
    ZZ(NOTE_A, 3, 254),
    ZZ(NOTE_A, 4, 254),
    ZZ(NOTE_D, 3, 254),
    ZZ(NOTE_FS, 4, 254),
    ZZ(NOTE_A, 3, 254),
    ZZ(NOTE_E, 5, 254),
    ZZ(NOTE_GS, 3, 127),
    ZZ(NOTE_CS, 3, 127),
    ZZ(NOTE_E, 5, 508),
    ZZ(NOTE_A, 4, 254),
    ZZ(NOTE_A, 4, 85),
    ZZ(NOTE_FS, 3, 85),
    ZZ(NOTE_FS, 3, 84),
    ZZ(NOTE_FS, 4, 508),
    ZZ(NOTE_E, 5, 254),
    /* Events 625-640 */
    ZZ(NOTE_E, 5, 254),
    ZZ(NOTE_B, 3, 254),
    ZZ(NOTE_CS, 5, 127),
    ZZ(NOTE_FS, 3, 127),
    ZZ(NOTE_FS, 5, 254),
    ZZ(NOTE_B, 3, 254),
    ZZ(NOTE_A, 4, 254),
    ZZ(NOTE_FS, 3, 254),
    ZZ(NOTE_B, 4, 254),
    ZZ(NOTE_E, 3, 508),
    ZZ(NOTE_E, 5, 254),
    ZZ(NOTE_B, 3, 254),
    ZZ(NOTE_B, 4, 254),
    ZZ(NOTE_E, 3, 254),
    ZZ(NOTE_A, 4, 508),
    ZZ(NOTE_B, 4, 127),
    /* Events 641-656 */
    ZZ(NOTE_A, 3, 127),
    ZZ(NOTE_CS, 5, 254),
    ZZ(NOTE_CS, 5, 127),
    ZZ(NOTE_E, 3, 127),
    ZZ(NOTE_B, 4, 254),
    ZZ(NOTE_CS, 5, 254),
    ZZ(NOTE_A, 3, 254),
    ZZ(NOTE_E, 3, 254),
    ZZ(NOTE_B, 4, 254),
    ZZ(NOTE_FS, 3, 127),
    ZZ(NOTE_GS, 3, 127),
    ZZ(NOTE_CS, 5, 254),
    ZZ(NOTE_CS, 5, 254),
    ZZ(NOTE_B, 4, 254),
    ZZ(NOTE_CS, 5, 255),
    ZZ(NOTE_GS, 3, 254),
    /* Events 657-672 */
    ZZ(NOTE_CS, 3, 254),
    ZZ(NOTE_CS, 5, 254),
    ZZ(NOTE_GS, 5, 127),
    ZZ(NOTE_FS, 3, 127),
    ZZ(NOTE_FS, 5, 254),
    ZZ(NOTE_GS, 5, 127),
    ZZ(NOTE_CS, 3, 127),
    ZZ(NOTE_A, 5, 254),
    ZZ(NOTE_A, 5, 254),
    ZZ(NOTE_FS, 3, 254),
    ZZ(NOTE_CS, 5, 127),
    ZZ(NOTE_CS, 3, 127),
    ZZ(NOTE_B, 4, 254),
    ZZ(NOTE_A, 4, 339),
    ZZ(NOTE_D, 3, 339),
    ZZ(NOTE_E, 3, 339),
    /* Events 673-688 */
    ZZ(NOTE_E, 3, 254),
    ZZ(NOTE_A, 3, 254),
    ZZ(NOTE_A, 4, 254),
    ZZ(NOTE_E, 5, 254),
    ZZ(NOTE_E, 5, 127),
    ZZ(NOTE_D, 3, 127),
    ZZ(NOTE_E, 5, 254),
    ZZ(NOTE_A, 3, 254),
    ZZ(NOTE_A, 4, 254),
    ZZ(NOTE_D, 3, 254),
    ZZ(NOTE_FS, 4, 254),
    ZZ(NOTE_A, 3, 254),
    ZZ(NOTE_E, 5, 254),
    ZZ(NOTE_GS, 3, 127),
    ZZ(NOTE_CS, 3, 127),
    ZZ(NOTE_E, 5, 508),
    /* Events 689-704 */
    ZZ(NOTE_A, 4, 254),
    ZZ(NOTE_FS, 3, 127),
    ZZ(NOTE_FS, 3, 127),
    ZZ(NOTE_FS, 4, 508),
    ZZ(NOTE_E, 5, 254),
    ZZ(NOTE_E, 5, 127),
    ZZ(NOTE_B, 3, 127),
    ZZ(NOTE_CS, 5, 254),
    ZZ(NOTE_CS, 5, 127),
    ZZ(NOTE_FS, 3, 127),
    ZZ(NOTE_B, 4, 254),
    ZZ(NOTE_B, 4, 254),
    ZZ(NOTE_B, 3, 254),
    ZZ(NOTE_FS, 3, 254),
    ZZ(NOTE_E, 5, 254),
    ZZ(NOTE_E, 5, 127),
    /* Events 705-720 */
    ZZ(NOTE_E, 3, 127),
    ZZ(NOTE_CS, 5, 254),
    ZZ(NOTE_CS, 5, 127),
    ZZ(NOTE_B, 3, 127),
    ZZ(NOTE_B, 4, 254),
    ZZ(NOTE_B, 4, 254),
    ZZ(NOTE_E, 3, 254),
    ZZ(NOTE_B, 3, 254),
    ZZ(NOTE_CS, 5, 254),
    ZZ(NOTE_D, 3, 254),
    ZZ(NOTE_GS, 3, 254),
    ZZ(NOTE_A, 4, 1525),
    ZZ(NOTE_D, 4, 508),
    ZZ(NOTE_CS, 4, 508),
    ZZ(NOTE_B, 3, 508),
    ZZ(NOTE_A, 3, 508),
    /* Events 721-736 */
    ZZ(NOTE_E, 4, 254),
    ZZ(NOTE_GS, 3, 254),
    ZZ(NOTE_GS, 3, 508),
    ZZ(NOTE_E, 4, 127),
    ZZ(NOTE_GS, 3, 127),
    ZZ(NOTE_E, 4, 254),
    ZZ(NOTE_GS, 3, 508),
    ZZ(NOTE_D, 4, 254),
    ZZ(NOTE_GS, 3, 254),
    ZZ(NOTE_CS, 4, 254),
    ZZ(NOTE_FS, 3, 254),
    ZZ(NOTE_B, 3, 254),
    ZZ(NOTE_E, 3, 254),
    ZZ(NOTE_A, 3, 254),
    ZZ(NOTE_D, 3, 254),
    ZZ(NOTE_A, 3, 127),
    /* Events 737-752 */
    ZZ(NOTE_A, 3, 127),
    ZZ(NOTE_E, 4, 508),
    ZZ(NOTE_A, 3, 254),
    ZZ(NOTE_E, 4, 254),
    ZZ(NOTE_E, 3, 254),
    ZZ(NOTE_A, 3, 508),
    ZZ(NOTE_D, 4, 254),
    ZZ(NOTE_A, 3, 254),
    ZZ(NOTE_CS, 4, 508),
    ZZ(NOTE_B, 3, 254),
    ZZ(NOTE_E, 3, 254),
    ZZ(NOTE_A, 3, 508),
    ZZ(NOTE_A, 3, 127),
    ZZ(NOTE_A, 3, 127),
    ZZ(NOTE_E, 4, 508),
    ZZ(NOTE_A, 3, 254),
    /* Events 753-768 */
    ZZ(NOTE_E, 4, 254),
    ZZ(NOTE_E, 3, 254),
    ZZ(NOTE_A, 3, 508),
    ZZ(NOTE_D, 4, 254),
    ZZ(NOTE_A, 3, 254),
    ZZ(NOTE_CS, 4, 508),
    ZZ(NOTE_E, 5, 127),
    ZZ(NOTE_B, 3, 127),
    ZZ(NOTE_D, 5, 254),
    ZZ(NOTE_CS, 5, 127),
    ZZ(NOTE_A, 3, 127),
    ZZ(NOTE_D, 5, 254),
    ZZ(NOTE_E, 5, 170),
    ZZ(NOTE_E, 4, 169),
    ZZ(NOTE_GS, 3, 169),
    ZZ(NOTE_B, 4, 508),
    /* Events 769-784 */
    ZZ(NOTE_E, 4, 763),
    ZZ(NOTE_CS, 4, 254),
    ZZ(NOTE_B, 4, 508),
    ZZ(NOTE_CS, 4, 508),
    ZZ(NOTE_B, 3, 508),
    ZZ(NOTE_A, 3, 508),
    ZZ(NOTE_A, 4, 254),
    ZZ(NOTE_FS, 3, 254),
    ZZ(NOTE_A, 3, 508),
    ZZ(NOTE_CS, 4, 508),
    ZZ(NOTE_D, 5, 254),
    ZZ(NOTE_A, 3, 254),
    ZZ(NOTE_FS, 3, 508),
    ZZ(NOTE_CS, 5, 254),
    ZZ(NOTE_A, 3, 254),
    ZZ(NOTE_B, 4, 254),
    /* Events 785-800 */
    ZZ(NOTE_CS, 4, 254),
    ZZ(NOTE_A, 4, 254),
    ZZ(NOTE_FS, 3, 254),
    ZZ(NOTE_E, 4, 254),
    ZZ(NOTE_D, 3, 254),
    ZZ(NOTE_FS, 3, 508),
    ZZ(NOTE_E, 4, 254),
    ZZ(NOTE_A, 3, 254),
    ZZ(NOTE_FS, 3, 254),
    ZZ(NOTE_CS, 4, 254),
    ZZ(NOTE_D, 4, 254),
    ZZ(NOTE_A, 3, 254),
    ZZ(NOTE_CS, 4, 508),
    ZZ(NOTE_B, 3, 254),
    ZZ(NOTE_D, 3, 254),
    ZZ(NOTE_A, 3, 508),
    /* Events 801-816 */
    ZZ(NOTE_B, 3, 678),
    ZZ(NOTE_E, 3, 678),
    ZZ(NOTE_E, 3, 678),
    ZZ_R(508),
    ZZ(NOTE_E, 5, 508),
    ZZ(NOTE_CS, 5, 254),
    ZZ(NOTE_B, 4, 254),
    ZZ(NOTE_A, 4, 508),
    ZZ(NOTE_B, 4, 85),
    ZZ(NOTE_E, 4, 85),
    ZZ(NOTE_A, 3, 84),
    ZZ(NOTE_CS, 5, 254),
    ZZ(NOTE_CS, 5, 254),
    ZZ(NOTE_B, 4, 254),
    ZZ(NOTE_CS, 5, 763),
    ZZ(NOTE_B, 4, 254),
    /* Events 817-832 */
    ZZ(NOTE_D, 4, 127),
    ZZ(NOTE_GS, 3, 127),
    ZZ(NOTE_CS, 5, 254),
    ZZ(NOTE_CS, 5, 254),
    ZZ(NOTE_B, 4, 254),
    ZZ(NOTE_CS, 5, 255),
    ZZ(NOTE_GS, 3, 254),
    ZZ(NOTE_CS, 3, 254),
    ZZ(NOTE_CS, 5, 254),
    ZZ(NOTE_GS, 5, 85),
    ZZ(NOTE_CS, 4, 85),
    ZZ(NOTE_FS, 3, 84),
    ZZ(NOTE_FS, 5, 254),
    ZZ(NOTE_FS, 5, 254),
    ZZ(NOTE_CS, 5, 254),
    ZZ(NOTE_A, 4, 508),
    /* Events 833-848 */
    ZZ(NOTE_FS, 4, 254),
    ZZ(NOTE_B, 4, 254),
    ZZ(NOTE_D, 4, 127),
    ZZ(NOTE_E, 3, 127),
    ZZ(NOTE_A, 4, 763),
    ZZ(NOTE_CS, 4, 382),
    ZZ(NOTE_A, 3, 381),
    ZZ(NOTE_E, 5, 254),
    ZZ(NOTE_E, 5, 85),
    ZZ(NOTE_A, 3, 85),
    ZZ(NOTE_D, 3, 84),
    ZZ(NOTE_E, 5, 508),
    ZZ(NOTE_A, 4, 254),
    ZZ(NOTE_A, 4, 254),
    ZZ(NOTE_FS, 4, 508),
    ZZ(NOTE_E, 5, 254),
    /* Events 849-864 */
    ZZ(NOTE_GS, 3, 127),
    ZZ(NOTE_CS, 3, 127),
    ZZ(NOTE_E, 5, 508),
    ZZ(NOTE_A, 4, 254),
    ZZ(NOTE_FS, 3, 127),
    ZZ(NOTE_FS, 3, 127),
    ZZ(NOTE_FS, 4, 508),
    ZZ(NOTE_E, 5, 254),
    ZZ(NOTE_E, 5, 254),
    ZZ(NOTE_B, 3, 254),
    ZZ(NOTE_CS, 5, 127),
    ZZ(NOTE_FS, 3, 127),
    ZZ(NOTE_FS, 5, 254),
    ZZ(NOTE_B, 3, 254),
    ZZ(NOTE_A, 4, 508),
    ZZ(NOTE_B, 4, 85),
    /* Events 865-880 */
    ZZ(NOTE_E, 3, 85),
    ZZ(NOTE_E, 3, 84),
    ZZ(NOTE_B, 4, 254),
    ZZ(NOTE_B, 3, 254),
    ZZ(NOTE_E, 5, 254),
    ZZ(NOTE_E, 3, 254),
    ZZ(NOTE_CS, 5, 254),
    ZZ(NOTE_B, 4, 254),
    ZZ(NOTE_A, 4, 508),
    ZZ(NOTE_B, 4, 127),
    ZZ(NOTE_A, 3, 127),
    ZZ(NOTE_CS, 5, 254),
    ZZ(NOTE_CS, 5, 127),
    ZZ(NOTE_E, 3, 127),
    ZZ(NOTE_B, 4, 254),
    ZZ(NOTE_CS, 5, 254),
    /* Events 881-896 */
    ZZ(NOTE_A, 3, 254),
    ZZ(NOTE_E, 3, 254),
    ZZ(NOTE_B, 4, 254),
    ZZ(NOTE_FS, 3, 127),
    ZZ(NOTE_GS, 3, 127),
    ZZ(NOTE_CS, 5, 254),
    ZZ(NOTE_CS, 5, 254),
    ZZ(NOTE_B, 4, 254),
    ZZ(NOTE_CS, 5, 255),
    ZZ(NOTE_GS, 3, 254),
    ZZ(NOTE_CS, 3, 254),
    ZZ(NOTE_CS, 5, 254),
    ZZ(NOTE_GS, 5, 127),
    ZZ(NOTE_FS, 3, 127),
    ZZ(NOTE_FS, 5, 254),
    ZZ(NOTE_GS, 5, 127),
    /* Events 897-912 */
    ZZ(NOTE_CS, 3, 127),
    ZZ(NOTE_A, 5, 254),
    ZZ(NOTE_A, 5, 254),
    ZZ(NOTE_FS, 3, 254),
    ZZ(NOTE_CS, 5, 127),
    ZZ(NOTE_CS, 3, 127),
    ZZ(NOTE_B, 4, 254),
    ZZ(NOTE_D, 3, 127),
    ZZ(NOTE_E, 3, 127),
    ZZ(NOTE_A, 4, 763),
    ZZ(NOTE_E, 3, 382),
    ZZ(NOTE_A, 3, 381),
    ZZ(NOTE_E, 5, 254),
    ZZ(NOTE_E, 5, 127),
    ZZ(NOTE_D, 3, 127),
    ZZ(NOTE_E, 5, 254),
    /* Events 913-928 */
    ZZ(NOTE_A, 3, 254),
    ZZ(NOTE_A, 4, 254),
    ZZ(NOTE_D, 4, 254),
    ZZ(NOTE_FS, 4, 254),
    ZZ(NOTE_A, 3, 254),
    ZZ(NOTE_A, 5, 254),
    ZZ(NOTE_A, 3, 127),
    ZZ(NOTE_CS, 3, 127),
    ZZ(NOTE_A, 5, 508),
    ZZ(NOTE_A, 4, 254),
    ZZ(NOTE_A, 4, 85),
    ZZ(NOTE_FS, 3, 85),
    ZZ(NOTE_FS, 3, 84),
    ZZ(NOTE_FS, 4, 508),
    ZZ(NOTE_E, 5, 254),
    ZZ(NOTE_E, 5, 127),
    /* Events 929-944 */
    ZZ(NOTE_B, 3, 127),
    ZZ(NOTE_CS, 5, 254),
    ZZ(NOTE_CS, 5, 127),
    ZZ(NOTE_FS, 3, 127),
    ZZ(NOTE_B, 4, 254),
    ZZ(NOTE_B, 4, 508),
    ZZ(NOTE_FS, 3, 254),
    ZZ(NOTE_E, 5, 254),
    ZZ(NOTE_E, 5, 127),
    ZZ(NOTE_E, 3, 127),
    ZZ(NOTE_CS, 5, 254),
    ZZ(NOTE_CS, 5, 127),
    ZZ(NOTE_B, 3, 127),
    ZZ(NOTE_B, 4, 254),
    ZZ(NOTE_B, 4, 508),
    ZZ(NOTE_B, 3, 254),
    /* Events 945-960 */
    ZZ(NOTE_CS, 5, 254),
    ZZ(NOTE_FS, 3, 508),
    ZZ(NOTE_A, 4, 254),
    ZZ(NOTE_A, 3, 254),
    ZZ(NOTE_GS, 3, 254),
    ZZ(NOTE_FS, 3, 254),
    ZZ(NOTE_E, 3, 508),
    ZZ(NOTE_A, 3, 1017),
    ZZ(NOTE_DS, 3, 1017),
    ZZ(NOTE_A, 3, 1780),
    ZZ(NOTE_E, 5, 254),
    ZZ(NOTE_E, 5, 127),
    ZZ(NOTE_B, 3, 127),
    ZZ(NOTE_CS, 5, 254),
    ZZ(NOTE_CS, 5, 254),
    ZZ(NOTE_B, 4, 254),
    /* Events 961-976 */
    ZZ(NOTE_B, 4, 255),
    ZZ(NOTE_B, 3, 254),
    ZZ(NOTE_FS, 3, 254),
    ZZ(NOTE_E, 5, 254),
    ZZ(NOTE_E, 5, 85),
    ZZ(NOTE_E, 3, 85),
    ZZ(NOTE_E, 3, 84),
    ZZ(NOTE_CS, 5, 254),
    ZZ(NOTE_CS, 5, 254),
    ZZ(NOTE_B, 4, 254),
    ZZ(NOTE_B, 4, 3051),
    ZZ(NOTE_E, 3, 1525),
    ZZ(NOTE_CS, 5, 508),
    ZZ(NOTE_A, 4, 508),
    ZZ(NOTE_E, 4, 508),
    ZZ(NOTE_B, 3, 508),
    /* Events 977-992 */
    ZZ(NOTE_A, 3, 508),
    ZZ(NOTE_A, 3, 85),
    ZZ(NOTE_D, 3, 85),
    ZZ(NOTE_D, 3, 84),
    ZZ(NOTE_E, 4, 508),
    ZZ(NOTE_A, 3, 254),
    ZZ(NOTE_E, 4, 508),
    ZZ(NOTE_A, 3, 254),
    ZZ(NOTE_D, 4, 254),
    ZZ(NOTE_D, 4, 508),
    ZZ(NOTE_CS, 4, 508),
    ZZ(NOTE_B, 3, 508),
    ZZ(NOTE_A, 3, 508),
    ZZ(NOTE_GS, 3, 127),
    ZZ(NOTE_D, 3, 127),
    ZZ(NOTE_E, 4, 508),
    /* Events 993-1008 */
    ZZ(NOTE_GS, 3, 254),
    ZZ(NOTE_E, 4, 508),
    ZZ(NOTE_GS, 3, 508),
    ZZ(NOTE_GS, 3, 2034),
    ZZ(NOTE_A, 3, 127),
    ZZ(NOTE_D, 3, 127),
    ZZ(NOTE_E, 4, 508),
    ZZ(NOTE_A, 3, 254),
    ZZ(NOTE_E, 4, 254),
    ZZ(NOTE_A, 3, 254),
    ZZ(NOTE_A, 3, 254),
    ZZ(NOTE_D, 4, 254),
    ZZ(NOTE_D, 3, 508),
    ZZ(NOTE_CS, 4, 508),
    ZZ(NOTE_B, 3, 254),
    ZZ(NOTE_FS, 3, 254),
    /* Events 1009-1017 */
    ZZ(NOTE_A, 3, 508),
    ZZ(NOTE_GS, 3, 127),
    ZZ(NOTE_D, 3, 127),
    ZZ(NOTE_E, 4, 508),
    ZZ(NOTE_GS, 3, 254),
    ZZ(NOTE_E, 4, 508),
    ZZ(NOTE_GS, 3, 508),
    ZZ(NOTE_GS, 3, 2034),
    ZZ(NOTE_E, 4, 4068)
};

#undef ZZ_R
#undef ZZ
