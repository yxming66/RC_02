/*
 * JJ Lin - Exchange Lifetime.
 * Complete single-line PWM buzzer reduction generated from probe.
 * Simultaneous right-hand, left-hand, and chord tones are
 * arpeggiated into one buzzer line with the upper voice first;
 * notes outside the practical buzzer range are folded by octaves.
 * 1227 buzzer events, about 148 seconds.
 */
#define EXL(note, octave, ms) {note, octave, (uint16_t)(ms)}
#define EXL_R(ms) {NOTE_REST, 0, (uint16_t)(ms)}

const Tone_t EXCHANGE_LIFETIME[] = {
    /* Events 1-16 */
    EXL(NOTE_A, 3, 250),
    EXL_R(1750),
    EXL(NOTE_FS, 4, 84),
    EXL(NOTE_D, 4, 83),
    EXL(NOTE_D, 3, 83),
    EXL(NOTE_A, 3, 250),
    EXL(NOTE_G, 4, 125),
    EXL(NOTE_D, 4, 125),
    EXL(NOTE_A, 3, 250),
    EXL(NOTE_A, 4, 250),
    EXL(NOTE_E, 4, 250),
    EXL(NOTE_D, 5, 250),
    EXL(NOTE_A, 4, 250),
    EXL(NOTE_C, 5, 84),
    EXL(NOTE_G, 4, 83),
    EXL(NOTE_A, 3, 83),
    /* Events 17-32 */
    EXL(NOTE_E, 3, 250),
    EXL(NOTE_B, 3, 250),
    EXL(NOTE_C, 4, 250),
    EXL(NOTE_B, 4, 250),
    EXL(NOTE_D, 4, 250),
    EXL(NOTE_A, 4, 500),
    EXL(NOTE_E, 4, 84),
    EXL(NOTE_C, 4, 83),
    EXL(NOTE_C, 3, 83),
    EXL(NOTE_G, 3, 250),
    EXL(NOTE_FS, 4, 125),
    EXL(NOTE_D, 4, 125),
    EXL(NOTE_C, 4, 250),
    EXL(NOTE_G, 4, 375),
    EXL(NOTE_E, 4, 375),
    EXL(NOTE_A, 4, 250),
    /* Events 33-48 */
    EXL(NOTE_D, 4, 84),
    EXL(NOTE_A, 3, 83),
    EXL(NOTE_G, 3, 83),
    EXL(NOTE_D, 3, 250),
    EXL(NOTE_G, 3, 250),
    EXL(NOTE_A, 3, 250),
    EXL(NOTE_D, 4, 250),
    EXL(NOTE_A, 3, 250),
    EXL(NOTE_A, 4, 500),
    EXL(NOTE_FS, 5, 63),
    EXL(NOTE_FS, 4, 63),
    EXL(NOTE_D, 3, 124),
    EXL(NOTE_A, 3, 250),
    EXL(NOTE_G, 5, 125),
    EXL(NOTE_G, 4, 125),
    EXL(NOTE_A, 3, 250),
    /* Events 49-64 */
    EXL(NOTE_A, 5, 250),
    EXL(NOTE_A, 4, 250),
    EXL(NOTE_D, 6, 250),
    EXL(NOTE_D, 5, 250),
    EXL(NOTE_C, 6, 84),
    EXL(NOTE_C, 5, 83),
    EXL(NOTE_A, 3, 83),
    EXL(NOTE_E, 3, 250),
    EXL(NOTE_B, 3, 250),
    EXL(NOTE_C, 4, 250),
    EXL(NOTE_B, 4, 250),
    EXL(NOTE_D, 4, 250),
    EXL(NOTE_A, 4, 250),
    EXL(NOTE_D, 4, 250),
    EXL(NOTE_G, 4, 63),
    EXL(NOTE_D, 4, 63),
    /* Events 65-80 */
    EXL(NOTE_C, 3, 124),
    EXL(NOTE_E, 3, 250),
    EXL(NOTE_E, 5, 84),
    EXL(NOTE_G, 4, 83),
    EXL(NOTE_G, 3, 83),
    EXL(NOTE_C, 4, 250),
    EXL(NOTE_FS, 5, 250),
    EXL(NOTE_A, 4, 250),
    EXL(NOTE_G, 5, 250),
    EXL(NOTE_B, 4, 250),
    EXL(NOTE_A, 5, 125),
    EXL(NOTE_D, 5, 125),
    EXL(NOTE_A, 4, 125),
    EXL(NOTE_A, 3, 125),
    EXL(NOTE_D, 5, 125),
    EXL(NOTE_A, 4, 125),
    /* Events 81-96 */
    EXL(NOTE_A, 3, 250),
    EXL(NOTE_E, 5, 334),
    EXL(NOTE_CS, 5, 333),
    EXL(NOTE_A, 4, 333),
    EXL(NOTE_FS, 5, 84),
    EXL(NOTE_A, 4, 83),
    EXL(NOTE_D, 4, 83),
    EXL(NOTE_FS, 5, 375),
    EXL(NOTE_G, 5, 125),
    EXL(NOTE_A, 5, 125),
    EXL(NOTE_B, 5, 63),
    EXL(NOTE_FS, 5, 62),
    EXL(NOTE_D, 4, 125),
    EXL(NOTE_G, 3, 125),
    EXL(NOTE_E, 5, 375),
    EXL(NOTE_FS, 5, 125),
    /* Events 97-112 */
    EXL(NOTE_G, 5, 125),
    EXL(NOTE_A, 5, 63),
    EXL(NOTE_E, 5, 62),
    EXL(NOTE_A, 4, 125),
    EXL(NOTE_CS, 4, 125),
    EXL(NOTE_E, 5, 375),
    EXL(NOTE_FS, 5, 125),
    EXL(NOTE_G, 5, 125),
    EXL(NOTE_FS, 5, 63),
    EXL(NOTE_B, 4, 62),
    EXL(NOTE_E, 4, 167),
    EXL(NOTE_CS, 4, 167),
    EXL(NOTE_FS, 3, 166),
    EXL(NOTE_E, 4, 125),
    EXL(NOTE_CS, 5, 125),
    EXL(NOTE_FS, 5, 125),
    /* Events 113-128 */
    EXL(NOTE_E, 5, 125),
    EXL(NOTE_D, 5, 84),
    EXL(NOTE_A, 4, 83),
    EXL(NOTE_B, 3, 83),
    EXL(NOTE_D, 5, 313),
    EXL(NOTE_A, 3, 62),
    EXL(NOTE_E, 5, 125),
    EXL(NOTE_FS, 5, 188),
    EXL(NOTE_GS, 4, 62),
    EXL(NOTE_D, 4, 125),
    EXL(NOTE_E, 3, 125),
    EXL(NOTE_B, 4, 375),
    EXL(NOTE_CS, 5, 125),
    EXL(NOTE_D, 5, 125),
    EXL(NOTE_E, 5, 63),
    EXL(NOTE_B, 4, 62),
    /* Events 129-144 */
    EXL(NOTE_E, 5, 250),
    EXL(NOTE_B, 3, 250),
    EXL(NOTE_D, 4, 125),
    EXL(NOTE_G, 4, 125),
    EXL(NOTE_B, 4, 125),
    EXL(NOTE_D, 5, 292),
    EXL(NOTE_G, 4, 167),
    EXL(NOTE_A, 3, 166),
    EXL(NOTE_E, 5, 167),
    EXL(NOTE_CS, 5, 167),
    EXL(NOTE_E, 4, 166),
    EXL(NOTE_CS, 6, 63),
    EXL(NOTE_A, 5, 63),
    EXL(NOTE_E, 5, 62),
    EXL(NOTE_FS, 3, 62),
    EXL(NOTE_CS, 6, 63),
    /* Events 145-160 */
    EXL(NOTE_CS, 4, 62),
    EXL(NOTE_E, 4, 125),
    EXL(NOTE_CS, 6, 63),
    EXL(NOTE_A, 4, 62),
    EXL(NOTE_B, 5, 63),
    EXL(NOTE_CS, 5, 62),
    EXL(NOTE_A, 5, 125),
    EXL(NOTE_D, 6, 63),
    EXL(NOTE_A, 5, 62),
    EXL(NOTE_FS, 4, 250),
    EXL(NOTE_B, 3, 250),
    EXL_R(500),
    EXL(NOTE_CS, 6, 63),
    EXL(NOTE_A, 5, 63),
    EXL(NOTE_E, 5, 62),
    EXL(NOTE_FS, 3, 62),
    /* Events 161-176 */
    EXL(NOTE_CS, 4, 125),
    EXL(NOTE_CS, 6, 63),
    EXL(NOTE_E, 4, 62),
    EXL(NOTE_CS, 6, 63),
    EXL(NOTE_A, 4, 62),
    EXL(NOTE_D, 6, 63),
    EXL(NOTE_CS, 5, 62),
    EXL(NOTE_E, 6, 250),
    EXL(NOTE_D, 6, 84),
    EXL(NOTE_A, 5, 83),
    EXL(NOTE_B, 3, 83),
    EXL(NOTE_FS, 3, 250),
    EXL(NOTE_FS, 6, 84),
    EXL(NOTE_A, 5, 83),
    EXL(NOTE_D, 4, 83),
    EXL(NOTE_D, 6, 125),
    /* Events 177-192 */
    EXL(NOTE_A, 3, 125),
    EXL(NOTE_B, 5, 63),
    EXL(NOTE_G, 5, 63),
    EXL(NOTE_D, 5, 62),
    EXL(NOTE_E, 3, 62),
    EXL(NOTE_B, 3, 125),
    EXL(NOTE_B, 5, 63),
    EXL(NOTE_D, 4, 62),
    EXL(NOTE_B, 5, 56),
    EXL(NOTE_G, 5, 56),
    EXL(NOTE_G, 4, 55),
    EXL(NOTE_CS, 6, 167),
    EXL(NOTE_D, 6, 251),
    EXL(NOTE_A, 5, 83),
    EXL(NOTE_FS, 3, 83),
    EXL(NOTE_A, 5, 84),
    /* Events 193-208 */
    EXL(NOTE_E, 5, 83),
    EXL(NOTE_D, 4, 83),
    EXL(NOTE_A, 5, 56),
    EXL(NOTE_E, 5, 56),
    EXL(NOTE_FS, 4, 55),
    EXL(NOTE_G, 5, 167),
    EXL(NOTE_FS, 5, 230),
    EXL(NOTE_D, 5, 63),
    EXL(NOTE_AS, 4, 62),
    EXL(NOTE_G, 3, 312),
    EXL(NOTE_G, 5, 125),
    EXL(NOTE_D, 5, 125),
    EXL(NOTE_D, 4, 250),
    EXL(NOTE_D, 6, 250),
    EXL(NOTE_G, 5, 250),
    EXL_R(250),
    /* Events 209-224 */
    EXL(NOTE_E, 6, 313),
    EXL(NOTE_B, 5, 63),
    EXL(NOTE_G, 5, 62),
    EXL(NOTE_A, 3, 62),
    EXL(NOTE_G, 3, 125),
    EXL(NOTE_A, 3, 125),
    EXL(NOTE_B, 3, 125),
    EXL(NOTE_D, 4, 125),
    EXL(NOTE_A, 4, 250),
    EXL(NOTE_A, 5, 200),
    EXL(NOTE_D, 5, 200),
    EXL(NOTE_B, 4, 200),
    EXL(NOTE_G, 3, 200),
    EXL(NOTE_A, 3, 200),
    EXL_R(500),
    EXL(NOTE_FS, 6, 125),
    /* Events 225-240 */
    EXL(NOTE_G, 6, 125),
    EXL(NOTE_FS, 6, 125),
    EXL(NOTE_E, 6, 125),
    EXL_R(1000),
    EXL(NOTE_FS, 6, 84),
    EXL(NOTE_B, 5, 83),
    EXL(NOTE_G, 3, 83),
    EXL(NOTE_D, 4, 125),
    EXL(NOTE_G, 4, 125),
    EXL(NOTE_B, 5, 63),
    EXL(NOTE_FS, 5, 62),
    EXL(NOTE_A, 4, 125),
    EXL(NOTE_B, 4, 125),
    EXL(NOTE_D, 5, 125),
    EXL(NOTE_E, 6, 84),
    EXL(NOTE_A, 5, 83),
    /* Events 241-256 */
    EXL(NOTE_A, 3, 83),
    EXL(NOTE_E, 4, 250),
    EXL(NOTE_A, 5, 250),
    EXL(NOTE_CS, 5, 250),
    EXL(NOTE_E, 6, 63),
    EXL(NOTE_A, 5, 63),
    EXL(NOTE_E, 5, 62),
    EXL(NOTE_FS, 3, 62),
    EXL(NOTE_CS, 4, 125),
    EXL(NOTE_E, 4, 125),
    EXL(NOTE_A, 5, 63),
    EXL(NOTE_E, 5, 62),
    EXL(NOTE_A, 4, 125),
    EXL(NOTE_CS, 5, 125),
    EXL(NOTE_A, 4, 125),
    EXL(NOTE_D, 6, 84),
    /* Events 257-272 */
    EXL(NOTE_A, 5, 83),
    EXL(NOTE_B, 3, 83),
    EXL(NOTE_FS, 3, 250),
    EXL(NOTE_FS, 6, 63),
    EXL(NOTE_D, 4, 62),
    EXL(NOTE_G, 6, 125),
    EXL(NOTE_FS, 6, 125),
    EXL(NOTE_E, 6, 125),
    EXL(NOTE_FS, 6, 84),
    EXL(NOTE_B, 5, 83),
    EXL(NOTE_E, 3, 83),
    EXL(NOTE_B, 3, 250),
    EXL(NOTE_B, 5, 42),
    EXL(NOTE_G, 5, 42),
    EXL(NOTE_D, 4, 41),
    EXL(NOTE_G, 4, 125),
    /* Events 273-288 */
    EXL(NOTE_B, 4, 125),
    EXL(NOTE_D, 5, 125),
    EXL(NOTE_G, 6, 63),
    EXL(NOTE_D, 6, 63),
    EXL(NOTE_B, 5, 62),
    EXL(NOTE_A, 3, 62),
    EXL(NOTE_FS, 6, 63),
    EXL(NOTE_G, 3, 62),
    EXL(NOTE_E, 6, 125),
    EXL(NOTE_A, 3, 125),
    EXL(NOTE_D, 6, 375),
    EXL(NOTE_FS, 6, 84),
    EXL(NOTE_C, 6, 83),
    EXL(NOTE_A, 3, 83),
    EXL(NOTE_G, 3, 125),
    EXL(NOTE_C, 4, 125),
    /* Events 289-304 */
    EXL(NOTE_D, 4, 125),
    EXL(NOTE_E, 4, 125),
    EXL(NOTE_G, 4, 125),
    EXL(NOTE_C, 4, 125),
    EXL(NOTE_E, 5, 63),
    EXL(NOTE_C, 5, 63),
    EXL(NOTE_C, 4, 62),
    EXL(NOTE_D, 3, 62),
    EXL(NOTE_A, 5, 125),
    EXL(NOTE_E, 5, 125),
    EXL(NOTE_FS, 6, 42),
    EXL(NOTE_C, 6, 42),
    EXL(NOTE_FS, 4, 41),
    EXL(NOTE_E, 6, 125),
    EXL(NOTE_D, 6, 125),
    EXL(NOTE_E, 6, 125),
    /* Events 305-320 */
    EXL(NOTE_FS, 6, 84),
    EXL(NOTE_B, 5, 83),
    EXL(NOTE_G, 3, 83),
    EXL(NOTE_B, 3, 250),
    EXL(NOTE_B, 6, 125),
    EXL(NOTE_B, 5, 125),
    EXL(NOTE_G, 4, 125),
    EXL(NOTE_D, 4, 125),
    EXL(NOTE_E, 6, 63),
    EXL(NOTE_CS, 6, 63),
    EXL(NOTE_A, 5, 62),
    EXL(NOTE_G, 3, 62),
    EXL(NOTE_E, 3, 250),
    EXL(NOTE_FS, 6, 84),
    EXL(NOTE_A, 5, 83),
    EXL(NOTE_CS, 4, 83),
    /* Events 321-336 */
    EXL(NOTE_E, 4, 250),
    EXL(NOTE_A, 6, 63),
    EXL(NOTE_E, 6, 63),
    EXL(NOTE_A, 5, 62),
    EXL(NOTE_FS, 3, 62),
    EXL(NOTE_A, 6, 63),
    EXL(NOTE_CS, 4, 62),
    EXL(NOTE_FS, 6, 63),
    EXL(NOTE_E, 4, 62),
    EXL(NOTE_B, 6, 63),
    EXL(NOTE_A, 4, 62),
    EXL(NOTE_CS, 5, 125),
    EXL(NOTE_D, 6, 188),
    EXL(NOTE_A, 5, 62),
    EXL(NOTE_D, 6, 250),
    EXL(NOTE_FS, 3, 250),
    /* Events 337-352 */
    EXL(NOTE_A, 4, 63),
    EXL(NOTE_D, 4, 62),
    EXL(NOTE_B, 5, 250),
    EXL(NOTE_CS, 6, 125),
    EXL(NOTE_D, 6, 63),
    EXL(NOTE_G, 5, 63),
    EXL(NOTE_D, 5, 62),
    EXL(NOTE_E, 3, 62),
    EXL(NOTE_B, 3, 125),
    EXL(NOTE_D, 4, 125),
    EXL(NOTE_FS, 6, 63),
    EXL(NOTE_D, 6, 62),
    EXL(NOTE_G, 4, 125),
    EXL(NOTE_B, 4, 125),
    EXL(NOTE_D, 5, 125),
    EXL(NOTE_CS, 6, 250),
    /* Events 353-368 */
    EXL(NOTE_A, 5, 250),
    EXL(NOTE_E, 5, 250),
    EXL(NOTE_A, 3, 250),
    EXL(NOTE_FS, 4, 63),
    EXL(NOTE_D, 3, 62),
    EXL(NOTE_D, 4, 125),
    EXL(NOTE_FS, 4, 125),
    EXL(NOTE_D, 4, 125),
    EXL(NOTE_FS, 4, 125),
    EXL(NOTE_D, 4, 125),
    EXL(NOTE_FS, 4, 125),
    EXL(NOTE_D, 4, 125),
    EXL(NOTE_FS, 4, 125),
    EXL(NOTE_D, 4, 125),
    EXL(NOTE_FS, 4, 125),
    EXL(NOTE_D, 4, 125),
    /* Events 369-384 */
    EXL(NOTE_FS, 4, 125),
    EXL(NOTE_D, 4, 125),
    EXL(NOTE_FS, 4, 125),
    EXL(NOTE_D, 4, 125),
    EXL(NOTE_F, 4, 63),
    EXL(NOTE_D, 3, 62),
    EXL(NOTE_D, 4, 125),
    EXL(NOTE_F, 4, 125),
    EXL(NOTE_D, 4, 125),
    EXL(NOTE_F, 4, 125),
    EXL(NOTE_D, 4, 125),
    EXL(NOTE_F, 4, 125),
    EXL(NOTE_D, 4, 125),
    EXL(NOTE_F, 4, 125),
    EXL(NOTE_D, 4, 125),
    EXL(NOTE_F, 4, 125),
    /* Events 385-400 */
    EXL(NOTE_D, 4, 125),
    EXL(NOTE_F, 4, 125),
    EXL(NOTE_D, 4, 125),
    EXL(NOTE_F, 4, 125),
    EXL(NOTE_D, 4, 125),
    EXL(NOTE_FS, 4, 63),
    EXL(NOTE_D, 3, 62),
    EXL(NOTE_D, 4, 125),
    EXL(NOTE_FS, 4, 125),
    EXL(NOTE_D, 4, 125),
    EXL(NOTE_FS, 4, 125),
    EXL(NOTE_D, 4, 125),
    EXL(NOTE_FS, 4, 125),
    EXL(NOTE_D, 4, 125),
    EXL(NOTE_A, 4, 125),
    EXL(NOTE_D, 4, 125),
    /* Events 401-416 */
    EXL(NOTE_FS, 4, 125),
    EXL(NOTE_D, 4, 125),
    EXL(NOTE_FS, 4, 125),
    EXL(NOTE_D, 4, 125),
    EXL(NOTE_FS, 4, 125),
    EXL(NOTE_D, 4, 125),
    EXL(NOTE_FS, 4, 63),
    EXL(NOTE_D, 3, 62),
    EXL(NOTE_D, 4, 125),
    EXL(NOTE_FS, 4, 125),
    EXL(NOTE_D, 4, 125),
    EXL(NOTE_FS, 4, 125),
    EXL(NOTE_D, 4, 125),
    EXL(NOTE_FS, 4, 125),
    EXL(NOTE_D, 4, 125),
    EXL(NOTE_D, 5, 125),
    /* Events 417-432 */
    EXL(NOTE_D, 4, 125),
    EXL(NOTE_FS, 4, 125),
    EXL(NOTE_D, 4, 125),
    EXL(NOTE_FS, 4, 125),
    EXL(NOTE_D, 4, 125),
    EXL(NOTE_FS, 4, 125),
    EXL(NOTE_D, 4, 125),
    EXL(NOTE_A, 5, 42),
    EXL(NOTE_A, 4, 42),
    EXL(NOTE_D, 3, 41),
    EXL(NOTE_D, 4, 125),
    EXL(NOTE_FS, 4, 125),
    EXL(NOTE_D, 4, 125),
    EXL(NOTE_FS, 4, 125),
    EXL(NOTE_D, 4, 125),
    EXL(NOTE_FS, 4, 125),
    /* Events 433-448 */
    EXL(NOTE_D, 4, 125),
    EXL(NOTE_FS, 4, 125),
    EXL(NOTE_D, 4, 125),
    EXL(NOTE_FS, 4, 125),
    EXL(NOTE_D, 4, 125),
    EXL(NOTE_FS, 4, 125),
    EXL(NOTE_A, 4, 63),
    EXL(NOTE_D, 4, 62),
    EXL(NOTE_D, 5, 63),
    EXL(NOTE_FS, 4, 62),
    EXL(NOTE_A, 5, 42),
    EXL(NOTE_A, 4, 42),
    EXL(NOTE_D, 4, 41),
    EXL(NOTE_GS, 5, 42),
    EXL(NOTE_GS, 4, 42),
    EXL(NOTE_D, 3, 41),
    /* Events 449-464 */
    EXL(NOTE_D, 4, 125),
    EXL(NOTE_F, 4, 125),
    EXL(NOTE_D, 4, 125),
    EXL(NOTE_CS, 6, 63),
    EXL(NOTE_F, 4, 62),
    EXL(NOTE_D, 4, 125),
    EXL(NOTE_F, 4, 125),
    EXL(NOTE_D, 4, 125),
    EXL(NOTE_B, 5, 63),
    EXL(NOTE_F, 4, 62),
    EXL(NOTE_D, 4, 125),
    EXL(NOTE_F, 4, 125),
    EXL(NOTE_D, 4, 125),
    EXL(NOTE_F, 4, 125),
    EXL(NOTE_B, 5, 63),
    EXL(NOTE_D, 4, 62),
    /* Events 465-480 */
    EXL(NOTE_A, 5, 32),
    EXL(NOTE_F, 4, 31),
    EXL(NOTE_B, 5, 63),
    EXL(NOTE_A, 5, 32),
    EXL(NOTE_D, 4, 31),
    EXL(NOTE_GS, 5, 63),
    EXL(NOTE_A, 5, 63),
    EXL(NOTE_D, 3, 62),
    EXL(NOTE_D, 4, 125),
    EXL(NOTE_FS, 4, 125),
    EXL(NOTE_D, 4, 125),
    EXL(NOTE_FS, 4, 125),
    EXL(NOTE_D, 4, 125),
    EXL(NOTE_FS, 4, 125),
    EXL(NOTE_D, 4, 125),
    EXL(NOTE_D, 5, 63),
    /* Events 481-496 */
    EXL(NOTE_FS, 4, 62),
    EXL(NOTE_D, 4, 125),
    EXL(NOTE_FS, 4, 125),
    EXL(NOTE_D, 4, 125),
    EXL(NOTE_FS, 4, 125),
    EXL(NOTE_A, 4, 63),
    EXL(NOTE_D, 4, 62),
    EXL(NOTE_D, 5, 63),
    EXL(NOTE_FS, 4, 62),
    EXL(NOTE_A, 5, 42),
    EXL(NOTE_A, 4, 42),
    EXL(NOTE_D, 4, 41),
    EXL(NOTE_GS, 5, 42),
    EXL(NOTE_GS, 4, 42),
    EXL(NOTE_D, 3, 41),
    EXL(NOTE_D, 4, 125),
    /* Events 497-512 */
    EXL(NOTE_F, 4, 125),
    EXL(NOTE_D, 4, 125),
    EXL(NOTE_B, 5, 63),
    EXL(NOTE_F, 4, 62),
    EXL(NOTE_D, 4, 125),
    EXL(NOTE_F, 4, 125),
    EXL(NOTE_D, 4, 125),
    EXL(NOTE_F, 4, 125),
    EXL(NOTE_D, 4, 125),
    EXL(NOTE_F, 4, 125),
    EXL(NOTE_D, 4, 125),
    EXL(NOTE_F, 4, 125),
    EXL(NOTE_D, 4, 125),
    EXL(NOTE_F, 4, 125),
    EXL(NOTE_D, 4, 125),
    EXL(NOTE_FS, 4, 84),
    /* Events 513-528 */
    EXL(NOTE_E, 4, 83),
    EXL(NOTE_D, 3, 83),
    EXL(NOTE_FS, 4, 313),
    EXL(NOTE_A, 3, 62),
    EXL(NOTE_G, 4, 125),
    EXL(NOTE_A, 4, 125),
    EXL(NOTE_B, 4, 63),
    EXL(NOTE_FS, 4, 62),
    EXL(NOTE_G, 3, 250),
    EXL(NOTE_E, 4, 125),
    EXL(NOTE_D, 3, 125),
    EXL(NOTE_E, 4, 63),
    EXL(NOTE_B, 3, 62),
    EXL(NOTE_FS, 4, 125),
    EXL(NOTE_G, 4, 125),
    EXL(NOTE_A, 4, 63),
    /* Events 529-544 */
    EXL(NOTE_E, 4, 62),
    EXL(NOTE_CS, 3, 250),
    EXL(NOTE_E, 4, 125),
    EXL(NOTE_A, 3, 125),
    EXL(NOTE_E, 4, 84),
    EXL(NOTE_CS, 4, 83),
    EXL(NOTE_FS, 4, 167),
    EXL(NOTE_G, 4, 167),
    EXL(NOTE_FS, 4, 84),
    EXL(NOTE_B, 3, 83),
    EXL(NOTE_FS, 3, 83),
    EXL(NOTE_FS, 4, 83),
    EXL(NOTE_G, 4, 83),
    EXL(NOTE_FS, 4, 83),
    EXL(NOTE_E, 4, 125),
    EXL(NOTE_AS, 3, 125),
    /* Events 545-560 */
    EXL(NOTE_FS, 3, 250),
    EXL(NOTE_D, 4, 84),
    EXL(NOTE_A, 3, 83),
    EXL(NOTE_B, 3, 83),
    EXL(NOTE_D, 4, 125),
    EXL(NOTE_FS, 3, 125),
    EXL(NOTE_D, 4, 63),
    EXL(NOTE_A, 3, 62),
    EXL(NOTE_E, 4, 125),
    EXL(NOTE_FS, 4, 188),
    EXL(NOTE_B, 3, 62),
    EXL(NOTE_E, 3, 250),
    EXL(NOTE_B, 3, 334),
    EXL(NOTE_GS, 3, 83),
    EXL(NOTE_CS, 4, 167),
    EXL(NOTE_D, 4, 167),
    /* Events 561-576 */
    EXL(NOTE_E, 4, 125),
    EXL(NOTE_E, 3, 125),
    EXL(NOTE_B, 3, 125),
    EXL(NOTE_D, 3, 125),
    EXL(NOTE_FS, 3, 125),
    EXL(NOTE_G, 3, 125),
    EXL(NOTE_B, 3, 125),
    EXL(NOTE_D, 4, 157),
    EXL(NOTE_B, 3, 31),
    EXL(NOTE_G, 3, 31),
    EXL(NOTE_A, 3, 31),
    EXL(NOTE_FS, 4, 125),
    EXL(NOTE_E, 4, 250),
    EXL(NOTE_CS, 4, 125),
    EXL(NOTE_A, 3, 125),
    EXL(NOTE_E, 3, 250),
    /* Events 577-592 */
    EXL(NOTE_CS, 5, 63),
    EXL(NOTE_A, 4, 63),
    EXL(NOTE_E, 4, 62),
    EXL(NOTE_FS, 3, 62),
    EXL(NOTE_CS, 5, 42),
    EXL(NOTE_A, 4, 42),
    EXL(NOTE_CS, 3, 41),
    EXL(NOTE_E, 3, 125),
    EXL(NOTE_CS, 5, 42),
    EXL(NOTE_A, 4, 42),
    EXL(NOTE_A, 3, 41),
    EXL(NOTE_B, 4, 63),
    EXL(NOTE_CS, 4, 62),
    EXL(NOTE_A, 4, 125),
    EXL(NOTE_D, 5, 63),
    EXL(NOTE_A, 4, 62),
    /* Events 593-608 */
    EXL(NOTE_D, 5, 250),
    EXL(NOTE_FS, 3, 125),
    EXL(NOTE_CS, 4, 125),
    EXL(NOTE_A, 4, 63),
    EXL(NOTE_D, 4, 62),
    EXL(NOTE_A, 3, 125),
    EXL(NOTE_D, 4, 125),
    EXL(NOTE_A, 4, 125),
    EXL(NOTE_CS, 5, 63),
    EXL(NOTE_A, 4, 63),
    EXL(NOTE_E, 4, 62),
    EXL(NOTE_FS, 3, 62),
    EXL(NOTE_CS, 3, 125),
    EXL(NOTE_CS, 5, 63),
    EXL(NOTE_E, 3, 62),
    EXL(NOTE_CS, 5, 42),
    /* Events 609-624 */
    EXL(NOTE_A, 4, 42),
    EXL(NOTE_A, 3, 41),
    EXL(NOTE_D, 5, 63),
    EXL(NOTE_CS, 4, 62),
    EXL(NOTE_E, 5, 125),
    EXL(NOTE_A, 4, 125),
    EXL(NOTE_D, 5, 84),
    EXL(NOTE_A, 4, 83),
    EXL(NOTE_B, 3, 83),
    EXL(NOTE_FS, 3, 125),
    EXL(NOTE_A, 3, 125),
    EXL(NOTE_FS, 5, 84),
    EXL(NOTE_A, 4, 83),
    EXL(NOTE_D, 4, 83),
    EXL(NOTE_D, 5, 250),
    EXL(NOTE_B, 4, 63),
    /* Events 625-640 */
    EXL(NOTE_G, 4, 63),
    EXL(NOTE_D, 4, 62),
    EXL(NOTE_E, 3, 62),
    EXL(NOTE_B, 3, 125),
    EXL(NOTE_B, 4, 63),
    EXL(NOTE_D, 3, 62),
    EXL(NOTE_B, 4, 56),
    EXL(NOTE_G, 4, 56),
    EXL(NOTE_G, 3, 55),
    EXL(NOTE_CS, 5, 84),
    EXL(NOTE_G, 4, 83),
    EXL(NOTE_D, 5, 84),
    EXL(NOTE_G, 4, 83),
    EXL(NOTE_D, 5, 84),
    EXL(NOTE_A, 4, 83),
    EXL(NOTE_D, 3, 83),
    /* Events 641-656 */
    EXL(NOTE_A, 4, 42),
    EXL(NOTE_E, 4, 42),
    EXL(NOTE_D, 3, 41),
    EXL(NOTE_A, 3, 125),
    EXL(NOTE_A, 4, 63),
    EXL(NOTE_D, 4, 62),
    EXL(NOTE_D, 3, 42),
    EXL(NOTE_G, 4, 42),
    EXL(NOTE_D, 4, 41),
    EXL(NOTE_D, 3, 83),
    EXL(NOTE_FS, 4, 84),
    EXL(NOTE_D, 4, 83),
    EXL(NOTE_FS, 4, 84),
    EXL(NOTE_D, 4, 83),
    EXL(NOTE_C, 3, 208),
    EXL(NOTE_G, 3, 125),
    /* Events 657-672 */
    EXL(NOTE_G, 4, 63),
    EXL(NOTE_D, 4, 62),
    EXL(NOTE_G, 3, 125),
    EXL(NOTE_C, 4, 125),
    EXL(NOTE_D, 4, 125),
    EXL(NOTE_D, 5, 84),
    EXL(NOTE_A, 4, 83),
    EXL(NOTE_G, 4, 83),
    EXL(NOTE_C, 3, 250),
    EXL(NOTE_G, 4, 84),
    EXL(NOTE_C, 4, 83),
    EXL(NOTE_C, 3, 83),
    EXL(NOTE_E, 5, 63),
    EXL(NOTE_G, 4, 63),
    EXL(NOTE_C, 3, 124),
    EXL(NOTE_E, 5, 63),
    /* Events 673-688 */
    EXL(NOTE_G, 4, 63),
    EXL(NOTE_A, 3, 249),
    EXL(NOTE_E, 3, 125),
    EXL(NOTE_G, 3, 125),
    EXL(NOTE_A, 3, 125),
    EXL(NOTE_D, 4, 125),
    EXL(NOTE_E, 4, 125),
    EXL(NOTE_A, 4, 25),
    EXL(NOTE_E, 4, 25),
    EXL(NOTE_D, 4, 25),
    EXL(NOTE_A, 3, 50),
    EXL_R(375),
    EXL(NOTE_FS, 5, 32),
    EXL(NOTE_A, 4, 31),
    EXL(NOTE_A, 3, 62),
    EXL(NOTE_G, 5, 125),
    /* Events 689-704 */
    EXL(NOTE_FS, 5, 125),
    EXL(NOTE_E, 5, 125),
    EXL(NOTE_FS, 5, 50),
    EXL(NOTE_B, 4, 50),
    EXL(NOTE_FS, 4, 50),
    EXL(NOTE_G, 3, 100),
    EXL(NOTE_D, 3, 125),
    EXL(NOTE_G, 3, 125),
    EXL(NOTE_B, 4, 63),
    EXL(NOTE_FS, 4, 62),
    EXL(NOTE_A, 3, 125),
    EXL(NOTE_B, 3, 125),
    EXL(NOTE_D, 4, 125),
    EXL(NOTE_E, 5, 63),
    EXL(NOTE_A, 4, 63),
    EXL(NOTE_E, 4, 62),
    /* Events 705-720 */
    EXL(NOTE_A, 3, 312),
    EXL(NOTE_A, 4, 167),
    EXL(NOTE_E, 4, 167),
    EXL(NOTE_E, 3, 166),
    EXL(NOTE_E, 5, 63),
    EXL(NOTE_A, 4, 63),
    EXL(NOTE_E, 4, 62),
    EXL(NOTE_FS, 3, 62),
    EXL(NOTE_CS, 3, 125),
    EXL(NOTE_E, 3, 125),
    EXL(NOTE_A, 4, 63),
    EXL(NOTE_E, 4, 62),
    EXL(NOTE_A, 3, 125),
    EXL(NOTE_CS, 4, 125),
    EXL(NOTE_A, 3, 125),
    EXL(NOTE_D, 5, 84),
    /* Events 721-736 */
    EXL(NOTE_A, 4, 83),
    EXL(NOTE_B, 3, 83),
    EXL(NOTE_D, 3, 250),
    EXL(NOTE_FS, 5, 42),
    EXL(NOTE_A, 4, 42),
    EXL(NOTE_A, 3, 41),
    EXL(NOTE_G, 5, 125),
    EXL(NOTE_FS, 5, 125),
    EXL(NOTE_E, 5, 125),
    EXL(NOTE_FS, 5, 63),
    EXL(NOTE_B, 4, 63),
    EXL(NOTE_FS, 4, 62),
    EXL(NOTE_E, 3, 62),
    EXL(NOTE_B, 3, 125),
    EXL(NOTE_D, 3, 125),
    EXL(NOTE_B, 4, 63),
    /* Events 737-752 */
    EXL(NOTE_FS, 4, 62),
    EXL(NOTE_FS, 3, 125),
    EXL(NOTE_G, 3, 125),
    EXL(NOTE_D, 4, 125),
    EXL(NOTE_G, 5, 84),
    EXL(NOTE_A, 4, 83),
    EXL(NOTE_A, 3, 83),
    EXL(NOTE_FS, 5, 63),
    EXL(NOTE_E, 3, 62),
    EXL(NOTE_E, 5, 125),
    EXL(NOTE_A, 3, 125),
    EXL(NOTE_D, 5, 375),
    EXL(NOTE_FS, 5, 84),
    EXL(NOTE_C, 5, 83),
    EXL(NOTE_A, 3, 333),
    EXL(NOTE_A, 4, 84),
    /* Events 753-768 */
    EXL(NOTE_E, 4, 83),
    EXL(NOTE_C, 4, 83),
    EXL(NOTE_A, 3, 250),
    EXL(NOTE_G, 4, 63),
    EXL(NOTE_E, 4, 63),
    EXL(NOTE_C, 4, 62),
    EXL(NOTE_D, 3, 187),
    EXL(NOTE_A, 3, 125),
    EXL(NOTE_FS, 5, 42),
    EXL(NOTE_A, 4, 42),
    EXL(NOTE_C, 4, 41),
    EXL(NOTE_E, 5, 63),
    EXL(NOTE_E, 4, 62),
    EXL(NOTE_D, 5, 125),
    EXL(NOTE_E, 5, 125),
    EXL(NOTE_FS, 5, 63),
    /* Events 769-784 */
    EXL(NOTE_B, 4, 63),
    EXL(NOTE_FS, 4, 62),
    EXL(NOTE_G, 3, 62),
    EXL(NOTE_D, 3, 250),
    EXL(NOTE_B, 5, 167),
    EXL(NOTE_D, 5, 167),
    EXL(NOTE_B, 3, 166),
    EXL(NOTE_E, 5, 63),
    EXL(NOTE_A, 4, 63),
    EXL(NOTE_E, 4, 62),
    EXL(NOTE_G, 3, 62),
    EXL(NOTE_E, 3, 250),
    EXL(NOTE_FS, 5, 167),
    EXL(NOTE_A, 4, 167),
    EXL(NOTE_CS, 4, 166),
    EXL(NOTE_A, 5, 63),
    /* Events 785-800 */
    EXL(NOTE_E, 5, 63),
    EXL(NOTE_A, 4, 62),
    EXL(NOTE_FS, 3, 62),
    EXL(NOTE_A, 5, 42),
    EXL(NOTE_A, 4, 42),
    EXL(NOTE_CS, 3, 41),
    EXL(NOTE_FS, 5, 63),
    EXL(NOTE_E, 3, 62),
    EXL(NOTE_B, 5, 42),
    EXL(NOTE_FS, 5, 42),
    EXL(NOTE_A, 3, 41),
    EXL(NOTE_CS, 4, 125),
    EXL(NOTE_D, 5, 125),
    EXL(NOTE_E, 5, 63),
    EXL(NOTE_A, 4, 62),
    EXL(NOTE_B, 3, 125),
    /* Events 801-816 */
    EXL(NOTE_D, 5, 63),
    EXL(NOTE_A, 4, 62),
    EXL(NOTE_D, 3, 250),
    EXL(NOTE_A, 3, 125),
    EXL(NOTE_B, 4, 250),
    EXL(NOTE_CS, 5, 125),
    EXL(NOTE_D, 5, 84),
    EXL(NOTE_G, 4, 83),
    EXL(NOTE_E, 3, 83),
    EXL(NOTE_B, 3, 250),
    EXL(NOTE_FS, 5, 84),
    EXL(NOTE_G, 4, 83),
    EXL(NOTE_D, 3, 83),
    EXL(NOTE_G, 3, 250),
    EXL(NOTE_CS, 5, 167),
    EXL(NOTE_G, 4, 167),
    /* Events 817-832 */
    EXL(NOTE_A, 3, 166),
    EXL(NOTE_E, 4, 188),
    EXL(NOTE_CS, 4, 187),
    EXL(NOTE_E, 5, 63),
    EXL(NOTE_G, 4, 62),
    EXL(NOTE_D, 3, 125),
    EXL(NOTE_D, 5, 63),
    EXL(NOTE_FS, 4, 62),
    EXL(NOTE_D, 3, 125),
    EXL(NOTE_A, 3, 125),
    EXL(NOTE_A, 4, 63),
    EXL(NOTE_E, 4, 62),
    EXL(NOTE_A, 3, 125),
    EXL(NOTE_D, 4, 125),
    EXL(NOTE_E, 4, 125),
    EXL(NOTE_G, 4, 84),
    /* Events 833-848 */
    EXL(NOTE_D, 4, 83),
    EXL(NOTE_D, 3, 83),
    EXL(NOTE_FS, 4, 63),
    EXL(NOTE_D, 4, 62),
    EXL(NOTE_D, 3, 125),
    EXL(NOTE_E, 4, 125),
    EXL(NOTE_D, 3, 125),
    EXL(NOTE_B, 4, 125),
    EXL(NOTE_A, 4, 125),
    EXL(NOTE_B, 4, 84),
    EXL(NOTE_D, 4, 83),
    EXL(NOTE_G, 3, 83),
    EXL(NOTE_B, 4, 42),
    EXL(NOTE_D, 4, 42),
    EXL(NOTE_D, 3, 41),
    EXL(NOTE_A, 4, 42),
    /* Events 849-864 */
    EXL(NOTE_D, 4, 42),
    EXL(NOTE_G, 3, 41),
    EXL(NOTE_B, 4, 63),
    EXL(NOTE_D, 4, 62),
    EXL(NOTE_G, 3, 125),
    EXL(NOTE_B, 4, 63),
    EXL(NOTE_D, 4, 62),
    EXL(NOTE_A, 4, 63),
    EXL(NOTE_D, 4, 62),
    EXL(NOTE_B, 4, 56),
    EXL(NOTE_D, 4, 56),
    EXL(NOTE_G, 3, 55),
    EXL(NOTE_CS, 5, 84),
    EXL(NOTE_A, 4, 83),
    EXL(NOTE_D, 5, 84),
    EXL(NOTE_A, 4, 83),
    /* Events 865-880 */
    EXL(NOTE_E, 5, 42),
    EXL(NOTE_A, 4, 42),
    EXL(NOTE_G, 3, 166),
    EXL(NOTE_D, 5, 63),
    EXL(NOTE_A, 4, 62),
    EXL(NOTE_D, 5, 63),
    EXL(NOTE_A, 4, 62),
    EXL(NOTE_D, 5, 250),
    EXL(NOTE_FS, 3, 125),
    EXL(NOTE_A, 3, 125),
    EXL(NOTE_A, 4, 63),
    EXL(NOTE_D, 4, 62),
    EXL(NOTE_FS, 3, 250),
    EXL(NOTE_A, 3, 125),
    EXL(NOTE_E, 4, 84),
    EXL(NOTE_CS, 4, 83),
    /* Events 881-896 */
    EXL(NOTE_B, 3, 83),
    EXL(NOTE_FS, 4, 63),
    EXL(NOTE_D, 4, 62),
    EXL(NOTE_FS, 3, 125),
    EXL(NOTE_A, 4, 63),
    EXL(NOTE_D, 4, 62),
    EXL(NOTE_A, 3, 125),
    EXL(NOTE_B, 4, 63),
    EXL(NOTE_D, 4, 62),
    EXL(NOTE_CS, 5, 63),
    EXL(NOTE_A, 4, 62),
    EXL(NOTE_D, 5, 63),
    EXL(NOTE_G, 4, 63),
    EXL(NOTE_D, 4, 62),
    EXL(NOTE_E, 3, 62),
    EXL(NOTE_D, 5, 42),
    /* Events 897-912 */
    EXL(NOTE_G, 4, 42),
    EXL(NOTE_E, 3, 41),
    EXL(NOTE_CS, 5, 125),
    EXL(NOTE_D, 5, 84),
    EXL(NOTE_G, 4, 83),
    EXL(NOTE_G, 3, 83),
    EXL(NOTE_D, 5, 42),
    EXL(NOTE_G, 4, 42),
    EXL(NOTE_E, 3, 41),
    EXL(NOTE_CS, 5, 125),
    EXL(NOTE_D, 5, 84),
    EXL(NOTE_G, 4, 83),
    EXL(NOTE_A, 3, 83),
    EXL(NOTE_G, 3, 125),
    EXL(NOTE_D, 5, 63),
    EXL(NOTE_A, 4, 62),
    /* Events 913-928 */
    EXL(NOTE_E, 5, 56),
    EXL(NOTE_A, 4, 56),
    EXL(NOTE_CS, 4, 55),
    EXL(NOTE_D, 5, 42),
    EXL(NOTE_A, 4, 41),
    EXL(NOTE_A, 3, 83),
    EXL(NOTE_B, 4, 251),
    EXL(NOTE_D, 4, 83),
    EXL(NOTE_D, 3, 208),
    EXL(NOTE_A, 4, 42),
    EXL(NOTE_D, 4, 42),
    EXL(NOTE_E, 3, 41),
    EXL(NOTE_A, 4, 125),
    EXL(NOTE_D, 4, 125),
    EXL(NOTE_E, 4, 125),
    EXL(NOTE_FS, 4, 125),
    /* Events 929-944 */
    EXL_R(125),
    EXL(NOTE_G, 4, 63),
    EXL(NOTE_D, 4, 63),
    EXL(NOTE_G, 3, 62),
    EXL(NOTE_E, 3, 187),
    EXL(NOTE_A, 4, 63),
    EXL(NOTE_D, 4, 63),
    EXL(NOTE_A, 3, 62),
    EXL(NOTE_FS, 3, 62),
    EXL(NOTE_B, 4, 42),
    EXL(NOTE_D, 4, 42),
    EXL(NOTE_D, 3, 41),
    EXL(NOTE_A, 4, 63),
    EXL(NOTE_D, 4, 62),
    EXL(NOTE_B, 4, 84),
    EXL(NOTE_D, 4, 83),
    /* Events 945-960 */
    EXL(NOTE_G, 3, 83),
    EXL(NOTE_B, 4, 42),
    EXL(NOTE_D, 4, 42),
    EXL(NOTE_D, 3, 41),
    EXL(NOTE_A, 4, 42),
    EXL(NOTE_D, 4, 42),
    EXL(NOTE_G, 3, 41),
    EXL(NOTE_B, 4, 63),
    EXL(NOTE_D, 4, 62),
    EXL(NOTE_G, 3, 125),
    EXL(NOTE_B, 4, 63),
    EXL(NOTE_D, 4, 62),
    EXL(NOTE_A, 4, 63),
    EXL(NOTE_D, 4, 62),
    EXL(NOTE_B, 4, 56),
    EXL(NOTE_D, 4, 56),
    /* Events 961-976 */
    EXL(NOTE_G, 3, 55),
    EXL(NOTE_CS, 5, 84),
    EXL(NOTE_A, 4, 83),
    EXL(NOTE_D, 5, 84),
    EXL(NOTE_A, 4, 83),
    EXL(NOTE_E, 5, 42),
    EXL(NOTE_A, 4, 42),
    EXL(NOTE_G, 3, 166),
    EXL(NOTE_D, 5, 63),
    EXL(NOTE_A, 4, 62),
    EXL(NOTE_FS, 5, 63),
    EXL(NOTE_A, 4, 62),
    EXL(NOTE_FS, 5, 250),
    EXL(NOTE_B, 3, 125),
    EXL(NOTE_FS, 3, 125),
    EXL(NOTE_A, 4, 63),
    /* Events 977-992 */
    EXL(NOTE_D, 4, 62),
    EXL(NOTE_B, 3, 125),
    EXL(NOTE_FS, 3, 125),
    EXL(NOTE_A, 4, 42),
    EXL(NOTE_E, 4, 42),
    EXL(NOTE_CS, 4, 41),
    EXL(NOTE_A, 4, 125),
    EXL(NOTE_B, 3, 125),
    EXL(NOTE_G, 5, 63),
    EXL(NOTE_D, 5, 62),
    EXL(NOTE_FS, 3, 125),
    EXL(NOTE_FS, 5, 84),
    EXL(NOTE_D, 5, 83),
    EXL(NOTE_E, 5, 84),
    EXL(NOTE_A, 4, 83),
    EXL(NOTE_D, 5, 167),
    /* Events 993-1008 */
    EXL(NOTE_E, 5, 42),
    EXL(NOTE_B, 4, 42),
    EXL(NOTE_E, 3, 41),
    EXL(NOTE_D, 5, 125),
    EXL(NOTE_E, 3, 125),
    EXL(NOTE_GS, 3, 125),
    EXL(NOTE_B, 4, 63),
    EXL(NOTE_E, 4, 62),
    EXL(NOTE_GS, 3, 125),
    EXL(NOTE_B, 3, 125),
    EXL(NOTE_D, 5, 63),
    EXL(NOTE_GS, 4, 62),
    EXL(NOTE_D, 5, 125),
    EXL(NOTE_E, 4, 125),
    EXL(NOTE_FS, 5, 334),
    EXL(NOTE_B, 4, 83),
    /* Events 1009-1024 */
    EXL(NOTE_E, 5, 167),
    EXL(NOTE_D, 5, 167),
    EXL(NOTE_E, 5, 63),
    EXL(NOTE_AS, 4, 63),
    EXL(NOTE_G, 4, 62),
    EXL(NOTE_G, 3, 62),
    EXL(NOTE_D, 3, 125),
    EXL(NOTE_A, 3, 125),
    EXL(NOTE_AS, 3, 125),
    EXL(NOTE_D, 4, 125),
    EXL(NOTE_G, 4, 125),
    EXL(NOTE_AS, 4, 125),
    EXL(NOTE_A, 5, 125),
    EXL(NOTE_D, 5, 125),
    EXL(NOTE_B, 4, 125),
    EXL(NOTE_A, 3, 125),
    /* Events 1025-1040 */
    EXL(NOTE_FS, 5, 125),
    EXL(NOTE_G, 5, 125),
    EXL(NOTE_FS, 5, 125),
    EXL(NOTE_E, 5, 125),
    EXL(NOTE_FS, 5, 167),
    EXL(NOTE_B, 4, 167),
    EXL(NOTE_G, 3, 166),
    EXL(NOTE_B, 4, 500),
    EXL(NOTE_E, 5, 125),
    EXL(NOTE_CS, 5, 125),
    EXL(NOTE_A, 4, 125),
    EXL(NOTE_G, 3, 125),
    EXL(NOTE_A, 4, 500),
    EXL(NOTE_E, 5, 63),
    EXL(NOTE_A, 4, 63),
    EXL(NOTE_E, 4, 62),
    /* Events 1041-1056 */
    EXL(NOTE_FS, 3, 62),
    EXL(NOTE_CS, 4, 250),
    EXL(NOTE_A, 4, 250),
    EXL(NOTE_E, 4, 250),
    EXL(NOTE_D, 5, 84),
    EXL(NOTE_A, 4, 83),
    EXL(NOTE_B, 3, 83),
    EXL(NOTE_FS, 3, 250),
    EXL(NOTE_FS, 5, 42),
    EXL(NOTE_A, 4, 42),
    EXL(NOTE_D, 4, 41),
    EXL(NOTE_G, 5, 125),
    EXL(NOTE_FS, 5, 125),
    EXL(NOTE_E, 5, 125),
    EXL(NOTE_FS, 5, 63),
    EXL(NOTE_B, 4, 63),
    /* Events 1057-1072 */
    EXL(NOTE_G, 4, 62),
    EXL(NOTE_E, 3, 187),
    EXL(NOTE_G, 3, 125),
    EXL(NOTE_B, 4, 63),
    EXL(NOTE_G, 4, 62),
    EXL(NOTE_B, 3, 125),
    EXL(NOTE_D, 4, 125),
    EXL(NOTE_A, 4, 125),
    EXL(NOTE_G, 5, 84),
    EXL(NOTE_A, 4, 83),
    EXL(NOTE_A, 3, 83),
    EXL(NOTE_FS, 5, 42),
    EXL(NOTE_A, 4, 42),
    EXL(NOTE_E, 3, 41),
    EXL(NOTE_E, 5, 63),
    EXL(NOTE_A, 4, 62),
    /* Events 1073-1088 */
    EXL(NOTE_A, 3, 125),
    EXL(NOTE_D, 5, 125),
    EXL(NOTE_A, 4, 125),
    EXL(NOTE_A, 5, 42),
    EXL(NOTE_D, 5, 42),
    EXL(NOTE_A, 4, 41),
    EXL(NOTE_A, 5, 250),
    EXL(NOTE_D, 3, 125),
    EXL(NOTE_A, 3, 125),
    EXL(NOTE_A, 4, 63),
    EXL(NOTE_E, 4, 62),
    EXL(NOTE_D, 4, 125),
    EXL(NOTE_A, 3, 125),
    EXL(NOTE_E, 4, 125),
    EXL_R(125),
    EXL(NOTE_G, 4, 63),
    /* Events 1089-1104 */
    EXL(NOTE_D, 4, 63),
    EXL(NOTE_B, 3, 62),
    EXL(NOTE_E, 3, 187),
    EXL(NOTE_FS, 5, 42),
    EXL(NOTE_A, 4, 42),
    EXL(NOTE_FS, 3, 41),
    EXL(NOTE_E, 5, 125),
    EXL(NOTE_D, 5, 63),
    EXL(NOTE_D, 3, 62),
    EXL(NOTE_E, 5, 125),
    EXL(NOTE_FS, 5, 63),
    EXL(NOTE_B, 4, 63),
    EXL(NOTE_FS, 4, 62),
    EXL(NOTE_G, 3, 62),
    EXL(NOTE_D, 3, 125),
    EXL(NOTE_A, 3, 125),
    /* Events 1105-1120 */
    EXL(NOTE_B, 5, 42),
    EXL(NOTE_B, 4, 42),
    EXL(NOTE_B, 3, 41),
    EXL(NOTE_D, 4, 125),
    EXL(NOTE_FS, 4, 125),
    EXL(NOTE_B, 4, 125),
    EXL(NOTE_E, 5, 63),
    EXL(NOTE_A, 4, 63),
    EXL(NOTE_E, 4, 62),
    EXL(NOTE_G, 3, 62),
    EXL(NOTE_E, 3, 250),
    EXL(NOTE_FS, 5, 250),
    EXL(NOTE_A, 4, 250),
    EXL(NOTE_A, 5, 63),
    EXL(NOTE_E, 5, 63),
    EXL(NOTE_A, 4, 62),
    /* Events 1121-1136 */
    EXL(NOTE_FS, 3, 62),
    EXL(NOTE_A, 5, 42),
    EXL(NOTE_A, 4, 42),
    EXL(NOTE_CS, 3, 41),
    EXL(NOTE_FS, 5, 63),
    EXL(NOTE_E, 3, 62),
    EXL(NOTE_B, 5, 42),
    EXL(NOTE_CS, 5, 42),
    EXL(NOTE_A, 3, 41),
    EXL(NOTE_CS, 4, 125),
    EXL(NOTE_D, 5, 188),
    EXL(NOTE_A, 4, 62),
    EXL(NOTE_D, 5, 250),
    EXL(NOTE_D, 3, 125),
    EXL(NOTE_A, 4, 63),
    EXL(NOTE_D, 4, 62),
    /* Events 1137-1152 */
    EXL(NOTE_A, 3, 125),
    EXL(NOTE_B, 4, 250),
    EXL(NOTE_CS, 5, 125),
    EXL(NOTE_D, 5, 63),
    EXL(NOTE_G, 4, 63),
    EXL(NOTE_D, 4, 62),
    EXL(NOTE_E, 3, 312),
    EXL(NOTE_FS, 5, 250),
    EXL(NOTE_G, 4, 250),
    EXL(NOTE_CS, 5, 125),
    EXL(NOTE_G, 4, 125),
    EXL(NOTE_E, 4, 125),
    EXL(NOTE_A, 3, 125),
    EXL_R(375),
    EXL(NOTE_A, 4, 125),
    EXL(NOTE_B, 3, 125),
    /* Events 1153-1168 */
    EXL(NOTE_E, 5, 125),
    EXL(NOTE_D, 5, 63),
    EXL(NOTE_FS, 3, 62),
    EXL(NOTE_CS, 4, 125),
    EXL(NOTE_D, 4, 125),
    EXL(NOTE_E, 4, 125),
    EXL(NOTE_FS, 4, 125),
    EXL(NOTE_A, 4, 125),
    EXL(NOTE_GS, 4, 125),
    EXL(NOTE_E, 3, 375),
    EXL(NOTE_E, 4, 125),
    EXL(NOTE_B, 3, 125),
    EXL(NOTE_B, 5, 125),
    EXL(NOTE_CS, 6, 125),
    EXL(NOTE_D, 6, 125),
    EXL(NOTE_G, 5, 125),
    /* Events 1169-1184 */
    EXL(NOTE_D, 5, 125),
    EXL(NOTE_E, 3, 125),
    EXL(NOTE_FS, 6, 500),
    EXL(NOTE_CS, 6, 250),
    EXL(NOTE_G, 5, 250),
    EXL(NOTE_E, 5, 250),
    EXL(NOTE_A, 3, 1250),
    EXL(NOTE_E, 6, 500),
    EXL(NOTE_D, 6, 500),
    EXL(NOTE_A, 4, 63),
    EXL(NOTE_FS, 4, 63),
    EXL(NOTE_E, 4, 62),
    EXL(NOTE_D, 3, 62),
    EXL(NOTE_A, 3, 250),
    EXL(NOTE_FS, 4, 125),
    EXL(NOTE_D, 4, 125),
    /* Events 1185-1200 */
    EXL(NOTE_A, 3, 250),
    EXL(NOTE_E, 4, 250),
    EXL(NOTE_D, 4, 250),
    EXL(NOTE_FS, 4, 63),
    EXL(NOTE_D, 4, 62),
    EXL(NOTE_G, 4, 125),
    EXL(NOTE_A, 4, 250),
    EXL(NOTE_G, 4, 84),
    EXL(NOTE_C, 4, 83),
    EXL(NOTE_A, 3, 83),
    EXL(NOTE_E, 3, 250),
    EXL(NOTE_C, 4, 250),
    EXL(NOTE_C, 5, 125),
    EXL(NOTE_E, 4, 125),
    EXL(NOTE_B, 4, 250),
    EXL(NOTE_E, 4, 250),
    /* Events 1201-1216 */
    EXL(NOTE_A, 4, 500),
    EXL(NOTE_G, 4, 63),
    EXL(NOTE_E, 4, 63),
    EXL(NOTE_D, 4, 62),
    EXL(NOTE_C, 3, 62),
    EXL(NOTE_G, 3, 250),
    EXL(NOTE_C, 4, 250),
    EXL(NOTE_D, 4, 250),
    EXL(NOTE_E, 4, 125),
    EXL(NOTE_C, 4, 125),
    EXL(NOTE_FS, 4, 125),
    EXL(NOTE_D, 4, 125),
    EXL(NOTE_G, 4, 125),
    EXL(NOTE_E, 4, 125),
    EXL(NOTE_A, 4, 125),
    EXL(NOTE_FS, 4, 125),
    /* Events 1217-1227 */
    EXL(NOTE_D, 4, 84),
    EXL(NOTE_B, 3, 166),
    EXL(NOTE_G, 3, 250),
    EXL(NOTE_B, 3, 250),
    EXL(NOTE_D, 4, 250),
    EXL(NOTE_G, 4, 1000),
    EXL(NOTE_FS, 4, 400),
    EXL(NOTE_E, 4, 400),
    EXL(NOTE_D, 4, 400),
    EXL(NOTE_A, 3, 400),
    EXL(NOTE_D, 3, 400)
};

#undef EXL_R
#undef EXL
